## CMakeLists.txt
```
cmake_minimum_required(VERSION 3.20.0)
# 모델 가중치 창은 **공용 파일 하나**를 쓴다 — 앱마다 복사해 두면 주소를
# 고칠 때 갈린다 (실제로 실기 DRAM 끝을 넘는 주소가 여섯 군데에 퍼져 있었다).
set(EXTRA_DTC_OVERLAY_FILE
    "${CMAKE_CURRENT_SOURCE_DIR}/../llm_common/model_blob.overlay")

# 사다리 공용 Kconfig 조각 — uart2 인터럽트 폭주를 끈다 (사이클의 77%).
# 근거와 측정값은 그 파일에 있다. ⚠ prj.conf **뒤에** 병합되므로 그 파일이 이긴다.
set(EXTRA_CONF_FILE
    "${CMAKE_CURRENT_SOURCE_DIR}/../llm_common/ladder.conf")

find_package(Zephyr REQUIRED HINTS $ENV{ZEPHYR_BASE})
project(llm_l1)
target_sources(app PRIVATE src/main.c)
```

## prj.conf
```kconfig
CONFIG_PRINTK=y
CONFIG_BOOT_BANNER=n
CONFIG_MAIN_STACK_SIZE=8192

# crc32_ieee / crc32_ieee_update (subsys/crc).
# 다항식 0xedb88320 · 초기 ~0 · 최종 반전 → zlib.crc32 와 같다.
# 이어 쓰기(crc32_ieee_update)도 zlib 와 같은 의미라 청크로 나눠 계산할 수 있다.
CONFIG_CRC=y

# 창 밖 영역을 더 매핑한다. 0x58000000+512MB 는 2 MB 블록 256개 = 추가 L2 2개.
# arm64 기본값은 8 이다(arch/arm64/core/Kconfig:412). 넉넉히 둔다.
CONFIG_MAX_XLAT_TABLES=24

# ⚠ **로그를 동기(immediate)로 만든다 — 쓰는 주체를 하나로 유지한 채.**
#
# 보드 defconfig 에 CONFIG_LOG=y 가 있어(dwc3 드라이버용) printk 가 기본으로
# 로그 시스템을 거친다. 기본 조합이 이렇다:
#     CONFIG_LOG_MODE_DEFERRED=y
#     CONFIG_LOG_BUFFER_SIZE=1024              ← 1 KB
#     CONFIG_LOG_PROCESS_THREAD_SLEEP_MS=1000  ← 로그 스레드가 1초씩 잔다
#     CONFIG_MAIN_THREAD_PRIORITY=0            ← main 이 그 스레드를 선점한다
# 사다리 앱은 80자 수십 줄을 main 에서 쏟으므로 버퍼가 넘쳐 **앞부분이
# 버려진다**(2026-11-07 L5b 첫 실기 투입에서 꼬리만 남았다).
#
# ⚠ 처음에 `CONFIG_LOG_PRINTK=n` 으로 고치려 했다가 **보드가 멈췄다.**
#   그러면 UART2 에 쓰는 주체가 둘이 된다 — printk(main, 동기)와 로그
#   백엔드(로그 스레드). 같은 인터럽트 구동 UART 를 동시에 건드려 교착한
#   것으로 보인다(dwc3 로그 한 줄만 나오고 멈췄다).
#
# 그래서 LOG_PRINTK 는 기본(y) 그대로 두고 **모드만 동기로** 바꾼다.
# 버퍼도 스레드도 쓰지 않으므로 유실이 없고 쓰는 주체는 하나다.
#
# ⚠ moru 는 이 설정을 쓰면 안 된다 — 동기 출력이 줄당 ~9 ms 를 잡아먹어
#   USB 열거의 SET_ADDRESS 50 ms 예산을 넘긴다(docs/hardware-verified.md).
#   사다리 앱은 USB 를 열거하지 않으므로 무해하다.
CONFIG_LOG_MODE_IMMEDIATE=y
```

## boards/qemu_cortex_a53.overlay
```dts
/* QEMU 로 빌드할 때만 적용된다 (Zephyr 가 boards/<board>.overlay 를 자동 포함).
 *
 * ⚠ 실기 보드 DTS 가 sram0 을 256 MiB 로 넓혔으므로(2026-11-07) QEMU 도
 *   맞춘다. 한쪽만 다르면 **다른 메모리 조건에서 돌아** 사다리 비교의 뜻이
 *   사라진다 — 지금 이 칸들은 작은 아레나로 충분해 빌드는 되지만, "같은
 *   조건" 이 사다리의 전제다. 내용은 공용 파일에 있다. */
#include "../../llm_common/qemu_sram256.dtsi"
```

## src/main.c
```c
/*
 * L1 — 대용량 메모리 관문.
 *
 * 사다리(docs/llm-hub-test-plan.md) 둘째 칸. 가리는 것:
 *   "Zephyr 창(128 MB) 밖의 DRAM 을 읽고 쓸 수 있는가"
 * Qwen3.5-0.8B Q4 가 약 0.55 GB 라 창에 안 들어간다. 이게 안 되면
 * L2(GGUF 파서) 이후가 전부 성립하지 않는다.
 *
 * 패턴은 **주소의 함수**다:  word[i] = (uint32)(i * 2654435761) ^ 'moru'
 * 그래서 ① 호스트에서 numpy 로 벡터화해 골든 CRC 를 만들 수 있고
 *        ② 주소가 섞이는 오류(별칭·줄바꿈·바이트순서)를 값으로 잡는다.
 *        단순히 0으로 채우면 창이 실제 RAM 보다 커도 통과해 버린다.
 */
#include <zephyr/kernel.h>
#include <zephyr/devicetree.h>
#include <zephyr/sys/crc.h>
#include <stdint.h>
#include <inttypes.h>

#define BLOB_NODE	DT_NODELABEL(model_blob)
#define BLOB_ADDR	DT_REG_ADDR(BLOB_NODE)
#define BLOB_SIZE	DT_REG_SIZE(BLOB_NODE)

#define PATTERN_MULT	2654435761u	/* Knuth 곱셈 해시 */
#define PATTERN_XOR	0x6D6F7275u	/* 'moru' */

/* 별칭 사전 점검의 보폭. 2 MB = 매핑 블록 하나당 한 번 */
#define ALIAS_STRIDE	(2u * 1024u * 1024u)

/* CRC 를 나눠 계산하는 단위 */
#define CRC_CHUNK	(64u * 1024u)

static inline uint32_t pattern_word(uint32_t i)
{
	return (uint32_t)(i * PATTERN_MULT) ^ PATTERN_XOR;
}

/*
 * 골든 CRC32 — 호스트에서 tools/l1_golden.py 로 계산한 값.
 *
 *   $ python3 tools/l1_golden.py --size 512M   →  0xc9806e9c
 *
 * 영역 크기가 DT 에 고정돼 있으므로 이 값은 이 시험의 상수다.
 * ⚠ apps/llm_common/model_blob.overlay 의 reg 크기나 pattern_word() 를
 *   바꾸면 다시 만들어야 한다. 아래 BUILD_ASSERT 가 먼저 막는다.
 */
#ifndef L1_GOLDEN_CRC32
#define L1_GOLDEN_CRC32 0xc9806e9cu
#endif
BUILD_ASSERT(BLOB_SIZE == 512u * 1024u * 1024u,
	     "골든 CRC32 는 512 MiB 전용이다 — 크기를 바꿨으면 tools/l1_golden.py 로 다시 만들어라");

int main(void)
{
	int fail = 0;

	printk("=== L1: 대용량 메모리 관문 ===\n");
	printk("  창: 0x%08" PRIxPTR " + %u MiB  (DT model_blob, zephyr,memory-region)\n",
	       (uintptr_t)BLOB_ADDR, (unsigned)(BLOB_SIZE / (1024 * 1024)));

	volatile uint32_t *w = (volatile uint32_t *)(uintptr_t)BLOB_ADDR;
	const uint32_t nwords = (uint32_t)(BLOB_SIZE / sizeof(uint32_t));

	/*
	 * [1] 별칭 사전 점검.
	 * 2 MB 마다 그 주소에서만 나오는 값을 넣고 전부 되읽는다. 창이 실제
	 * RAM 보다 크면 뒤쪽 쓰기가 앞쪽을 덮어 여기서 걸린다 — 512 MB 를
	 * 다 쓰기 전에, 싸게.
	 */
	printk("  [1] 별칭 점검 (2 MiB 보폭 %u 지점) ... ", (unsigned)(BLOB_SIZE / ALIAS_STRIDE));
	for (uint32_t off = 0; off < BLOB_SIZE; off += ALIAS_STRIDE) {
		w[off / 4] = pattern_word(off / 4);
	}
	uint32_t alias_bad = 0;
	for (uint32_t off = 0; off < BLOB_SIZE; off += ALIAS_STRIDE) {
		if (w[off / 4] != pattern_word(off / 4)) {
			if (alias_bad == 0) {
				printk("\n      첫 불일치 off=0x%08x 읽음=0x%08x 기대=0x%08x\n",
				       off, w[off / 4], pattern_word(off / 4));
			}
			alias_bad++;
		}
	}
	if (alias_bad == 0) {
		printk("OK\n");
	} else {
		printk("      FAIL — %u 지점 불일치 (창이 실제 RAM 보다 크다)\n", alias_bad);
		fail++;
		goto done;	/* 여기서 틀리면 뒤는 의미 없다 */
	}

	/* [2] 전 영역 쓰기 */
	printk("  [2] 전 영역 쓰기 %u MiB ... ", (unsigned)(BLOB_SIZE / (1024 * 1024)));
	int64_t t0 = k_uptime_get();
	for (uint32_t i = 0; i < nwords; i++) {
		w[i] = pattern_word(i);
	}
	int64_t t_wr = k_uptime_get() - t0;
	printk("%" PRId64 " ms", t_wr);
	if (t_wr > 0) {
		printk("  (%" PRId64 " MiB/s)", (int64_t)(BLOB_SIZE / 1024 / 1024) * 1000 / t_wr);
	}
	printk("\n");

	/* [3] 되읽기 + 값 비교 — CRC 가 맞아도 어디가 틀렸는지 알려 준다 */
	printk("  [3] 되읽기 값 비교 ... ");
	uint32_t bad = 0;
	for (uint32_t i = 0; i < nwords; i++) {
		if (w[i] != pattern_word(i)) {
			if (bad == 0) {
				printk("\n      첫 불일치 i=%u (off=0x%08x) 읽음=0x%08x 기대=0x%08x\n",
				       i, i * 4u, w[i], pattern_word(i));
			}
			bad++;
		}
	}
	if (bad == 0) {
		printk("OK\n");
	} else {
		printk("      FAIL — %u 워드 불일치\n", bad);
		fail++;
	}

	/* [4] CRC32 — 호스트 골든값과 대조 */
	printk("  [4] CRC32 (%u KiB 청크) ... ", (unsigned)(CRC_CHUNK / 1024));
	t0 = k_uptime_get();
	uint32_t crc = 0;
	const uint8_t *p = (const uint8_t *)(uintptr_t)BLOB_ADDR;
	for (uint32_t off = 0; off < BLOB_SIZE; off += CRC_CHUNK) {
		uint32_t n = CRC_CHUNK;
		if (off + n > BLOB_SIZE) {
			n = (uint32_t)BLOB_SIZE - off;
		}
		crc = crc32_ieee_update(crc, p + off, n);
	}
	int64_t t_crc = k_uptime_get() - t0;
	printk("0x%08x  (%" PRId64 " ms)\n", crc, t_crc);

	if (L1_GOLDEN_CRC32 == 0u) {
		printk("      ⚠ 골든값이 안 박혔다 — tools/l1_golden.py 로 만들어 넣어라\n");
		printk("        비교를 건너뛴다 (이 실행은 PASS 로 셈하지 않는다)\n");
		fail++;
	} else if (crc == (uint32_t)L1_GOLDEN_CRC32) {
		printk("      OK — 호스트 골든값 0x%08x 와 일치\n", (uint32_t)L1_GOLDEN_CRC32);
	} else {
		printk("      FAIL — 골든값 0x%08x 와 다르다\n", (uint32_t)L1_GOLDEN_CRC32);
		fail++;
	}

done:
	if (fail == 0) {
		printk("=== L1 PASS (실패 0) ===\n");
	} else {
		printk("=== L1 FAIL (실패 %d) ===\n", fail);
	}
	return 0;
}
```
