## CMakeLists.txt
```
cmake_minimum_required(VERSION 3.20.0)
# 모델 가중치 창은 **공용 파일 하나**를 쓴다 (llm_l5b 와 같은 이유).
set(EXTRA_DTC_OVERLAY_FILE
    "${CMAKE_CURRENT_SOURCE_DIR}/../llm_common/model_blob.overlay")

# 사다리 공용 Kconfig 조각 — uart2 인터럽트 폭주를 끈다 (사이클의 77%).
# 근거와 측정값은 그 파일에 있다. ⚠ prj.conf **뒤에** 병합되므로 그 파일이 이긴다.
set(EXTRA_CONF_FILE
    "${CMAKE_CURRENT_SOURCE_DIR}/../llm_common/ladder.conf")

find_package(Zephyr REQUIRED HINTS $ENV{ZEPHYR_BASE})
project(llm_l6c)

# ── ggml·llama 소스만 -O3 로 (2026-11-07 밤) ────────────────────────────
#
# Zephyr Kconfig 에는 -O3 선택지가 없다 (SIZE/-Os · SPEED/-O2 · …).
# 업스트림 llama.cpp 는 Release 에서 -O3 를 쓴다. 전역 Kconfig 는 그대로
# 두고(이 앱은 -O2) **ggml·llama 소스와 main 에만** 뒤에 붙여 덮는다
# (gcc 는 마지막 -O 를 쓴다). 커널에는 주지 않는다.
#
# ⚠ include **전에** 세워야 한다 — llm_ggml.cmake 의 set(... CACHE ...) 는
#   FORCE 가 없어 이미 있는 값을 이기지 못한다.
# ⚠ 되돌리기는 이 줄을 지우는 것이다. 그러면 Kconfig 값(-O2)으로 돌아간다.
set(LLM_GGML_OPT_LEVEL "-O3" CACHE STRING "" FORCE)

include(${CMAKE_CURRENT_SOURCE_DIR}/../../cmake/llm_ggml.cmake)
include(${CMAKE_CURRENT_SOURCE_DIR}/../../cmake/llm_llama.cmake)
llm_add_ggml()
llm_add_llama(L6B)

target_sources(app PRIVATE
	src/main.cpp
	${CMAKE_CURRENT_SOURCE_DIR}/../llm_common/ggml_port.c)
target_include_directories(app PRIVATE src)
llm_ggml_flags(${CMAKE_CURRENT_SOURCE_DIR}/src/main.cpp)
```

## prj.conf
```kconfig
CONFIG_PRINTK=y
CONFIG_BOOT_BANNER=n
CONFIG_MAIN_STACK_SIZE=65536
CONFIG_MAX_XLAT_TABLES=24

CONFIG_CPP=y
CONFIG_STD_CPP17=y
CONFIG_GLIBCXX_LIBCPP=y
CONFIG_CPP_EXCEPTIONS=y
CONFIG_CPP_RTTI=y

CONFIG_POSIX_API=y
CONFIG_THREAD_STACK_INFO=y
CONFIG_DYNAMIC_THREAD=y
CONFIG_DYNAMIC_THREAD_ALLOC=y
CONFIG_DYNAMIC_THREAD_STACK_SIZE=32768

# ggml_init 이 mem_size(16 MiB)를 **정렬 할당 한 덩이**로 받는다. 아레나가
# 요청과 같으면 정렬 여유가 없어 실패한다(L4 에서 겪었다). 여러 배로 둔다.
CONFIG_COMMON_LIBC_MALLOC=y
# ⚠ L6a 는 **어휘**를 힙에 올린다 — 248,320 토큰. 토큰마다 std::string 과
#   unordered_map 노드 둘(id→token, token→id)이 생기므로 수십 MB 다.
#   창(sram0)이 128 MiB 라 넉넉히 준다. 실제 사용량은 앱이 찍는다.
# ⚠ **창이 256 MiB 가 된 뒤의 값** (2026-11-07, boards/.../radxa_zero_3e.dts).
#     창 262,144 − 정적 비-아레나 9,604 − 여유 6,780 = 245,760 KiB = **240 MiB**
#
#   왜 이만큼 필요한가 — 128 MiB 창에서 L6b 가 멈춘 이유를 측정했다:
#     모델·어휘 고정          62.5 MB
#     가장 큰 **연속** 블록   27.9 MB   ← 합계는 48.3 MB 였다
#     단편화로 잃은 몫        20.5 MB   ← 어휘가 248,320개 토큰을 작은
#                                        조각으로 할당하고 20 MB 를 돌려준다
#     그 27.9 MB 에서 output 0.95 + KV 3.00 + RS 19.27 를 먼저 떼면 4.7 MB
#     남고, 스케줄러 문맥 13.4 MB 가 들어가지 못했다.
#   즉 총량과 **연속성**이 둘 다 모자랐다. 창을 넓혀 둘 다 푼다.
CONFIG_COMMON_LIBC_MALLOC_ARENA_SIZE=251658240
CONFIG_HEAP_MEM_POOL_SIZE=4194304

# ⚠ 이것이 있어야 malloc_runtime_stats_get() 이 **링크된다**
#   (zephyr/lib/libc/common/source/stdlib/malloc.c:265-280 이 #ifdef 로 감싼다).
#   없으면 undefined reference 로 끝난다 — 겪었다.
#   west build 의 "RAM 79.48%" 는 아레나를 전부 예약으로 세어서 쓸모가 없다.
#   어휘가 실제로 얼마를 쓰는지 알아야 L6b 의 자리가 있는지 가릴 수 있다.
CONFIG_SYS_HEAP_RUNTIME_STATS=y

# ⚠ **로그를 동기(immediate)로 만든다 — 쓰는 주체를 하나로 유지한 채.**
#
# 보드 defconfig 에 CONFIG_LOG=y 가 있어(dwc3 드라이버용) printk 가 기본으로
# 로그 시스템을 거친다. 기본 조합이 이렇다:
#     CONFIG_LOG_MODE_DEFERRED=y
#     CONFIG_LOG_BUFFER_SIZE=1024              ← 1 KB
#     CONFIG_LOG_PROCESS_THREAD_SLEEP_MS=1000  ← 로그 스레드가 1초씩 잔다
#     CONFIG_MAIN_THREAD_PRIORITY=0            ← main 이 그 스레드를 선점한다
# 사다리 앱은 80자 수십 줄을 main 에서 쏟으므로 버퍼가 넘쳐 **앞부분이
# 버려진다**(2026-11-07 L5b 첫 실기 투입에서 꼬리만 남았다).
#
# ⚠ 처음에 `CONFIG_LOG_PRINTK=n` 으로 고치려 했다가 **보드가 멈췄다.**
#   그러면 UART2 에 쓰는 주체가 둘이 된다 — printk(main, 동기)와 로그
#   백엔드(로그 스레드). 같은 인터럽트 구동 UART 를 동시에 건드려 교착한
#   것으로 보인다(dwc3 로그 한 줄만 나오고 멈췄다).
#
# 그래서 LOG_PRINTK 는 기본(y) 그대로 두고 **모드만 동기로** 바꾼다.
# 버퍼도 스레드도 쓰지 않으므로 유실이 없고 쓰는 주체는 하나다.
#
# ⚠ moru 는 이 설정을 쓰면 안 된다 — 동기 출력이 줄당 ~9 ms 를 잡아먹어
#   USB 열거의 SET_ADDRESS 50 ms 예산을 넘긴다(docs/hardware-verified.md).
#   사다리 앱은 USB 를 열거하지 않으므로 무해하다.
CONFIG_LOG_MODE_IMMEDIATE=y

# ── uart2 인터럽트 폭주 ───────────────────────────────────────────────
#
# CONFIG_UART_INTERRUPT_DRIVEN=n 은 이제 **공용 파일**에 있다:
#     apps/llm_common/ladder.conf
# 근거와 측정값(토큰당 23,600 ms → 1,423 ms, 16.6배)도 그 파일에 있다.
# 여기 복사해 두지 않는다 — 복사하면 갈린다.
```

## src/main.cpp
```c
/*
 * L6c — 여러 토큰. KV 캐시와 DeltaNet 재귀 상태가 **토큰 사이로** 넘어가나.
 *
 * L6 의 셋째 칸. L6b 는 토큰 **하나**를 넣었으므로 상태가 넘어가는지는
 * 가리지 못했다. 상태가 안 넘어가면 **둘째 토큰부터** 틀린다.
 *
 * ── 왜 "토큰 열" 이 기준인가 ────────────────────────────────────────────
 *
 * 로짓 값은 1 ulp 교란에 4.3% 흔들린다(docs/l6b-sensitivity.md). 그런데
 * **탐욕 argmax 열은 16개까지 그 교란에 견딘다** — 호스트의 두 빌드
 * (`-ffp-contract=off` 와 `=fast`)가 16개 토큰을 똑같이 낸다:
 *
 *     , I am a student of the university of the north of the north of the
 *
 * 그래서 토큰 id 열은 **전부 일치를 요구**할 수 있다. 측정으로 정한 기준이다.
 *
 * ── 무엇을 가리나 ───────────────────────────────────────────────────────
 *
 *   [1] 블롭이 실제 모델인가
 *   [2] 모델 적재
 *   [3] 문맥 생성
 *   [4] 토큰 12개를 **이어서** 생성하고 매 단계 호스트와 대조
 *       · 토큰 id 가 어긋나면 그 자리에서 **멈춘다** — 그 뒤는 입력이
 *         달라져 비교가 무의미하다
 *       · 단계마다 시간을 잰다 (문맥이 길어지며 느려지는가)
 *   [5] 생성된 글 전체
 */
#include <zephyr/kernel.h>
#include <zephyr/devicetree.h>
#include <zephyr/sys/mem_stats.h>

#include "ggml.h"
#include "llama.h"

#include <cinttypes>
#include <cstdio>
#include <cstring>

#include "host_gen.inc"

extern "C" int malloc_runtime_stats_get(struct sys_memory_stats *stats);

#define BLOB_NODE DT_NODELABEL(model_blob)
#define BLOB_ADDR ((uintptr_t)DT_REG_ADDR(BLOB_NODE))
#define BLOB_SIZE ((size_t)DT_REG_SIZE(BLOB_NODE))
#define MODEL_BYTES 532517120u

static int fails;

static void heap(const char *when)
{
	struct sys_memory_stats s;
	if (malloc_runtime_stats_get(&s) != 0) {
		return;
	}
	printk("      힙[%s]: 쓴 %zu KiB · 최대 %zu KiB · 남은 %zu KiB\n",
	       when, s.allocated_bytes / 1024, s.max_allocated_bytes / 1024,
	       s.free_bytes / 1024);
}

#ifdef LLM_CLK1416
#include "clk1416.h"
#endif

#include <moru_led.h>

int main(void)
{
	printk("=== L6c: 여러 토큰 (KV 캐시 · DeltaNet 상태) ===\n");
#ifdef LLM_CLK1416
	/* L6d: 1416 MHz 로 올린다. 실패하면 1104 그대로 시험한다(이유를 찍는다). */
	printk("  [L6d] 1416 MHz 판: %s\n", clk1416_raise() == 0 ? "올렸다" : "**못 올렸다 — 1104 로 잰다**");
#endif
	printk("  창 0x%08" PRIxPTR " + %u MiB · 첫 토큰 %d · %d개 생성\n",
	       (uintptr_t)BLOB_ADDR, (unsigned)(BLOB_SIZE / (1024 * 1024)),
	       L6C_FIRST_TOKEN, L6C_N_GEN);
	printk("  기준: **토큰 id 열 전부 일치** (1 ulp 교란에도 16개까지 견딘다)\n");

	moru_led_set(MORU_LED_BLOB);	/* 블롭 점검·모델 적재·문맥 생성 */
	printk("  [1] 블롭 점검 ... ");
	{
		const uint8_t *p = (const uint8_t *)BLOB_ADDR;
		if (*(const uint32_t *)p != 0x46554747u) {
			printk("FAIL — 매직이 0x%08x 다\n", *(const uint32_t *)p);
			fails++;
			goto done;
		}
		const uint64_t nt = *(const uint64_t *)(p + 8);
		printk("OK — 'GGUF' v3, 텐서 %" PRIu64 "개\n", nt);
		if (nt < 16) {
			printk("      FAIL — 시험 GGUF 가 올라왔다\n");
			fails++;
			goto done;
		}
	}

	llama_backend_init();

	{
		printk("  [2] 모델 적재 ... ");
		FILE *f = fmemopen((void *)BLOB_ADDR, MODEL_BYTES, "rb");
		if (f == nullptr) {
			printk("FAIL — fmemopen\n");
			fails++;
			goto done;
		}
		llama_model_params mp = llama_model_default_params();
		mp.n_gpu_layers    = 0;
		mp.load_mode       = LLAMA_LOAD_MODE_MMAP;
		mp.check_tensors   = false;
		mp.use_extra_bufts = false;

		int64_t t0 = k_uptime_get();
		llama_model *model = llama_model_load_from_file_ptr(f, mp);
		if (model == nullptr) {
			printk("FAIL — nullptr\n");
			fails++;
			goto done;
		}
		printk("OK (%" PRId64 " ms)\n", k_uptime_get() - t0);
		heap("모델 적재 뒤");

		/* ⚠ 보드와 호스트가 **같은 설정**이어야 한다 (tools/l6c_host_gen.cpp) */
		printk("  [3] 문맥 생성 (n_ctx=256) ... ");
		llama_context_params cp = llama_context_default_params();
		cp.n_ctx           = 256;
		cp.n_batch         = 1;
		cp.n_ubatch        = 1;
		/* ── n_threads=4 (2026-11-07 밤) ────────────────────────────
		 * L8e 가 실기에서 네 코어를 올렸다. 여기서 ggml 이 실제로
		 * 그것을 쓰게 한다. ggml 은 워커 3개를 pthread 로 만든다.
		 *
		 * ⚠ **호스트 골든은 n_threads=1 로 뽑은 그대로 둔다.**
		 *   그러면 이 시험이 묻는 것이 분명해진다 —
		 *   "4스레드 보드가 1스레드 호스트와 **여전히** 같은 토큰을
		 *    내는가". 행렬곱은 보통 스레드가 행/덩이를 나눠 가져
		 *    누적 순서가 바뀌지 않으므로 비트 일치가 기대되지만,
		 *    **기대는 증거가 아니다.** 12/12 일치가 깨지면 그 자체가
		 *    정보이고, 어느 층에서 갈라지는지 L6b 로 내려가 본다.
		 */
		cp.n_threads       = 4;
		cp.n_threads_batch = 4;
		cp.flash_attn_type = LLAMA_FLASH_ATTN_TYPE_DISABLED;
		llama_context *ctx = llama_init_from_model(model, cp);
		if (ctx == nullptr) {
			printk("FAIL — nullptr\n");
			fails++;
			goto done;
		}
		printk("OK\n");
		heap("문맥 생성 뒤");

		const llama_vocab *vocab = llama_model_get_vocab(model);
		const int n_vocab = llama_vocab_n_tokens(vocab);

		moru_led_set(MORU_LED_INFER);
		printk("  [4] 토큰 %d개 이어서 생성 (실기는 토큰당 20초대)\n", L6C_N_GEN);
		llama_token t = L6C_FIRST_TOKEN;
		int matched = 0;
		char text[256] = {0};
		size_t tlen = 0;

		for (int step = 0; step < L6C_N_GEN; step++) {
			llama_batch b = llama_batch_get_one(&t, 1);
			int64_t s0 = k_uptime_get();
			const int rc = llama_decode(ctx, b);
			const int64_t dt = k_uptime_get() - s0;
			if (rc != 0) {
				printk("      %2d단계 FAIL — llama_decode 가 %d\n",
				       step + 1, rc);
				fails++;
				break;
			}

			const float *lg = llama_get_logits_ith(ctx, 0);
			if (lg == nullptr) {
				printk("      %2d단계 FAIL — 로짓을 못 읽었다\n", step + 1);
				fails++;
				break;
			}
			int best = 0;
			for (int i = 1; i < n_vocab; i++) {
				if (lg[i] > lg[best]) {
					best = i;
				}
			}

			/* 조각을 모아 글을 만든다 — 숫자만 보면 맞는지 감이 안 온다 */
			char piece[32] = {0};
			const int pn = llama_token_to_piece(vocab, best, piece,
							    sizeof piece - 1, 0, true);
			if (pn > 0 && tlen + (size_t)pn < sizeof text - 1) {
				memcpy(text + tlen, piece, (size_t)pn);
				tlen += (size_t)pn;
			}

			const int want = l6c_host_gen[step].id;
			if (best == want) {
				printk("      %2d단계 OK   id %6d 로짓 %9.6f  (호스트 %9.6f '%s')  %" PRId64 " ms\n",
				       step + 1, best, (double)lg[best],
				       (double)l6c_host_gen[step].logit,
				       l6c_host_gen[step].piece, dt);
				matched++;
			} else {
				printk("      %2d단계 FAIL id %6d (호스트 %6d '%s')  %" PRId64 " ms\n",
				       step + 1, best, want, l6c_host_gen[step].piece, dt);
				fails++;
				/*
				 * ⚠ **여기서 멈춘다.** 토큰이 갈리면 다음 단계의
				 *   입력이 달라져 비교가 무의미해진다. 계속 돌리면
				 *   "여러 단계가 실패" 로 보여 **갈린 지점을 가린다**.
				 */
				printk("      → 입력이 갈렸으므로 멈춘다 (뒤는 비교가 무의미하다)\n");
				break;
			}
			t = best;
		}

		printk("  [5] 결과\n");
		printk("      생성: \"%s\"\n", text);
		if (matched == L6C_N_GEN) {
			printk("      OK — %d/%d 토큰 일치\n", matched, L6C_N_GEN);
			printk("      → KV 캐시와 DeltaNet 상태가 토큰 사이로 제대로 넘어간다\n");
		} else {
			printk("      %d/%d 토큰 일치\n", matched, L6C_N_GEN);
			if (matched >= 1) {
				printk("      ⚠ 첫 토큰은 맞고 %d번째에서 갈렸다 — **상태 전달**을 의심한다\n",
				       matched + 1);
				printk("        (L6b 가 첫 토큰을 이미 가렸으므로 순전파 자체는 아니다)\n");
			}
		}
		heap("생성 뒤");
	}

done:
	if (fails == 0) {
		printk("=== L6c PASS (실패 0) ===\n");
		moru_led_set(MORU_LED_READY);
	} else {
		printk("=== L6c FAIL (실패 %d) ===\n", fails);
		moru_led_set(MORU_LED_FAIL);
	}
#ifdef LLM_CLK1416
	clk1416_report();
	clk1416_back_to_1104("시험 끝");
#endif
	/* ⚠ main 에서 돌아오지 않는다 — 이유는 apps/llm_l6b/src/main.cpp 참고
	 *   (정적 소멸자가 NULL 로 뛴다). */
	printk("    (시험 끝 — 여기서 멈춘다. 전원을 다시 주면 moru 로 돌아온다)\n");
	k_sleep(K_FOREVER);
	return 0;
}
```
