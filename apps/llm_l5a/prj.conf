## CMakeLists.txt
```
cmake_minimum_required(VERSION 3.20.0)
# 모델 가중치 창은 **공용 파일 하나**를 쓴다 — 앱마다 복사해 두면 주소를
# 고칠 때 갈린다 (실제로 실기 DRAM 끝을 넘는 주소가 여섯 군데에 퍼져 있었다).
set(EXTRA_DTC_OVERLAY_FILE
    "${CMAKE_CURRENT_SOURCE_DIR}/../llm_common/model_blob.overlay")

# 사다리 공용 Kconfig 조각 — uart2 인터럽트 폭주를 끈다 (사이클의 77%).
# 근거와 측정값은 그 파일에 있다. ⚠ prj.conf **뒤에** 병합되므로 그 파일이 이긴다.
set(EXTRA_CONF_FILE
    "${CMAKE_CURRENT_SOURCE_DIR}/../llm_common/ladder.conf")

find_package(Zephyr REQUIRED HINTS $ENV{ZEPHYR_BASE})
project(llm_l5a)

include(${CMAKE_CURRENT_SOURCE_DIR}/../../cmake/llm_ggml.cmake)
llm_add_ggml()

target_sources(app PRIVATE
	src/main.c
	src/l5_graph.c
	${CMAKE_CURRENT_SOURCE_DIR}/../llm_common/ggml_port.c)
target_include_directories(app PRIVATE src)

# 그래프 파일도 ggml 과 **같은 -mcpu** 로 짓는다. 여기서 기능 매크로를 읽어
# 호스트와 비교하므로, 이 파일만 플래그가 다르면 비교가 거짓말이 된다.
llm_ggml_flags(${CMAKE_CURRENT_SOURCE_DIR}/src/l5_graph.c)
```

## prj.conf
```kconfig
CONFIG_PRINTK=y
CONFIG_BOOT_BANNER=n
CONFIG_MAIN_STACK_SIZE=32768
CONFIG_MAX_XLAT_TABLES=24

CONFIG_CPP=y
CONFIG_STD_CPP17=y
CONFIG_GLIBCXX_LIBCPP=y
CONFIG_CPP_EXCEPTIONS=y
CONFIG_CPP_RTTI=y

CONFIG_POSIX_API=y
CONFIG_THREAD_STACK_INFO=y
CONFIG_DYNAMIC_THREAD=y
CONFIG_DYNAMIC_THREAD_ALLOC=y
CONFIG_DYNAMIC_THREAD_STACK_SIZE=32768

# ggml_init 이 mem_size(48 MiB)를 **정렬 할당 한 덩이**로 받는다. 아레나가
# 요청과 같으면 정렬 여유가 없어 실패한다(L4 에서 겪었다). 여러 배로 둔다.
# 실제 상태 텐서가 [128,128,16] = 1 MiB 이고 그래프가 그 크기를 여러 개 만든다.
CONFIG_COMMON_LIBC_MALLOC=y
CONFIG_COMMON_LIBC_MALLOC_ARENA_SIZE=100663296
CONFIG_HEAP_MEM_POOL_SIZE=1048576

# ⚠ **로그를 동기(immediate)로 만든다 — 쓰는 주체를 하나로 유지한 채.**
#
# 보드 defconfig 에 CONFIG_LOG=y 가 있어(dwc3 드라이버용) printk 가 기본으로
# 로그 시스템을 거친다. 기본 조합이 이렇다:
#     CONFIG_LOG_MODE_DEFERRED=y
#     CONFIG_LOG_BUFFER_SIZE=1024              ← 1 KB
#     CONFIG_LOG_PROCESS_THREAD_SLEEP_MS=1000  ← 로그 스레드가 1초씩 잔다
#     CONFIG_MAIN_THREAD_PRIORITY=0            ← main 이 그 스레드를 선점한다
# 사다리 앱은 80자 수십 줄을 main 에서 쏟으므로 버퍼가 넘쳐 **앞부분이
# 버려진다**(2026-11-07 L5b 첫 실기 투입에서 꼬리만 남았다).
#
# ⚠ 처음에 `CONFIG_LOG_PRINTK=n` 으로 고치려 했다가 **보드가 멈췄다.**
#   그러면 UART2 에 쓰는 주체가 둘이 된다 — printk(main, 동기)와 로그
#   백엔드(로그 스레드). 같은 인터럽트 구동 UART 를 동시에 건드려 교착한
#   것으로 보인다(dwc3 로그 한 줄만 나오고 멈췄다).
#
# 그래서 LOG_PRINTK 는 기본(y) 그대로 두고 **모드만 동기로** 바꾼다.
# 버퍼도 스레드도 쓰지 않으므로 유실이 없고 쓰는 주체는 하나다.
#
# ⚠ moru 는 이 설정을 쓰면 안 된다 — 동기 출력이 줄당 ~9 ms 를 잡아먹어
#   USB 열거의 SET_ADDRESS 50 ms 예산을 넘긴다(docs/hardware-verified.md).
#   사다리 앱은 USB 를 열거하지 않으므로 무해하다.
CONFIG_LOG_MODE_IMMEDIATE=y
```

## src/main.c
```c
/*
 * L5a — Gated DeltaNet 층 관문 (합성 가중치).
 *
 * 사다리(docs/llm-hub-test-plan.md)의 L5a 하위 다섯 개를 한 번에 본다.
 * 치수는 Qwen3.5-0.8B 의 실측값이다.
 *
 * ⚠ 이 칸이 가리는 것은 **"ggml 이 이 층을 호스트와 똑같이 계산하는가"** 다.
 *   "llama.cpp 의 qwen35 경로가 옳은가" 는 **아니다** — 그것은 실제 가중치와
 *   호스트 중간 텐서가 필요하다. 혼동하지 않도록 출력에도 적는다.
 */
#include <zephyr/kernel.h>
#include <string.h>
#include <stdint.h>
#include <inttypes.h>

#include "l5_graph.h"
#include "l5_golden.h"

/* 계획서의 L5 허용 오차 1e-4 = 100,000 ppb */
#define TOL_PPB		100000ull

static uint32_t bits(float f) { uint32_t b; memcpy(&b, &f, 4); return b; }
static float ab(float f) { return f < 0 ? -f : f; }

static uint64_t rel_ppb(float got, float want)
{
	float d = ab(got - want);
	float m = ab(want);

	/*
	 * ⚠ NaN·Inf 를 먼저 걸러낸다. 그러지 않으면 **NaN 이 OK 로 통과한다** —
	 *   NaN 비교는 `d == 0` 도 `r > 1e18` 도 거짓이고 `(uint64_t)NaN` 은 0 이라
	 *   worst 가 0 으로 남아 "최대 0 ppb" 로 찍힌다. 커널이 NaN 을 내거나
	 *   Inf-Inf 가 생기는 회귀가 조용히 통과한다.
	 */
	if (got != got || want != want) { return UINT64_MAX; }	/* NaN */
	if (d > 1e30f) { return UINT64_MAX; }			/* Inf 또는 폭발 */
	if (d == 0.0f) { return 0; }
	if (m < 1e-30f) { m = 1e-30f; }
	float r = d / m * 1e9f;

	if (r > 1e18f) { return (uint64_t)1e18; }
	return (uint64_t)r;
}

static int check(const char *name, const float *got, const uint32_t *golden, int n)
{
	int nbit = 0;
	uint64_t worst = 0;
	int wi = 0;

	/*
	 * 비트가 같으면 비교를 건너뛰므로, **양쪽이 같은 NaN 을 내면 통과한다.**
	 * 그래서 얻은 값 자체에 비유한값이 있는지 골든과 무관하게 먼저 본다.
	 * 층 출력에 NaN·Inf 가 나오는 것은 어떤 경우에도 실패다.
	 */
	int nonfinite = 0;

	for (int i = 0; i < n; i++) {
		if (got[i] != got[i] || ab(got[i]) > 1e30f) { nonfinite++; }
	}
	if (nonfinite) {
		printk("FAIL — 얻은 값에 비유한값(NaN/Inf) %d개\n", nonfinite);
		return 1;
	}
	printk("  %-28s %5d개 ... ", name, n);
	for (int i = 0; i < n; i++) {
		if (bits(got[i]) != golden[i]) {
			float want;

			memcpy(&want, &golden[i], 4);
			nbit++;
			uint64_t r = rel_ppb(got[i], want);

			if (r > worst) { worst = r; wi = i; }
		}
	}
	if (nbit == 0) {
		printk("OK — **비트 일치**\n");
		return 0;
	}
	if (worst <= TOL_PPB) {
		printk("OK — 비트 %d/%d 다름, 최대 %" PRIu64 " ppb\n", nbit, n, worst);
		/*
		 * 통과했어도 최대 오차가 눈에 띄면 **값을 찍는다.**
		 * 상대오차가 큰데 결과가 0 근처면 그것은 상쇄(cancellation)이고
		 * 구현 오류가 아니다. 숫자를 보지 않으면 그 구분을 할 수 없다.
		 */
		if (worst > 1000ull) {
			float want;

			memcpy(&want, &golden[wi], 4);
			printk("      └ 최대 오차 지점 [%d]: 얻음 0x%08x  골든 0x%08x\n",
			       wi, bits(got[wi]), golden[wi]);
			printk("        크기 |골든| 이 다른 원소 중앙값의 몇 배인지 보라 — "
			       "0 근처면 상쇄다\n");
			/* 절대오차와 그 지점의 크기를 정수로 찍는다 (printk 에 float 금지) */
			printk("        |골든| = %u e-9 · |차| = %u e-9\n",
			       (unsigned)(ab(want) * 1e9f), (unsigned)(ab(got[wi] - want) * 1e9f));
		}
		return 0;
	}
	printk("FAIL — 최대 %" PRIu64 " ppb (> %" PRIu64 ") at [%d]\n", worst, TOL_PPB, wi);
	printk("      %*s얻음 0x%08x  골든 0x%08x\n", 6, "", bits(got[wi]), golden[wi]);
	return 1;
}

static int check_ne(const char *name, const int64_t *got, const int64_t *golden)
{
	printk("  %-28s ", name);
	printk("[%" PRId64 ",%" PRId64 ",%" PRId64 ",%" PRId64 "] ... ",
	       got[0], got[1], got[2], got[3]);
	for (int i = 0; i < 4; i++) {
		if (got[i] != golden[i]) {
			printk("FAIL — 골든 [%" PRId64 ",%" PRId64 ",%" PRId64 ",%" PRId64 "]\n",
			       golden[0], golden[1], golden[2], golden[3]);
			return 1;
		}
	}
	printk("OK\n");
	return 0;
}

/*
 * 전체 텐서 요약 비교 — **표본 밖 영역의 상한**이다.
 *
 * CRC32 는 차이를 감지하지만 허용 오차가 없어 libm 1 ulp 로도 달라진다.
 * 그래서 CRC 불일치는 실패로 셀 수 없고, 결과적으로 표본에 안 걸리는 영역이
 * 틀려도 통과한다 — 순환 상태는 262,144개 중 1,024개(0.4%)만 표본이다.
 * 합과 절댓값 합을 허용 오차로 비교해 그 구멍을 좁힌다.
 */
static int check_full(const char *name, struct llm_fullsum got,
		      uint32_t g_sum_bits, uint32_t g_abs_bits)
{
	float gs, ga;

	memcpy(&gs, &g_sum_bits, 4);
	memcpy(&ga, &g_abs_bits, 4);

	uint64_t rs = rel_ppb(got.sum, gs);
	uint64_t ra = rel_ppb(got.abssum, ga);

	printk("  %-28s 합 %" PRIu64 " ppb · |합| %" PRIu64 " ppb ... ", name, rs, ra);
	/* 합은 상쇄가 있을 수 있으므로 |합| 을 주 판정으로, 합은 참고로 둔다 */
	if (ra <= TOL_PPB) {
		printk("OK\n");
		return 0;
	}
	printk("FAIL — |합| 이 허용 오차를 넘었다 (표본 밖이 틀렸다는 뜻이다)\n");
	return 1;
}

static struct l5_results res;

int main(void)
{
	int fail = 0;

	printk("=== L5a: Gated DeltaNet 층 관문 (합성 가중치) ===\n");
	printk("  치수 실측: S=%d H=%d d_conv=%d conv_dim=%d n_embd=%d\n",
	       L5_S, L5_H, L5_D_CONV, L5_CONV_DIM, L5_N_EMBD);

	int rc = l5_run(&res);

	if (rc != 0) {
		printk("  l5_run 실패: %d\n", rc);
		printk("=== L5a FAIL (실패 1) ===\n");
		return 0;
	}

	printk("  [0] 기능 집합  Zephyr dotprod=%d i8mm=%d / 호스트 %d %d ... ",
	       res.dotprod, res.i8mm, L5_HOST_DOTPROD, L5_HOST_I8MM);
	if (res.dotprod == L5_HOST_DOTPROD && res.i8mm == L5_HOST_I8MM) {
		printk("OK\n");
	} else {
		printk("불일치 — 아래 비교는 다른 커널 경로끼리다\n");
		fail++;
	}

	/* L5a-5 축 배치를 **먼저** 본다. 형태가 어긋나면 값 비교가 무의미하다. */
	printk("  ── L5a-5 축 배치\n");
	fail += check_ne("[1] q permute", res.ne_q_perm, l5_g_ne_q_perm);
	fail += check_ne("[2] sum_rows(s*k)", res.ne_sk, l5_g_ne_sk);
	fail += check_ne("[3] k*d_t", res.ne_kd, l5_g_ne_kd);
	fail += check_ne("[4] 출력 o", res.ne_o, l5_g_ne_o);

	printk("  ── L5a-1 인과 컨볼루션\n");
	fail += check("[5] ssm_conv (보폭 표본)", res.conv, l5_g_conv, L5_CONV_SAMP);
	printk("  %-28s 0x%08x ... ", "[6] ssm_conv 전체 CRC32", res.conv_crc);
	if (res.conv_crc == L5_G_CONV_CRC) {
		printk("OK — 전체가 비트 일치\n");
	} else {
		printk("다름 (골든 0x%08x) — 아래 전체 요약으로 상한을 본다\n", L5_G_CONV_CRC);
	}
	fail += check_full("[6a] ssm_conv 전체 요약", res.conv_full,
			   L5_G_CONV_SUM, L5_G_CONV_ABS);

	printk("  ── L5a-2 감쇠·게이트 계수\n");
	fail += check("[7] beta = sigmoid(..)", res.beta, l5_g_beta, L5_H);
	fail += check("[8] softplus(alpha+dt)", res.a_softplus, l5_g_a_softplus, L5_H);
	fail += check("[9] gate = sp * ssm_a", res.gate, l5_g_gate, L5_H);

	printk("  ── L5a-3 델타 규칙 순환 1스텝\n");
	fail += check("[10] 출력 o", res.o, l5_g_o, L5_O_N);
	fail += check("[11] 상태 (보폭 표본)", res.state, l5_g_state, L5_STATE_SAMP);
	printk("  %-28s 0x%08x ... ", "[12] 상태 전체 CRC32", res.state_crc);
	if (res.state_crc == L5_G_STATE_CRC) {
		printk("OK — 262,144개 전부 비트 일치\n");
	} else {
		printk("다름 (골든 0x%08x) — 아래 전체 요약으로 상한을 본다\n", L5_G_STATE_CRC);
	}
	fail += check_full("[12a] 상태 전체 요약", res.state_full,
			   L5_G_STATE_SUM, L5_G_STATE_ABS);

	printk("  ── L5a-4 ssm_norm + silu 게이트\n");
	fail += check("[13] normg", res.normg, l5_g_normg, L5_O_N);

	if (fail == 0) {
		printk("=== L5a PASS (실패 0) ===\n");
		printk("  ⚠ 합성 가중치다. 'llama.cpp 의 qwen35 경로가 옳은가' 는 아직 못 가렸다.\n");
	} else {
		printk("=== L5a FAIL (실패 %d) ===\n", fail);
	}
	return 0;
}
```

## src/l5_graph.c
```c
/*
 * L5a 그래프 — 호스트와 Zephyr 가 공유한다. l5_graph.h 참고.
 *
 * 무엇을 하는가: Qwen3.5 의 **Gated DeltaNet 층**을 구성하는 네 조각을
 * llama.cpp 의 연산 순서 **그대로** 재현한다. 가중치만 합성이다.
 *
 *   L5a-1  ggml_ssm_conv                      — 인과 컨볼루션
 *   L5a-2  beta/alpha/dt/A 로 만드는 계수      — src/models/qwen35.cpp:357-372
 *   L5a-3  델타 규칙 순환 1스텝                 — src/models/delta-net-base.cpp:286-368
 *   L5a-4  ssm_norm + silu 게이트              — src/models/qwen35.cpp:252-261
 *   L5a-5  축 배치                            — 중간 텐서의 ne[] 를 기록
 *
 * ⚠ 합성 가중치다. 이 칸이 가리는 것은 "ggml 이 이 층을 호스트와 똑같이
 *   계산하는가" 이고, "llama.cpp 의 qwen35 경로가 옳은가" 는 **아니다**.
 *   후자는 실제 가중치 + 호스트 중간 텐서가 필요하다.
 */
#include "l5_graph.h"

#include <string.h>
#include <stdlib.h>
#include <math.h>

#include "ggml.h"
#include "ggml-cpu.h"

/* 입력·가중치는 전부 **첨자의 함수**다. 난수는 양쪽에서 같음을 보장할 수 없고
 * 0 으로 채우면 계산이 틀려도 통과한다. */
static float fn(int i, int salt)
{
	return (float)(((i * 7919 + salt * 104729) % 251) - 125) * 0.008f;
}

static void fill(struct ggml_tensor *t, int salt)
{
	float *p = (float *)t->data;
	int64_t n = ggml_nelements(t);

	for (int64_t i = 0; i < n; i++) {
		p[i] = fn((int)i, salt);
	}
}

static void save_ne(int64_t *dst, const struct ggml_tensor *t)
{
	for (int i = 0; i < 4; i++) {
		dst[i] = t->ne[i];
	}
}

/* crc32(IEEE) — Zephyr 의 crc32_ieee 와 zlib.crc32 와 같다.
 * 호스트에서도 같은 코드를 쓰려고 여기 둔다(libz 의존을 피한다). */
static uint32_t crc32_of(const void *data, size_t len)
{
	static const uint32_t tab[16] = {
		0x00000000u, 0x1db71064u, 0x3b6e20c8u, 0x26d930acu,
		0x76dc4190u, 0x6b6b51f4u, 0x4db26158u, 0x5005713cu,
		0xedb88320u, 0xf00f9344u, 0xd6d6a3e8u, 0xcb61b38cu,
		0x9b64c2b0u, 0x86d3d2d4u, 0xa00ae278u, 0xbdbdf21cu,
	};
	const uint8_t *p = (const uint8_t *)data;
	uint32_t crc = ~0u;

	for (size_t i = 0; i < len; i++) {
		crc = (crc >> 4) ^ tab[(crc ^ p[i]) & 0x0f];
		crc = (crc >> 4) ^ tab[(crc ^ ((uint32_t)p[i] >> 4)) & 0x0f];
	}
	return ~crc;
}

int l5_run(struct l5_results *out)
{
	memset(out, 0, sizeof(*out));
#ifdef __ARM_FEATURE_DOTPROD
	out->dotprod = 1;
#endif
#ifdef __ARM_FEATURE_MATMUL_INT8
	out->i8mm = 1;
#endif

	struct ggml_init_params ip = {
		.mem_size   = 48u * 1024 * 1024,
		.mem_buffer = NULL,
		.no_alloc   = false,
	};
	struct ggml_context *ctx = ggml_init(ip);

	if (!ctx) {
		return -1;
	}
	struct ggml_cgraph *gf = ggml_new_graph(ctx);

	/* ─────────────────────────────────────────────── L5a-1 인과 컨볼루션
	 * ggml_ssm_conv 규약 (ggml.c:5774-5791):
	 *   c  = [d_conv, d_inner]            커널
	 *   sx = [d_conv-1+n_t, d_inner, n_s] 입력 (앞쪽이 과거 상태)
	 *   결과 = [d_inner, n_t, n_s]
	 * 토큰 1개(n_t=1)이므로 sx 의 첫 축이 d_conv 다.
	 */
	struct ggml_tensor *conv_w = ggml_new_tensor_2d(ctx, GGML_TYPE_F32,
							L5_D_CONV, L5_CONV_DIM);
	struct ggml_tensor *conv_x = ggml_new_tensor_3d(ctx, GGML_TYPE_F32,
							L5_D_CONV, L5_CONV_DIM, 1);
	fill(conv_w, 1);
	fill(conv_x, 2);
	struct ggml_tensor *conv_o = ggml_ssm_conv(ctx, conv_x, conv_w);

	/* ──────────────────────────────────── L5a-2 감쇠·게이트 계수
	 * qwen35.cpp:357-372 그대로:
	 *   beta  = sigmoid(ssm_beta @ x)
	 *   alpha = ssm_alpha @ x
	 *   gate  = softplus(alpha + ssm_dt) * ssm_a
	 *
	 * ⚠ 공개된 변환 함정이 **ssm_a** 다. 텐서 이름이 SSM_A_NOSCAN 이고
	 *   파일에는 **이미 -exp(A_log) 로 변환된 값**이 들어 있다(qwen35.cpp:372
	 *   의 주석 "-A_log.exp() * softplus"). 즉 **항상 음수**다.
	 *   여기서 A_log 를 다시 exp 하면 틀리고, 양수를 넣으면 뒤의 exp(gate)
	 *   가 발산한다. 그래서 합성값도 음수로 둔다.
	 */
	struct ggml_tensor *x = ggml_new_tensor_2d(ctx, GGML_TYPE_F32, L5_N_EMBD, 1);
	struct ggml_tensor *w_beta = ggml_new_tensor_2d(ctx, GGML_TYPE_F32, L5_N_EMBD, L5_H);
	struct ggml_tensor *w_alpha = ggml_new_tensor_2d(ctx, GGML_TYPE_F32, L5_N_EMBD, L5_H);
	struct ggml_tensor *ssm_dt = ggml_new_tensor_1d(ctx, GGML_TYPE_F32, L5_H);
	struct ggml_tensor *ssm_a = ggml_new_tensor_1d(ctx, GGML_TYPE_F32, L5_H);

	fill(x, 3);
	fill(w_beta, 4);
	fill(w_alpha, 5);
	fill(ssm_dt, 6);
	for (int i = 0; i < L5_H; i++) {
		((float *)ssm_a->data)[i] = -(0.25f + 0.02f * (float)i);	/* 항상 음수 */
	}

	struct ggml_tensor *beta = ggml_sigmoid(ctx, ggml_mul_mat(ctx, w_beta, x));
	struct ggml_tensor *alpha = ggml_mul_mat(ctx, w_alpha, x);
	struct ggml_tensor *a_sp = ggml_softplus(ctx, ggml_add(ctx, alpha, ssm_dt));
	struct ggml_tensor *gate = ggml_mul(ctx, a_sp, ssm_a);

	/* ───────────────────────── L5a-3 델타 규칙 순환 1스텝
	 * delta-net-base.cpp:286-368 의 연산 순서를 그대로 옮긴다.
	 * 한 줄도 바꾸지 않는다 — 바꾸면 무엇을 시험하는지 알 수 없게 된다.
	 */
	struct ggml_tensor *q = ggml_new_tensor_4d(ctx, GGML_TYPE_F32, L5_S, L5_H, 1, 1);
	struct ggml_tensor *k = ggml_new_tensor_4d(ctx, GGML_TYPE_F32, L5_S, L5_H, 1, 1);
	struct ggml_tensor *v = ggml_new_tensor_4d(ctx, GGML_TYPE_F32, L5_S, L5_H, 1, 1);
	struct ggml_tensor *s = ggml_new_tensor_4d(ctx, GGML_TYPE_F32, L5_S, L5_S, L5_H, 1);

	fill(q, 7);
	fill(k, 8);
	fill(v, 9);
	fill(s, 10);

	/* g, b 는 [1, H, n_tokens, n_seqs] 로 들어간다 (GDA: g->ne[0]==1) */
	struct ggml_tensor *g4 = ggml_reshape_4d(ctx, gate, 1, L5_H, 1, 1);
	struct ggml_tensor *b4 = ggml_reshape_4d(ctx, beta, 1, L5_H, 1, 1);

	const float scale = 1.0f / sqrtf((float)L5_S);
	struct ggml_tensor *qs = ggml_scale(ctx, q, scale);

	struct ggml_tensor *qp = ggml_permute(ctx, qs, 0, 2, 1, 3);
	struct ggml_tensor *kp = ggml_permute(ctx, k, 0, 2, 1, 3);
	struct ggml_tensor *vp = ggml_permute(ctx, v, 0, 2, 1, 3);

	struct ggml_tensor *gg = ggml_reshape_4d(ctx, g4, 1, g4->ne[0], L5_H, 1);
	struct ggml_tensor *bb = ggml_reshape_4d(ctx, b4, 1, 1, L5_H, 1);

	gg = ggml_exp(ctx, gg);
	struct ggml_tensor *s1 = ggml_mul(ctx, s, gg);

	struct ggml_tensor *sk = ggml_sum_rows(ctx, ggml_mul(ctx, s1, kp));
	struct ggml_tensor *d = ggml_mul(ctx, ggml_sub(ctx, vp, ggml_transpose(ctx, sk)), bb);
	struct ggml_tensor *d_t = ggml_transpose(ctx, d);
	struct ggml_tensor *kr = ggml_repeat(ctx, kp, s1);
	struct ggml_tensor *kd = ggml_mul(ctx, kr, d_t);
	struct ggml_tensor *s2 = ggml_add(ctx, s1, kd);
	struct ggml_tensor *o = ggml_sum_rows(ctx, ggml_mul(ctx, s2, qp));

	o = ggml_permute(ctx, o, 2, 0, 1, 3);
	o = ggml_cont(ctx, o);		/* 비교하려면 연속이어야 한다 */

	save_ne(out->ne_q_perm, qp);
	save_ne(out->ne_sk, sk);
	save_ne(out->ne_kd, kd);
	save_ne(out->ne_o, o);

	/* ───────────────────── L5a-4 ssm_norm + silu 게이트
	 * qwen35.cpp:252-261 — build_norm(RMS) 뒤에 **silu** 로 곱한다.
	 * ⚠ sigmoid 가 아니다. 공개된 함정에 RMSNorm 이 들어 있는 이유가
	 *   여기다 — 가중치 곱과 게이트 곱의 순서·함수를 바꾸면 조용히 틀린다.
	 */
	struct ggml_tensor *norm_w = ggml_new_tensor_1d(ctx, GGML_TYPE_F32, L5_S);
	struct ggml_tensor *z = ggml_new_tensor_2d(ctx, GGML_TYPE_F32, L5_S, L5_H);

	fill(norm_w, 11);
	fill(z, 12);
	struct ggml_tensor *o2 = ggml_reshape_2d(ctx, o, L5_S, L5_H);
	struct ggml_tensor *nz = ggml_mul(ctx, ggml_rms_norm(ctx, o2, 1e-6f), norm_w);
	struct ggml_tensor *normg = ggml_mul(ctx, nz, ggml_silu(ctx, z));

	/* ── 계산. 스레드 1개 — 누산 순서를 고정한다. */
	ggml_build_forward_expand(gf, conv_o);
	ggml_build_forward_expand(gf, beta);
	ggml_build_forward_expand(gf, a_sp);
	ggml_build_forward_expand(gf, gate);
	ggml_build_forward_expand(gf, o);
	ggml_build_forward_expand(gf, s2);
	ggml_build_forward_expand(gf, normg);

	enum ggml_status st = ggml_graph_compute_with_ctx(ctx, gf, 1);

	if (st != GGML_STATUS_SUCCESS) {
		ggml_free(ctx);
		return -2 - (int)st;
	}

	const float *cp = (const float *)conv_o->data;

	for (int i = 0; i < L5_CONV_SAMP; i++) {
		out->conv[i] = cp[(size_t)i * L5_CONV_STRIDE];
	}
	out->conv_crc = crc32_of(cp, (size_t)L5_CONV_DIM * sizeof(float));
	out->conv_full = llm_fullsum_of(cp, L5_CONV_DIM);

	memcpy(out->beta, beta->data, sizeof(out->beta));
	memcpy(out->a_softplus, a_sp->data, sizeof(out->a_softplus));
	memcpy(out->gate, gate->data, sizeof(out->gate));
	memcpy(out->o, o->data, sizeof(out->o));
	memcpy(out->normg, normg->data, sizeof(out->normg));

	const float *sp = (const float *)s2->data;

	for (int i = 0; i < L5_STATE_SAMP; i++) {
		out->state[i] = sp[(size_t)i * L5_STATE_STRIDE];
	}
	out->state_crc = crc32_of(sp, (size_t)L5_STATE_N * sizeof(float));
	out->state_full = llm_fullsum_of(sp, L5_STATE_N);

	ggml_free(ctx);
	return 0;
}
```

## src/l5_graph.h
```c
/*
 * L5a 그래프 — **호스트와 Zephyr 가 이 파일을 공유한다.**
 *
 * 치수는 Qwen3.5-0.8B 의 **실측값**이다 (models/ 의 GGUF 를 gguf_dump 로 읽음):
 *   ssm.state_size 128 · ssm.group_count 16 · ssm.time_step_rank 16
 *   ssm.conv_kernel 4 · embedding_length 1024
 *   head_k_dim = head_v_dim = 128 · n_k_heads = n_v_heads = 16
 *   key_dim = value_dim = 128*16 = 2048 · conv_dim = 2048*2 + 2048 = 6144
 */
#ifndef L5_GRAPH_H
#define L5_GRAPH_H

#include <stdint.h>
#include "llm_fullsum.h"

#define L5_S		128	/* ssm.state_size — head_k_dim = head_v_dim */
#define L5_H		16	/* n_k_heads == n_v_heads */
#define L5_D_CONV	4	/* ssm.conv_kernel */
#define L5_CONV_DIM	6144	/* key_dim*2 + value_dim */
#define L5_N_EMBD	1024

/* 골든 헤더가 너무 커지지 않게 큰 출력은 **보폭 표본**으로 비교한다.
 * 전체는 CRC32 로 한 번 더 본다 — 비트 일치면 CRC 가 같다. */
#define L5_CONV_STRIDE	6
#define L5_CONV_SAMP	(L5_CONV_DIM / L5_CONV_STRIDE)		/* 1024 */
#define L5_O_N		(L5_S * L5_H)				/* 2048 */
#define L5_STATE_N	(L5_S * L5_S * L5_H)			/* 262144 */
#define L5_STATE_STRIDE	256
#define L5_STATE_SAMP	(L5_STATE_N / L5_STATE_STRIDE)		/* 1024 */

struct l5_results {
	/* L5a-1 인과 컨볼루션 */
	float    conv[L5_CONV_SAMP];
	uint32_t conv_crc;
	struct llm_fullsum conv_full;	/* 표본 밖 영역의 상한 */
	/* L5a-2 감쇠·게이트 계수 */
	float    beta[L5_H];		/* sigmoid(ssm_beta @ x) */
	float    a_softplus[L5_H];	/* softplus(ssm_alpha @ x + ssm_dt) */
	float    gate[L5_H];		/* a_softplus * ssm_a   (ssm_a = -exp(A_log)) */
	/* L5a-3 델타 규칙 순환 1스텝 */
	float    o[L5_O_N];
	float    state[L5_STATE_SAMP];
	uint32_t state_crc;
	struct llm_fullsum state_full;	/* 262,144개 중 0.4%만 표본이다 — 상한이 필요하다 */
	/* L5a-4 ssm_norm + 게이트 */
	float    normg[L5_O_N];
	/* L5a-5 축 배치 — 중간 텐서의 ne[] 를 그대로 기록한다 */
	int64_t  ne_q_perm[4];
	int64_t  ne_sk[4];
	int64_t  ne_kd[4];
	int64_t  ne_o[4];
	/* 커널 기능 집합 */
	int      dotprod;
	int      i8mm;
};

/* 0 = 성공. 실패하면 음수. */
int l5_run(struct l5_results *out);

#endif /* L5_GRAPH_H */
```
