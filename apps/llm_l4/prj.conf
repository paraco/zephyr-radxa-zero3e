## CMakeLists.txt
```
cmake_minimum_required(VERSION 3.20.0)
# 모델 가중치 창은 **공용 파일 하나**를 쓴다 — 앱마다 복사해 두면 주소를
# 고칠 때 갈린다 (실제로 실기 DRAM 끝을 넘는 주소가 여섯 군데에 퍼져 있었다).
set(EXTRA_DTC_OVERLAY_FILE
    "${CMAKE_CURRENT_SOURCE_DIR}/../llm_common/model_blob.overlay")

# 사다리 공용 Kconfig 조각 — uart2 인터럽트 폭주를 끈다 (사이클의 77%).
# 근거와 측정값은 그 파일에 있다. ⚠ prj.conf **뒤에** 병합되므로 그 파일이 이긴다.
set(EXTRA_CONF_FILE
    "${CMAKE_CURRENT_SOURCE_DIR}/../llm_common/ladder.conf")

find_package(Zephyr REQUIRED HINTS $ENV{ZEPHYR_BASE})
project(llm_l4)

include(${CMAKE_CURRENT_SOURCE_DIR}/../../cmake/llm_ggml.cmake)
llm_add_ggml()

target_sources(app PRIVATE
	src/main.c
	src/l4_graph.c
	${CMAKE_CURRENT_SOURCE_DIR}/../llm_common/ggml_port.c)
target_include_directories(app PRIVATE src)

# 그래프 파일도 ggml 과 **같은 -mcpu** 로 짓는다. 여기서 기능 매크로를
# 읽어 호스트와 비교하므로, 이 파일만 플래그가 다르면 비교가 거짓말이 된다.
llm_ggml_flags(${CMAKE_CURRENT_SOURCE_DIR}/src/l4_graph.c)
```

## prj.conf
```kconfig
CONFIG_PRINTK=y
CONFIG_BOOT_BANNER=n
CONFIG_MAIN_STACK_SIZE=32768
CONFIG_MAX_XLAT_TABLES=24

# L0 에서 확인한 C++17 조합 — GLIBCXX_LIBCPP 를 명시해야 예외가 켜진다
CONFIG_CPP=y
CONFIG_STD_CPP17=y
CONFIG_GLIBCXX_LIBCPP=y
CONFIG_CPP_EXCEPTIONS=y
CONFIG_CPP_RTTI=y

CONFIG_POSIX_API=y
CONFIG_THREAD_STACK_INFO=y
CONFIG_DYNAMIC_THREAD=y
CONFIG_DYNAMIC_THREAD_ALLOC=y
CONFIG_DYNAMIC_THREAD_STACK_SIZE=32768

# ggml 은 ggml_init 의 mem_size 를 **정렬 할당** 한 덩이로 받는다.
# 아레나가 요청과 같으면 정렬 여유가 없어 실패한다 —
# "ggml_aligned_malloc: insufficient memory (attempted to allocate 4.00 MB)" 를
# 실제로 봤다. 요청(4 MiB)의 여러 배로 둔다. QEMU sram0 은 128 MB 다.
CONFIG_COMMON_LIBC_MALLOC=y
CONFIG_COMMON_LIBC_MALLOC_ARENA_SIZE=33554432
CONFIG_HEAP_MEM_POOL_SIZE=1048576

# ⚠ **로그를 동기(immediate)로 만든다 — 쓰는 주체를 하나로 유지한 채.**
#
# 보드 defconfig 에 CONFIG_LOG=y 가 있어(dwc3 드라이버용) printk 가 기본으로
# 로그 시스템을 거친다. 기본 조합이 이렇다:
#     CONFIG_LOG_MODE_DEFERRED=y
#     CONFIG_LOG_BUFFER_SIZE=1024              ← 1 KB
#     CONFIG_LOG_PROCESS_THREAD_SLEEP_MS=1000  ← 로그 스레드가 1초씩 잔다
#     CONFIG_MAIN_THREAD_PRIORITY=0            ← main 이 그 스레드를 선점한다
# 사다리 앱은 80자 수십 줄을 main 에서 쏟으므로 버퍼가 넘쳐 **앞부분이
# 버려진다**(2026-11-07 L5b 첫 실기 투입에서 꼬리만 남았다).
#
# ⚠ 처음에 `CONFIG_LOG_PRINTK=n` 으로 고치려 했다가 **보드가 멈췄다.**
#   그러면 UART2 에 쓰는 주체가 둘이 된다 — printk(main, 동기)와 로그
#   백엔드(로그 스레드). 같은 인터럽트 구동 UART 를 동시에 건드려 교착한
#   것으로 보인다(dwc3 로그 한 줄만 나오고 멈췄다).
#
# 그래서 LOG_PRINTK 는 기본(y) 그대로 두고 **모드만 동기로** 바꾼다.
# 버퍼도 스레드도 쓰지 않으므로 유실이 없고 쓰는 주체는 하나다.
#
# ⚠ moru 는 이 설정을 쓰면 안 된다 — 동기 출력이 줄당 ~9 ms 를 잡아먹어
#   USB 열거의 SET_ADDRESS 50 ms 예산을 넘긴다(docs/hardware-verified.md).
#   사다리 앱은 USB 를 열거하지 않으므로 무해하다.
CONFIG_LOG_MODE_IMMEDIATE=y
```

## app.overlay
```dts
/*
 * L1 — 모델 가중치 창(창 밖 DRAM)을 MMU 에 연다.
 *
 * ⚠ C 코드가 0줄이다. arm64 가 DT 의 zephyr,memory-region 노드를 부팅 때
 *   평면 매핑한다 (arch/arm64/core/mmu.c:907 의 mmu_dt_regions).
 *   단 zephyr,memory-attr 속성이 있어야 항목이 생긴다 —
 *   MMU_REGION_DT_FLAT_ENTRY_FROM_DT 가 IF_ENABLED 로 감싸고 있다
 *   (include/zephyr/arch/arm64/arm_mmu.h:236-242). 빼면 조용히 안 매핑된다.
 *
 * 주소 0x60000000 은 docs/llm-hub-test-plan.md 가 고정한 값이다.
 * 실기 U-Boot fatload 와 QEMU -device loader 가 같은 주소를 쓴다.
 *   sram0        0x40000000 + 128 MB → 0x48000000 까지
 *   OTA 적재     0x50000000 (sdcard/boot.cmd 의 ota_addr) — 겹치지 않는다
 *   모델 창      0x60000000 + 640 MB → 0x88000000 까지
 *   DRAM 끝      0xC0000000 (2 GB) — 안에 있다
 *
 * 2 MB 정렬이 중요하다. set_mapping(mmu.c:372) 은 정렬이 맞을 때만 큰 블록을
 * 쓰므로, 정렬이 깨지면 4 KB 페이지로 깔려 MAX_XLAT_TABLES 를 넘기고
 * 콘솔이 올라오기 전에 죽는다. 0x60000000/640 MB 는 둘 다 2 MB 정렬이라
 * L2 블록 320개 = 추가 테이블 2개로 끝난다.
 */
#include <zephyr/dt-bindings/memory-attr/memory-attr-arm64.h>

/ {
	reserved-memory {
		#address-cells = <2>;
		#size-cells = <2>;
		ranges;

		model_blob: memory@60000000 {
			compatible = "zephyr,memory-region";
			reg = <0x0 0x60000000 0x0 0x28000000>;	/* 640 MiB */
			zephyr,memory-region = "MODEL_BLOB";
			zephyr,memory-attr = <DT_MEM_ARM64_MMU_NORMAL>;
		};
	};
};
```

## src/main.c
```c
/*
 * L4 — ggml 커널 관문.
 *
 * 사다리(docs/llm-hub-test-plan.md) 다섯째 칸: 작은 행렬곱 · RMSNorm · SiLU ·
 * RoPE, **dotprod 포함**.
 *
 * 그래프는 src/l4_graph.c 하나다 — 호스트 골든 도구도 **같은 파일**을
 * 컴파일한다. 양쪽에 따로 쓰면 전사 오류를 "커널이 다르다" 로 오진한다.
 *
 * 허용 오차: 계획서는 상대 1e-5 다(f32 누산 순서 차이). 비트 일치면 그렇게
 * 적고, 아니면 최대 상대오차를 ppb 로 찍는다 — 숫자를 봐야 판단할 수 있다.
 */
#include <zephyr/kernel.h>
#include <string.h>
#include <stdint.h>
#include <inttypes.h>

#include "ggml-backend.h"
#include "ggml-cpu.h"

#include "l4_graph.h"
#include "l4_golden.h"

/* 계획서의 L4 허용 오차 1e-5 = 10,000 ppb */
#define TOL_PPB		10000ull

static uint32_t bits(float f) { uint32_t b; memcpy(&b, &f, 4); return b; }
static float fabsf_(float f) { return f < 0 ? -f : f; }

/* 상대오차를 ppb(10억분율)로. printk 에 부동소수를 쓰지 않는다. */
static uint64_t rel_ppb(float got, float want)
{
	float d = fabsf_(got - want);
	float m = fabsf_(want);

	/*
	 * ⚠ NaN·Inf 를 먼저 걸러낸다. 그러지 않으면 **NaN 이 OK 로 통과한다** —
	 *   NaN 비교는 `d == 0` 도 `r > 1e18` 도 거짓이고 `(uint64_t)NaN` 은 0 이라
	 *   worst 가 0 으로 남아 "최대 0 ppb" 로 찍힌다. 커널이 NaN 을 내거나
	 *   Inf-Inf 가 생기는 회귀가 조용히 통과한다.
	 */
	if (got != got || want != want) { return UINT64_MAX; }	/* NaN */
	if (d > 1e30f) { return UINT64_MAX; }			/* Inf 또는 폭발 */
	if (d == 0.0f) { return 0; }
	if (m < 1e-30f) { m = 1e-30f; }
	float r = d / m * 1e9f;

	if (r > 1e18f) { return (uint64_t)1e18; }
	return (uint64_t)r;
}

static int check(const char *name, const float *got, const uint32_t *golden, int n)
{
	int nbit = 0;
	uint64_t worst = 0;
	int worst_i = 0;

	/*
	 * 비트가 같으면 비교를 건너뛰므로, **양쪽이 같은 NaN 을 내면 통과한다.**
	 * 그래서 얻은 값 자체에 비유한값이 있는지 골든과 무관하게 먼저 본다.
	 * 층 출력에 NaN·Inf 가 나오는 것은 어떤 경우에도 실패다.
	 */
	int nonfinite = 0;

	for (int i = 0; i < n; i++) {
		if (got[i] != got[i] || fabsf_(got[i]) > 1e30f) { nonfinite++; }
	}
	if (nonfinite) {
		printk("FAIL — 얻은 값에 비유한값(NaN/Inf) %d개\n", nonfinite);
		return 1;
	}
	printk("  %-12s %4d개 ... ", name, n);
	for (int i = 0; i < n; i++) {
		float want;

		memcpy(&want, &golden[i], 4);
		if (bits(got[i]) != golden[i]) {
			nbit++;
			uint64_t r = rel_ppb(got[i], want);

			if (r > worst) { worst = r; worst_i = i; }
		}
	}
	if (nbit == 0) {
		printk("OK — **비트 일치**\n");
		return 0;
	}
	if (worst <= TOL_PPB) {
		printk("OK — 비트는 %d/%d 다르나 최대 상대오차 %" PRIu64 " ppb ≤ %" PRIu64 "\n",
		       nbit, n, worst, TOL_PPB);
		return 0;
	}
	printk("FAIL — 최대 상대오차 %" PRIu64 " ppb (> %" PRIu64 ") at [%d]\n",
	       worst, TOL_PPB, worst_i);
	printk("         얻음 0x%08x  골든 0x%08x\n", bits(got[worst_i]), golden[worst_i]);
	return 1;
}

static struct l4_results res;

int main(void)
{
	int fail = 0;

	printk("=== L4: ggml 커널 관문 ===\n");

	int rc = l4_run(&res);

	if (rc != 0) {
		printk("  l4_run 실패: %d\n", rc);
		printk("=== L4 FAIL (실패 1) ===\n");
		return 0;
	}

	/*
	 * [0a] **sysconf 포팅의 양성 대조.**
	 *
	 * ggml_backend_cpu_device_get_memory() 가 sysconf(_SC_PHYS_PAGES) 와
	 * sysconf(_SC_PAGE_SIZE) 를 연달아 부른다. 우리 포팅이 틀리면 여기서
	 * 멈추거나 쓰레기를 돌려준다 — 실제로 한 번 **무한 재귀**를 만들었고
	 * L4·L5 가 이 함수를 부르지 않아 초록으로 통과했다.
	 * 계기를 쓰지 않으면 잠복한다. 그래서 직접 부른다.
	 */
	printk("  [0a] sysconf 포팅 (장치 메모리 보고) ... ");
	{
		ggml_backend_reg_t reg = ggml_backend_cpu_reg();
		size_t dev_free = 0, dev_total = 0;

		if (!reg || ggml_backend_reg_dev_count(reg) == 0) {
			printk("FAIL — CPU 백엔드 장치가 없다\n");
			fail++;
		} else {
			ggml_backend_dev_t dev = ggml_backend_reg_dev_get(reg, 0);

			ggml_backend_dev_memory(dev, &dev_free, &dev_total);
			if (dev_total == 0 || dev_total > (size_t)1 << 40) {
				printk("FAIL — total=%u KiB 가 말이 안 된다\n",
				       (unsigned)(dev_total / 1024));
				fail++;
			} else {
				printk("OK — total %u KiB (멈추지 않았다)\n",
				       (unsigned)(dev_total / 1024));
			}
		}
	}

	/*
	 * [0] 커널 기능 집합이 호스트와 같은가.
	 * 다르면 ggml 이 **다른 커널 경로**를 골라 Q4_0 행렬곱 결과가 갈린다.
	 * 계획서가 -cpu max 를 쓰지 말라고 한 이유가 이것이다.
	 */
	printk("  [0] 기능 집합  Zephyr dotprod=%d i8mm=%d / 호스트 %d %d ... ",
	       res.dotprod, res.i8mm, L4_HOST_DOTPROD, L4_HOST_I8MM);
	if (res.dotprod == L4_HOST_DOTPROD && res.i8mm == L4_HOST_I8MM) {
		printk("OK\n");
	} else {
		printk("불일치 — 아래 비교는 다른 커널 경로끼리다\n");
		fail++;
	}

	fail += check("[1] mm f32", res.mm_f32, l4_g_mm_f32, L4_MM_N);
	fail += check("[2] mm Q4_0", res.mm_q4_0, l4_g_mm_q4_0, L4_MM_N);
	fail += check("[3] RMSNorm", res.rms, l4_g_rms, L4_RMS_NE);
	fail += check("[4] SiLU", res.silu, l4_g_silu, L4_SILU_NE);
	fail += check("[5] RoPE", res.rope, l4_g_rope, L4_ROPE_NE);

	if (fail == 0) {
		printk("=== L4 PASS (실패 0) ===\n");
	} else {
		printk("=== L4 FAIL (실패 %d) ===\n", fail);
	}
	return 0;
}
```

## src/l4_golden.h
```c
/*
 * l4_golden.h — 생성 파일이다. 손으로 고치지 않는다.
 *
 *   $ ./tools/l4_golden.sh
 *
 * 출처: 호스트에서 apps/llm_l4/src/l4_graph.c 를 **그대로** 돌린 결과다.
 * 같은 파일을 Zephyr 에서도 컴파일하므로 차이는 플랫폼뿐이다.
 *
 * 호스트 커널 플래그: dotprod=1 i8mm=0
 */
#ifndef L4_GOLDEN_H
#define L4_GOLDEN_H

#include <stdint.h>

#define L4_HOST_DOTPROD 1
#define L4_HOST_I8MM    0

static const uint32_t l4_g_mm_f32[128] = {
	0xc206b000u, 0xc1864000u, 0x40dc8000u, 0x421d2000u, 0x42a0c800u, 0x42075000u, 0x40120000u, 0xc1a46000u,
	0xc20aa000u, 0xc2203000u, 0xc212e000u, 0xc1b5e000u, 0xbffc0000u, 0x41dc2000u, 0x42837000u, 0x42525000u,
	0x413d4000u, 0xc15e8000u, 0xc1f76000u, 0xc21ce000u, 0xc21b3000u, 0xc1ddc000u, 0xc11dc000u, 0x4185c000u,
	0x42501000u, 0x42840000u, 0x41b2c000u, 0xc0c98000u, 0xc1d1c000u, 0xc215b000u, 0xc21fa000u, 0xc206b000u,
	0xc21ce000u, 0xc206b000u, 0xc19f2000u, 0x40270000u, 0x42075000u, 0x42a21000u, 0x421e6000u, 0x40dc0000u,
	0xc1890000u, 0xc201a000u, 0xc21be000u, 0xc2115000u, 0xc1cba000u, 0xc0bb8000u, 0x41b3a000u, 0x426df000u,
	0x4251c000u, 0x41868000u, 0xc1218000u, 0xc1e24000u, 0xc2170000u, 0xc2181000u, 0xc1f06000u, 0xc155c000u,
	0x4140c000u, 0x4238b000u, 0x42848000u, 0x41ddc000u, 0xc0060000u, 0xc1b98000u, 0xc20e4000u, 0xc21ce000u,
	0xc20e4000u, 0xc21fa000u, 0xc20a4000u, 0xc1a40000u, 0x40120000u, 0x421e6000u, 0x429fa000u, 0x421aa000u,
	0x40c70000u, 0xc18c0000u, 0xc2020000u, 0xc21f0000u, 0xc2154000u, 0xc1d14000u, 0xc0c90000u, 0x41b28000u,
	0x4282e000u, 0x424da000u, 0x41808000u, 0xc1290000u, 0xc1e3c000u, 0xc21a8000u, 0xc21c6000u, 0xc1f6c000u,
	0xc15e0000u, 0x413d0000u, 0x42502000u, 0x42824000u, 0x41d70000u, 0xc02a0000u, 0xc1bbc000u, 0xc20e4000u,
	0xc1b98000u, 0xc215b000u, 0xc2221000u, 0xc20b9000u, 0xc1a46000u, 0x40dc0000u, 0x421aa000u, 0x429e5000u,
	0x42192000u, 0x40c40000u, 0xc18a8000u, 0xc209d000u, 0xc221d000u, 0xc216f000u, 0xc1d26000u, 0xc0c48000u,
	0x41d8c000u, 0x42816000u, 0x424bc000u, 0x417e0000u, 0xc1278000u, 0xc1f42000u, 0xc21db000u, 0xc21e7000u,
	0xc1f8a000u, 0xc15d4000u, 0x41840000u, 0x424cc000u, 0x42812000u, 0x41d4c000u, 0xc02a0000u, 0xc1b98000u,
};

static const uint32_t l4_g_mm_q4_0[128] = {
	0x3f154840u, 0xc03e2558u, 0xbed3a400u, 0xbfaa8a70u, 0x3f49f4c8u, 0xc105c06eu, 0x3fddcc28u, 0x411a01a0u,
	0xc008ffe0u, 0xbfe8e630u, 0xc0413770u, 0x4098f184u, 0xbf0c11f8u, 0xc135771eu, 0x4009d384u, 0xbfa28280u,
	0xbf778b40u, 0xbfa117b0u, 0xc0273be0u, 0x403ad6c8u, 0xc02218aeu, 0xc10a79ceu, 0x3f2b7c50u, 0x40add900u,
	0x3f4c1500u, 0xc109c466u, 0x3e2dd900u, 0xc01ef778u, 0x3ec40d10u, 0xc1ac75bfu, 0x3f9c9ac8u, 0x4157e470u,
	0xc02ed9feu, 0xc03255e8u, 0x401d5f4eu, 0xc161a2c6u, 0xc053e078u, 0x415495e0u, 0x3fa4df30u, 0xbe40be80u,
	0xbfdbca2cu, 0x40eb611cu, 0xbf251ba8u, 0xc10fac1eu, 0xc0330b50u, 0x4107d188u, 0x3e972c00u, 0x4077c7b8u,
	0x4033ee12u, 0xc1a44075u, 0xbf5ebe08u, 0xbff43cb0u, 0xc0a88874u, 0x408170e0u, 0x400c8ae8u, 0x41a8538bu,
	0xc039f406u, 0xc07cfa08u, 0x405a13c6u, 0xc114de6eu, 0xc0576b80u, 0x3fcdf8c0u, 0x40c357a8u, 0x4066c5f8u,
	0xbff7a97cu, 0x3f9face0u, 0xc044d196u, 0xc1479818u, 0xbeb9a870u, 0xbfe597a0u, 0x40eb9605u, 0xc186a330u,
	0x4081878du, 0x411a5c54u, 0xc0af4b5fu, 0xc062c200u, 0xbf23b0d8u, 0x413a0324u, 0x40153922u, 0x40e33af0u,
	0x3fc375e4u, 0xc1301774u, 0xc0a3d6a3u, 0x3fec34c0u, 0x3fbcd8c4u, 0xc1280f84u, 0x410cd2b6u, 0xc0dfec60u,
	0xc030fa36u, 0x405e8190u, 0xc001f8eeu, 0xc02bf540u, 0xbe9d5030u, 0x401896d0u, 0x40b523f9u, 0xc1620c98u,
	0x3fdebe08u, 0xc19d9437u, 0xc0192dfcu, 0x415a13c6u, 0xc05efa80u, 0x41bcb2f9u, 0x3e080e00u, 0xc1326506u,
	0x409de75cu, 0xc150fbbau, 0xc0824484u, 0x412d147au, 0xbf3035b0u, 0x410d8be6u, 0xbf985a58u, 0x3fd05570u,
	0x40451d2cu, 0xc1d22283u, 0xc0499a14u, 0x4168036eu, 0x4007d188u, 0x3d8f9d00u, 0x4007d188u, 0xc14c241eu,
	0x3e8f9d00u, 0xc1614812u, 0xbf9cd740u, 0x41e1c891u, 0xc05477a4u, 0x41e28d17u, 0xbeace720u, 0xc117d24au,
};

static const uint32_t l4_g_rms[128] = {
	0xbf65fc40u, 0x3f2c7d30u, 0xbf9e1d6cu, 0x3eac7d30u, 0xbfc93cb8u, 0x00000000u, 0x3fc93cb8u, 0xbeac7d30u,
	0x3f9e1d6cu, 0xbf2c7d30u, 0x3f65fc40u, 0xbf815de4u, 0x3f0fbda8u, 0xbfac7d30u, 0x3e65fc40u, 0xbfd79c7cu,
	0xbde5fc40u, 0x3fbadcf4u, 0xbee5fc40u, 0x3f8fbda8u, 0xbf493cb8u, 0x3f493cb8u, 0xbf8fbda8u, 0x3ee5fc40u,
	0xbfbadcf4u, 0x3de5fc40u, 0x3fd79c7cu, 0xbe65fc40u, 0x3fac7d30u, 0xbf0fbda8u, 0x3f815de4u, 0xbf65fc40u,
	0x3f2c7d30u, 0xbf9e1d6cu, 0x3eac7d30u, 0xbfc93cb8u, 0x00000000u, 0x3fc93cb8u, 0xbeac7d30u, 0x3f9e1d6cu,
	0xbf2c7d30u, 0x3f65fc40u, 0xbf815de4u, 0x3f0fbda8u, 0xbfac7d30u, 0x3e65fc40u, 0xbfd79c7cu, 0xbde5fc40u,
	0x3fbadcf4u, 0xbee5fc40u, 0x3f8fbda8u, 0xbf493cb8u, 0x3f493cb8u, 0xbf8fbda8u, 0x3ee5fc40u, 0xbfbadcf4u,
	0x3de5fc40u, 0x3fd79c7cu, 0xbe65fc40u, 0x3fac7d30u, 0xbf0fbda8u, 0x3f815de4u, 0xbf65fc40u, 0x3f2c7d30u,
	0xbf9e1d6cu, 0x3eac7d30u, 0xbfc93cb8u, 0x00000000u, 0x3fc93cb8u, 0xbeac7d30u, 0x3f9e1d6cu, 0xbf2c7d30u,
	0x3f65fc40u, 0xbf815de4u, 0x3f0fbda8u, 0xbfac7d30u, 0x3e65fc40u, 0xbfd79c7cu, 0xbde5fc40u, 0x3fbadcf4u,
	0xbee5fc40u, 0x3f8fbda8u, 0xbf493cb8u, 0x3f493cb8u, 0xbf8fbda8u, 0x3ee5fc40u, 0xbfbadcf4u, 0x3de5fc40u,
	0x3fd79c7cu, 0xbe65fc40u, 0x3fac7d30u, 0xbf0fbda8u, 0x3f815de4u, 0xbf65fc40u, 0x3f2c7d30u, 0xbf9e1d6cu,
	0x3eac7d30u, 0xbfc93cb8u, 0x00000000u, 0x3fc93cb8u, 0xbeac7d30u, 0x3f9e1d6cu, 0xbf2c7d30u, 0x3f65fc40u,
	0xbf815de4u, 0x3f0fbda8u, 0xbfac7d30u, 0x3e65fc40u, 0xbfd79c7cu, 0xbde5fc40u, 0x3fbadcf4u, 0xbee5fc40u,
	0x3f8fbda8u, 0xbf493cb8u, 0x3f493cb8u, 0xbf8fbda8u, 0x3ee5fc40u, 0xbfbadcf4u, 0x3de5fc40u, 0x3fd79c7cu,
	0xbe65fc40u, 0x3fac7d30u, 0xbf0fbda8u, 0x3f815de4u, 0xbf65fc40u, 0x3f2c7d30u, 0xbf9e1d6cu, 0x3eac7d30u,
};

static const uint32_t l4_g_silu[128] = {
	0x3f8c7b1bu, 0xbe76640au, 0x3f3b26a8u, 0xbe8d2b41u, 0x3ed06efeu, 0xbe8c1a52u, 0x3e0feacdu, 0xbe7f4a96u,
	0xbd700555u, 0x3fadc7d4u, 0xbe414d03u, 0x3f78bc68u, 0xbe83ceeeu, 0x3f1e1889u, 0xbe8e8732u, 0x3e9f597fu,
	0xbe88e0b1u, 0x3d87fd57u, 0x3fd016adu, 0xbde02a67u, 0x3f9cf96cu, 0xbe5f2204u, 0x3f596a60u, 0xbe89b2b0u,
	0x3f0266feu, 0xbe8e1396u, 0x3e63957fu, 0xbe84a679u, 0x00000000u, 0x3fbed661u, 0xbe1c6a81u, 0x3f8c7b1bu,
	0xbe76640au, 0x3f3b26a8u, 0xbe8d2b41u, 0x3ed06efeu, 0xbe8c1a52u, 0x3e0feacdu, 0xbe7f4a96u, 0xbd700555u,
	0x3fadc7d4u, 0xbe414d03u, 0x3f78bc68u, 0xbe83ceeeu, 0x3f1e1889u, 0xbe8e8732u, 0x3e9f597fu, 0xbe88e0b1u,
	0x3d87fd57u, 0x3fd016adu, 0xbde02a67u, 0x3f9cf96cu, 0xbe5f2204u, 0x3f596a60u, 0xbe89b2b0u, 0x3f0266feu,
	0xbe8e1396u, 0x3e63957fu, 0xbe84a679u, 0x00000000u, 0x3fbed661u, 0xbe1c6a81u, 0x3f8c7b1bu, 0xbe76640au,
	0x3f3b26a8u, 0xbe8d2b41u, 0x3ed06efeu, 0xbe8c1a52u, 0x3e0feacdu, 0xbe7f4a96u, 0xbd700555u, 0x3fadc7d4u,
	0xbe414d03u, 0x3f78bc68u, 0xbe83ceeeu, 0x3f1e1889u, 0xbe8e8732u, 0x3e9f597fu, 0xbe88e0b1u, 0x3d87fd57u,
	0x3fd016adu, 0xbde02a67u, 0x3f9cf96cu, 0xbe5f2204u, 0x3f596a60u, 0xbe89b2b0u, 0x3f0266feu, 0xbe8e1396u,
	0x3e63957fu, 0xbe84a679u, 0x00000000u, 0x3fbed661u, 0xbe1c6a81u, 0x3f8c7b1bu, 0xbe76640au, 0x3f3b26a8u,
	0xbe8d2b41u, 0x3ed06efeu, 0xbe8c1a52u, 0x3e0feacdu, 0xbe7f4a96u, 0xbd700555u, 0x3fadc7d4u, 0xbe414d03u,
	0x3f78bc68u, 0xbe83ceeeu, 0x3f1e1889u, 0xbe8e8732u, 0x3e9f597fu, 0xbe88e0b1u, 0x3d87fd57u, 0x3fd016adu,
	0xbde02a67u, 0x3f9cf96cu, 0xbe5f2204u, 0x3f596a60u, 0xbe89b2b0u, 0x3f0266feu, 0xbe8e1396u, 0x3e63957fu,
	0xbe84a679u, 0x00000000u, 0x3fbed661u, 0xbe1c6a81u, 0x3f8c7b1bu, 0xbe76640au, 0x3f3b26a8u, 0xbe8d2b41u,
};

static const uint32_t l4_g_rope[256] = {
	0xbe000000u, 0x3fd00000u, 0xbf000000u, 0x3fa00000u, 0xbf600000u, 0x3f600000u, 0xbfa00000u, 0x3f000000u,
	0xbfd00000u, 0x3e000000u, 0x3ff00000u, 0xbe800000u, 0x3fc00000u, 0xbf200000u, 0x3f900000u, 0xbf800000u,
	0x3f400000u, 0xbfb00000u, 0x3ec00000u, 0xbfe00000u, 0x00000000u, 0x3fe00000u, 0xbec00000u, 0x3fb00000u,
	0xbf400000u, 0x3f800000u, 0xbf900000u, 0x3f200000u, 0xbfc00000u, 0x3e800000u, 0xbff00000u, 0xbe000000u,
	0x3fd00000u, 0xbf000000u, 0x3fa00000u, 0xbf600000u, 0x3f600000u, 0xbfa00000u, 0x3f000000u, 0xbfd00000u,
	0x3e000000u, 0x3ff00000u, 0xbe800000u, 0x3fc00000u, 0xbf200000u, 0x3f900000u, 0xbf800000u, 0x3f400000u,
	0xbfb00000u, 0x3ec00000u, 0xbfe00000u, 0x00000000u, 0x3fe00000u, 0xbec00000u, 0x3fb00000u, 0xbf400000u,
	0x3f800000u, 0xbf900000u, 0x3f200000u, 0xbfc00000u, 0x3e800000u, 0xbff00000u, 0xbe000000u, 0x3fd00000u,
	0xbfa936f6u, 0x3e82607cu, 0xbf9a77c8u, 0x3e8c2712u, 0xbfabf82au, 0x3db11b70u, 0xbfcf8cd7u, 0xbe285dfcu,
	0x3ff1fee4u, 0xbd7c29e0u, 0x3fc4315fu, 0xbf0a2a20u, 0x3f93f99du, 0xbf76c424u, 0x3f463a96u, 0xbfae43deu,
	0x3ec8f344u, 0xbfdf8241u, 0xbc213bd2u, 0x3fdfff18u, 0xbec239acu, 0x3fafd8eau, 0xbf407477u, 0x3f7fa87du,
	0xbf901477u, 0x3f1fb641u, 0xbfc00499u, 0x3e7f22deu, 0xbfeffeb3u, 0xbe009b6eu, 0x3fd002eau, 0xbeffda20u,
	0x3fb4b170u, 0x3f143e34u, 0x3fb40f5au, 0xbf174b0fu, 0x3f7b05b7u, 0xbfb1c88eu, 0xbe55a6cau, 0x3fef0ba8u,
	0xbecc0858u, 0x3fbbd89cu, 0xbf2fef19u, 0x3f8b46a9u, 0xbf82f8a6u, 0x3f37cf57u, 0xbfb0d361u, 0x3eb37382u,
	0xbfdffd22u, 0xbc8f5b8eu, 0x3fe04432u, 0xbebaf55au, 0x3fb04d7du, 0xbf3ee2ccu, 0x3f804180u, 0xbf8fc5acu,
	0x3f206249u, 0xbfbfeb7fu, 0x3e808a32u, 0xbfeffb62u, 0xbe0086b5u, 0x3fcffeb3u, 0xbf000e91u, 0x3f9ffd16u,
	0xbedcee73u, 0xbf947323u, 0xbf7d8a74u, 0xbf697460u, 0xbfb139f2u, 0xbf5c192eu, 0x3fec1f7au, 0x3ed6499cu,
	0x3fcc10fbu, 0xbea10b13u, 0x3f9d74b2u, 0xbf5e0f5cu, 0x3f55dd1eu, 0xbfa994a2u, 0x3edfbd16u, 0xbfde26ccu,
	0xbd0f59b8u, 0x3fdff488u, 0xbec7e7ccu, 0x3faf72f4u, 0xbf419d80u, 0x3f7ec7d3u, 0xbf90489bu, 0x3f1ef986u,
	0xbfc01048u, 0x3e7ced70u, 0xbfeffb5bu, 0xbe0228c8u, 0x3fd00a5bu, 0xbeff7948u, 0x3fa00a32u, 0xbf5fe2dcu,
	0x3f45c21eu, 0x3fa86cc0u, 0x3fd741beu, 0xbe800818u, 0xbf80f71au, 0x3fcb096fu, 0xbf41b4a1u, 0x3fa8d77du,
	0xbf560705u, 0x3f7a78dbu, 0xbf89f72cu, 0x3f220e45u, 0xbfb2ae90u, 0x3e931ef6u, 0xbfdfdbbcu, 0xbd7ee163u,
	0x3fe0ea46u, 0xbeae0af5u, 0x3fb1118cu, 0xbf3c0770u, 0x3f80e87eu, 0xbf8f3005u, 0x3f215d5eu, 0xbfbfb6d9u,
	0x3e81eb74u, 0xbfefef7eu, 0xbe01df13u, 0x3fcffb5cu, 0xbf0033ceu, 0x3f9ff5a1u, 0xbf601464u, 0x3f5feb9au,
	0x3f955dfcu, 0xbf2be0a0u, 0x3d83a99fu, 0xbfd073beu, 0x3fa5dd9au, 0x3fb0633bu, 0x3fce00b1u, 0x3e660ba8u,
	0x3faf6521u, 0xbf1f74d2u, 0x3f786050u, 0xbf9d61f9u, 0x3f0a0170u, 0xbfda7226u, 0xbdbf1c25u, 0x3fdfae6bu,
	0xbed507cbu, 0x3fae7b24u, 0xbf444a90u, 0x3f7cb982u, 0xbf90c0a1u, 0x3f1d42b9u, 0xbfc02b01u, 0x3e77cd55u,
	0xbfeff370u, 0xbe05c269u, 0x3fd01b90u, 0xbefe9895u, 0x3fa01b2eu, 0xbf5fb242u, 0x3f602bb2u, 0xbf9ff0b3u,
	0xbe8806b8u, 0x3fd6f33bu, 0xbff03c79u, 0xbdbf0989u, 0xbfaead3du, 0x3f2bc492u, 0xbf8e1ccau, 0x3f269d2au,
	0xbf96a72cu, 0x3ed78af9u, 0xbfb58f8fu, 0x3e0e2402u, 0xbfdefe25u, 0xbe29bfcau, 0x3fe23da7u, 0xbe8ff309u,
	0x3fb2cce5u, 0xbf355aeeu, 0x3f826937u, 0xbf8dd1fau, 0x3f23a2bcu, 0xbfbf3b80u, 0x3e851e9eu, 0xbfefd36cu,
	0xbe04fdceu, 0x3fcff379u, 0xbf008a27u, 0x3f9fe44du, 0xbf603660u, 0x3f5fc992u, 0xbfa008bdu, 0x3effa896u,
};

#endif /* L4_GOLDEN_H */
```

## src/l4_graph.c
```c
/*
 * L4 그래프 — 호스트와 Zephyr 가 공유한다. l4_graph.h 참고.
 *
 * 입력은 전부 **첨자의 함수**다. 난수를 쓰면 양쪽에서 같은 값을 보장할 수
 * 없고, 0 으로 채우면 커널이 틀려도 통과한다(L1 에서 같은 이유로 그렇게 했다).
 */
#include "l4_graph.h"

#include <string.h>
#include <stdlib.h>

#include "ggml.h"
#include "ggml-cpu.h"

/* f32 입력 — 양수·음수·0 을 고루 지나간다 */
static float in_f32(int i)
{
	return (float)((i * 7919) % 31 - 15) * 0.125f;
}

/*
 * Q4_0 가중치의 **생바이트**. 임의 바이트도 유효한 Q4_0 블록이다
 * (d 가 fp16, qs 가 니블 16개). 다만 d 가 NaN/Inf 가 되면 결과가 NaN 이라
 * 비교가 무의미해지므로 **d 는 고정하고 니블만 바꾼다.**
 *
 * 블록 = 18 B: d fp16 | qs[16]
 */
static void fill_q4_0(uint8_t *p, int nblocks)
{
	for (int b = 0; b < nblocks; b++) {
		uint8_t *blk = p + (size_t)b * 18;
		/* fp16 값들: 0.0625, -0.125, 0.25, -0.5 가 순환 */
		static const uint16_t ds[4] = { 0x2C00, 0xB000, 0x3400, 0xB800 };
		uint16_t d = ds[b & 3];

		memcpy(blk, &d, 2);
		for (int j = 0; j < 16; j++) {
			blk[2 + j] = (uint8_t)((b * 37 + j * 11) & 0xFF);
		}
	}
}

int l4_run(struct l4_results *out)
{
	memset(out, 0, sizeof(*out));
#ifdef __ARM_FEATURE_DOTPROD
	out->dotprod = 1;
#endif
#ifdef __ARM_FEATURE_MATMUL_INT8
	out->i8mm = 1;
#endif

	struct ggml_init_params ip = {
		.mem_size   = 4u * 1024 * 1024,
		.mem_buffer = NULL,
		.no_alloc   = false,
	};
	struct ggml_context *ctx = ggml_init(ip);

	if (!ctx) {
		return -1;
	}

	/* ── ① f32 행렬곱.  a[K,M] × b[K,N] → [M,N] */
	struct ggml_tensor *a = ggml_new_tensor_2d(ctx, GGML_TYPE_F32, L4_K, L4_M);
	struct ggml_tensor *b = ggml_new_tensor_2d(ctx, GGML_TYPE_F32, L4_K, L4_N);

	for (int i = 0; i < L4_K * L4_M; i++) { ((float *)a->data)[i] = in_f32(i); }
	for (int i = 0; i < L4_K * L4_N; i++) { ((float *)b->data)[i] = in_f32(i + 1000); }
	struct ggml_tensor *mm = ggml_mul_mat(ctx, a, b);

	/*
	 * ── ② Q4_0 행렬곱 — **진짜 추론 경로다.**
	 * ggml 이 b 를 Q8_0 으로 양자화해 ggml_vec_dot_q4_0_q8_0 를 부르고,
	 * 그 안에서 __ARM_FEATURE_DOTPROD 가 있으면 vdotq_s32 를 쓴다.
	 * 즉 이 한 줄이 dotprod 경로를 지나간다.
	 */
	struct ggml_tensor *aq = ggml_new_tensor_2d(ctx, GGML_TYPE_Q4_0, L4_K, L4_M);
	fill_q4_0((uint8_t *)aq->data, (L4_K / 32) * L4_M);
	struct ggml_tensor *bq = ggml_new_tensor_2d(ctx, GGML_TYPE_F32, L4_K, L4_N);

	for (int i = 0; i < L4_K * L4_N; i++) { ((float *)bq->data)[i] = in_f32(i + 1000); }
	struct ggml_tensor *mmq = ggml_mul_mat(ctx, aq, bq);

	/* ── ③ RMSNorm */
	struct ggml_tensor *r = ggml_new_tensor_1d(ctx, GGML_TYPE_F32, L4_RMS_NE);

	for (int i = 0; i < L4_RMS_NE; i++) { ((float *)r->data)[i] = in_f32(i + 2000); }
	struct ggml_tensor *rms = ggml_rms_norm(ctx, r, 1e-5f);

	/* ── ④ SiLU */
	struct ggml_tensor *s = ggml_new_tensor_1d(ctx, GGML_TYPE_F32, L4_SILU_NE);

	for (int i = 0; i < L4_SILU_NE; i++) { ((float *)s->data)[i] = in_f32(i + 3000); }
	struct ggml_tensor *silu = ggml_silu(ctx, s);

	/* ── ⑤ RoPE.  a[head_dim, n_head, n_tok], b = 위치 i32[n_tok] */
	struct ggml_tensor *q = ggml_new_tensor_3d(ctx, GGML_TYPE_F32,
						   L4_HEAD_DIM, L4_N_HEAD, L4_N_TOK);
	for (int i = 0; i < L4_ROPE_NE; i++) { ((float *)q->data)[i] = in_f32(i + 4000); }
	struct ggml_tensor *pos = ggml_new_tensor_1d(ctx, GGML_TYPE_I32, L4_N_TOK);

	for (int i = 0; i < L4_N_TOK; i++) { ((int32_t *)pos->data)[i] = i; }
	struct ggml_tensor *rope = ggml_rope(ctx, q, pos, L4_HEAD_DIM, 0);

	/* ── 계산. 스레드 1개 — 재현성을 위해 누산 순서를 고정한다. */
	struct ggml_cgraph *gf = ggml_new_graph(ctx);

	ggml_build_forward_expand(gf, mm);
	ggml_build_forward_expand(gf, mmq);
	ggml_build_forward_expand(gf, rms);
	ggml_build_forward_expand(gf, silu);
	ggml_build_forward_expand(gf, rope);

	enum ggml_status st = ggml_graph_compute_with_ctx(ctx, gf, 1);

	if (st != GGML_STATUS_SUCCESS) {
		ggml_free(ctx);
		return -2 - (int)st;
	}

	memcpy(out->mm_f32, mm->data, sizeof(out->mm_f32));
	memcpy(out->mm_q4_0, mmq->data, sizeof(out->mm_q4_0));
	memcpy(out->rms, rms->data, sizeof(out->rms));
	memcpy(out->silu, silu->data, sizeof(out->silu));
	memcpy(out->rope, rope->data, sizeof(out->rope));

	ggml_free(ctx);
	return 0;
}
```

## src/l4_graph.h
```c
/*
 * L4 그래프 — **호스트와 Zephyr 가 이 파일을 공유한다.**
 *
 * 그래프를 양쪽에 따로 쓰면 전사 오류가 생기고, 그걸 "커널이 다르다" 로
 * 오진한다. 한 파일을 양쪽에서 컴파일하면 차이는 플랫폼뿐이다.
 */
#ifndef L4_GRAPH_H
#define L4_GRAPH_H

#include <stdint.h>

/* 크기 — 작게 유지한다. 커널의 정확성을 보는 것이고 성능은 L8 이다. */
#define L4_K		64	/* 내적 길이 (Q4_0 블록 2개) */
#define L4_M		32	/* 가중치 행 */
#define L4_N		4	/* 입력 열(토큰) */
#define L4_MM_N		(L4_M * L4_N)

#define L4_RMS_NE	128
#define L4_SILU_NE	128

#define L4_HEAD_DIM	32
#define L4_N_HEAD	2
#define L4_N_TOK	4
#define L4_ROPE_NE	(L4_HEAD_DIM * L4_N_HEAD * L4_N_TOK)

struct l4_results {
	float mm_f32[L4_MM_N];
	float mm_q4_0[L4_MM_N];
	float rms[L4_RMS_NE];
	float silu[L4_SILU_NE];
	float rope[L4_ROPE_NE];
	int   dotprod;		/* __ARM_FEATURE_DOTPROD 가 켜졌는가 */
	int   i8mm;		/* __ARM_FEATURE_MATMUL_INT8 */
};

/* 0 = 성공. 실패하면 음수. */
int l4_run(struct l4_results *out);

#endif /* L4_GRAPH_H */
```
