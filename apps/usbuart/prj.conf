## CMakeLists.txt
```
# SPDX-License-Identifier: Apache-2.0
cmake_minimum_required(VERSION 3.20.0)
find_package(Zephyr REQUIRED HINTS $ENV{ZEPHYR_BASE})
project(usbuart)
target_sources(app PRIVATE src/main.c)
```

## prj.conf
```kconfig
# USB 디바이스 스택은 켜되, 콘솔은 UART2 로 둔다.
#
# 스택이 켜져야 usbd 가 udc_init()/udc_enable() 을 부르고 그래야 dwc3
# 드라이버가 실제로 돈다. 콘솔을 CDC-ACM 으로 보내면 드라이버가 실패할 때
# 실패 원인을 알려 줄 로그 자체가 사라지므로, 콘솔은 UART2 에 남긴다.
CONFIG_SERIAL=y
CONFIG_CONSOLE=y
CONFIG_UART_CONSOLE=y
CONFIG_STDOUT_CONSOLE=y
CONFIG_UART_LINE_CTRL=y

CONFIG_USB_DEVICE_STACK_NEXT=y
CONFIG_USBD_CDC_ACM_CLASS=y
# 부팅 때 스택을 자동으로 올린다 — 앱 코드 없이 udc_init/udc_enable 이 불린다
CONFIG_CDC_ACM_SERIAL_INITIALIZE_AT_BOOT=y
CONFIG_CDC_ACM_SERIAL_PID=0x0004
CONFIG_CDC_ACM_SERIAL_PRODUCT_STRING="PiZZa dwc3 bringup"

# 진단이 목적이므로 USB 쪽 로그를 모두 켠다
CONFIG_LOG=y
# DBG 는 줄 수가 너무 많다 — 타이밍에 영향을 준다. 판정에 필요한 INF 만.
CONFIG_UDC_DRIVER_LOG_LEVEL_INF=y
CONFIG_USBD_LOG_LEVEL_INF=y
CONFIG_USBD_CDC_ACM_LOG_LEVEL_INF=y

# ⚠ 즉시 출력 모드. 어딘가에서 멈추면 버퍼에 남은 로그가 날아가므로,
#   한 줄씩 바로 내보내 '어디까지 갔는지' 를 알 수 있게 한다.
# ⚠ 즉시 모드를 쓰지 않는다 — 이것이 열거 실패의 원인이었다.
#
#   즉시 모드는 로그 한 줄을 그 자리에서 UART 로 밀어내며 스레드를 멈춘다.
#   115200 에서 100자는 약 9 ms 이고, 리셋 처리 하나가 12줄 이상을 찍으니
#   100 ms 가 넘는다. USB 규격은 SET_ADDRESS 가 50 ms 안에 완료되어야
#   한다고 정하므로, 로그가 그 예산을 통째로 먹고 호스트가 타임아웃·리셋을
#   반복했다 (실기에서 26~38회).
#
#   지연 모드는 로그 스레드가 따로 내보내므로 드라이버 스레드를 막지 않는다.
CONFIG_LOG_MODE_DEFERRED=y
CONFIG_LOG_BUFFER_SIZE=8192

# ⚠ 실기에서 "xlat tables low: 7 of 8 in use" 경고가 났다. device_map 을
#   여러 번 쓰므로(dwc3, GPIO, USB2PHY GRF) 기본값 8 로는 빠듯하다.
CONFIG_MAX_XLAT_TABLES=16

# ⚠ 실기에서 크래시했다 — ELR 과 lr 이 같은 쓰레기 주소(0xffffff80ffffffd0)
#   였다. ret 이 망가진 복귀 주소로 돌아간 것, 즉 스택 손상이다.
#
#   드라이버 스레드 기본값이 1024 바이트인데 CONFIG_LOG_MODE_IMMEDIATE 는
#   호출자 스택에서 로그를 포매팅·출력하므로 훨씬 많이 쓴다. 핸들러 하나가
#   여러 줄을 찍으면 넘친다.
CONFIG_UDC_DWC3_STACK_SIZE=4096

# 다음에 또 넘치면 '쓰레기 점프' 가 아니라 명확한 메시지로 보이게 한다.
# 스택 손상이 원인이 아니었다면 이 설정들이 그것도 알려 준다.
# CONFIG_HW_STACK_PROTECTION 은 이 arm64 타깃에서 지원되지 않는다.
# 소프트웨어 감시자(sentinel)로 대신한다 — 넘치면 명확히 알려 준다.
# 넘침을 쓰레기 점프가 아니라 명확한 메시지로 보이게 한다.
# (기동을 깨뜨린 것은 FRAME_POINTER 였고 이것은 무해했다)
CONFIG_STACK_SENTINEL=y
CONFIG_THREAD_NAME=y
CONFIG_THREAD_STACK_INFO=y
# CONFIG_STACK_USAGE=y   # 기동 실패 원인 가리기 위해 임시로 끔
# CONFIG_INIT_STACKS=y   # 기동 실패 원인 가리기 위해 임시로 끔

# CONFIG_DEBUG_THREAD_INFO=y   # 기동 실패 원인 가리기 위해 임시로 끔

# ⚠ CONFIG_FRAME_POINTER / CONFIG_EXCEPTION_STACK_TRACE 를 켜면 Zephyr 가
#   기동조차 하지 못했다 (LED 도 콘솔도 무음). 실기에서 확인했으므로 쓰지
#   않는다. 역추적 없이 로그로 위치를 좁힌다.

# ⚠ usbd 스레드 스택 — Zephyr 기본값 1024 로는 넘친다 (실기 확인:
#   "FATAL ERROR 2: Stack overflow", Current thread: usbd).
#
#   1024 는 32비트 MCU 기준 값이다. arm64 는 64비트 레지스터 31개라
#   문맥 저장만으로도 크고, CONFIG_LOG_MODE_IMMEDIATE 는 로그를 호출자
#   스택에서 포매팅한다. 이 보드의 다른 스택(main·workqueue·ISR·idle)은
#   이미 4096 인데 이것만 기본값으로 남아 있었다.
CONFIG_USBD_THREAD_STACK_SIZE=4096

# 직렬번호 문자열 디스크립터를 위해 hwinfo 를 켠다.
# 구현은 drivers/hwinfo/hwinfo_rk3566.c (자리표 — 주석 참고).
CONFIG_HWINFO=y

# 이 앱은 LED 를 직접 다룬다 — 보드 공용 상태 LED(soc_init/moru_led.c)를 끈다
CONFIG_MORU_LED=n
```

## app.overlay
```dts
/*
 * CDC-ACM 클래스 노드만 만든다. chosen zephyr,console 은 건드리지 않아
 * 보드 DTS 의 &uart2 (115200) 가 그대로 콘솔로 쓰인다.
 *
 * SPDX-License-Identifier: Apache-2.0
 */

&zephyr_udc0 {
	cdc_acm_uart0: cdc_acm_uart0 {
		compatible = "zephyr,cdc-acm-uart";
	};
};
```

## src/main.c
```c
/*
 * Radxa ZERO 3E — dwc3 실기 진단.
 *
 * SPDX-License-Identifier: Apache-2.0
 *
 * 콘솔은 UART2 @ 115200 (보드 DTS 의 기본값), USB 스택은 켜져 있다.
 * 목적은 dwc3 드라이버가 초기화하면서 찍는 값들을 사람이 읽는 것이다 —
 * GSNPSID, GHWPARAMS3, 코어 리셋 결과, PRTCAPDIR 반영 여부, DEPCMD 상태,
 * 그리고 버스 이벤트(USB_RESET)가 오는지.
 *
 * LED 도 함께 깜박인다. 시리얼이 조용하거나 글자가 깨져도 Zephyr 가
 * 살아 있는지는 LED 로 알 수 있다 — 보율 문제와 기동 실패를 구분해 준다.
 *
 * 배선: 어댑터 RXD -> 보드 8번 · TXD -> 10번 · GND -> 6번
 *       (핀 이름은 보드 기준이라 어댑터와 교차한다)
 * 읽기: tio /dev/cu.usbserial-0001 -b 115200
 *       글자가 깨지면 -b 125000 으로 재시도 (UART 클럭이 12 MHz 인 경우)
 */

#include <zephyr/kernel.h>
#include <zephyr/sys/sys_io.h>
#include <zephyr/sys/device_mmio.h>
#include <zephyr/logging/log.h>

LOG_MODULE_REGISTER(bringup, LOG_LEVEL_INF);

#define GPIO0_PHYS		0xfdd60000UL
#define GPIO0_SIZE		0x100
#define RK_GPIO_SWPORT_DR_L	0x00
#define RK_GPIO_SWPORT_DDR_L	0x08
#define LED_PIN			0U

static inline uint32_t rk_gpio_val(uint32_t pin, bool on)
{
	uint32_t we = BIT(pin + 16);

	return on ? (we | BIT(pin)) : we;
}

static void led_thread(void *a, void *b, void *c)
{
	mm_reg_t base;

	ARG_UNUSED(a); ARG_UNUSED(b); ARG_UNUSED(c);

	device_map(&base, GPIO0_PHYS, GPIO0_SIZE, K_MEM_CACHE_NONE);
	sys_write32(rk_gpio_val(LED_PIN, true), base + RK_GPIO_SWPORT_DDR_L);

	while (1) {
		sys_write32(rk_gpio_val(LED_PIN, true),
			    base + RK_GPIO_SWPORT_DR_L);
		k_msleep(2000);
		sys_write32(rk_gpio_val(LED_PIN, false),
			    base + RK_GPIO_SWPORT_DR_L);
		k_msleep(2000);
	}
}

/*
 * ⚠ 스택 4096 — 1024 로 두었다가 실기에서 크래시했다.
 *
 *   arm64 는 64비트 레지스터 31개라 문맥 저장만 256바이트를 넘고,
 *   device_map() 은 MMU 페이지테이블 작업을 한다. 1024 로는 넘친다.
 *   증상: CPU 예외, ELR=FAR=lr=0x0 (복귀 주소가 0 으로 덮임),
 *   x7~x18 전부 쓰레기, Current thread: led_tid.
 *
 *   ⚠ 진단용으로 넣은 이 스레드 자체가 크래시 원인이었다. 드라이버
 *     스택(CONFIG_UDC_DWC3_STACK_SIZE)을 늘려도 변화가 없던 이유다.
 */
K_THREAD_DEFINE(led_tid, 4096, led_thread, NULL, NULL, NULL, 7, 0, 0);

int main(void)
{
	uint32_t n = 0;

	printk("\n");
	printk("=====================================\n");
	printk(" PiZZa — Radxa Zero 3E dwc3 bringup\n");
	printk(" console: uart2 @ 115200\n");
	printk("=====================================\n");

	while (1) {
		LOG_INF("alive %u", n++);
		k_msleep(5000);
	}

	return 0;
}
```
