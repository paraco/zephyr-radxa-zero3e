## CMakeLists.txt
```
cmake_minimum_required(VERSION 3.20.0)
# 모델 가중치 창은 **공용 파일 하나**를 쓴다 — 앱마다 복사해 두면 주소를
# 고칠 때 갈린다 (실제로 실기 DRAM 끝을 넘는 주소가 여섯 군데에 퍼져 있었다).
set(EXTRA_DTC_OVERLAY_FILE
    "${CMAKE_CURRENT_SOURCE_DIR}/../llm_common/model_blob.overlay")

# 사다리 공용 Kconfig 조각 — uart2 인터럽트 폭주를 끈다 (사이클의 77%).
# 근거와 측정값은 그 파일에 있다. ⚠ prj.conf **뒤에** 병합되므로 그 파일이 이긴다.
set(EXTRA_CONF_FILE
    "${CMAKE_CURRENT_SOURCE_DIR}/../llm_common/ladder.conf")

find_package(Zephyr REQUIRED HINTS $ENV{ZEPHYR_BASE})
project(llm_l3)

# ggml 소스를 **그대로** 가져온다. 계획의 B안(ggml CPU 백엔드 포팅)에서
# 핵심 질문은 "ggml 의 C 가 Zephyr 로 그대로 빌드되는가" 다. 재구현하면
# 그 질문을 피해 가는 것이고, 재구현의 버그를 ggml 의 버그로 착각하게 된다.
set(LLAMA_DIR "${CMAKE_CURRENT_SOURCE_DIR}/../../../upstream/llama.cpp"
    CACHE PATH "llama.cpp 체크아웃")
if(NOT EXISTS "${LLAMA_DIR}/ggml/src/ggml-quants.c")
  message(FATAL_ERROR "ggml 소스를 못 찾았다: ${LLAMA_DIR}\n"
                      "  git clone --depth 1 https://github.com/ggml-org/llama.cpp "
                      "${LLAMA_DIR}")
endif()

target_sources(app PRIVATE src/main.c src/ggml_stubs.c
                           ${LLAMA_DIR}/ggml/src/ggml-quants.c)
target_include_directories(app PRIVATE
	${LLAMA_DIR}/ggml/include
	${LLAMA_DIR}/ggml/src
	${LLAMA_DIR}/ggml/src/ggml-cpu)
```

## prj.conf
```kconfig
CONFIG_PRINTK=y
CONFIG_BOOT_BANNER=n
CONFIG_MAIN_STACK_SIZE=16384
CONFIG_MAX_XLAT_TABLES=24
# ggml-quants.c 가 malloc/qsort/math 를 쓴다
CONFIG_COMMON_LIBC_MALLOC=y
CONFIG_COMMON_LIBC_MALLOC_ARENA_SIZE=65536
CONFIG_NEWLIB_LIBC=n

# ⚠ **로그를 동기(immediate)로 만든다 — 쓰는 주체를 하나로 유지한 채.**
#
# 보드 defconfig 에 CONFIG_LOG=y 가 있어(dwc3 드라이버용) printk 가 기본으로
# 로그 시스템을 거친다. 기본 조합이 이렇다:
#     CONFIG_LOG_MODE_DEFERRED=y
#     CONFIG_LOG_BUFFER_SIZE=1024              ← 1 KB
#     CONFIG_LOG_PROCESS_THREAD_SLEEP_MS=1000  ← 로그 스레드가 1초씩 잔다
#     CONFIG_MAIN_THREAD_PRIORITY=0            ← main 이 그 스레드를 선점한다
# 사다리 앱은 80자 수십 줄을 main 에서 쏟으므로 버퍼가 넘쳐 **앞부분이
# 버려진다**(2026-11-07 L5b 첫 실기 투입에서 꼬리만 남았다).
#
# ⚠ 처음에 `CONFIG_LOG_PRINTK=n` 으로 고치려 했다가 **보드가 멈췄다.**
#   그러면 UART2 에 쓰는 주체가 둘이 된다 — printk(main, 동기)와 로그
#   백엔드(로그 스레드). 같은 인터럽트 구동 UART 를 동시에 건드려 교착한
#   것으로 보인다(dwc3 로그 한 줄만 나오고 멈췄다).
#
# 그래서 LOG_PRINTK 는 기본(y) 그대로 두고 **모드만 동기로** 바꾼다.
# 버퍼도 스레드도 쓰지 않으므로 유실이 없고 쓰는 주체는 하나다.
#
# ⚠ moru 는 이 설정을 쓰면 안 된다 — 동기 출력이 줄당 ~9 ms 를 잡아먹어
#   USB 열거의 SET_ADDRESS 50 ms 예산을 넘긴다(docs/hardware-verified.md).
#   사다리 앱은 USB 를 열거하지 않으므로 무해하다.
CONFIG_LOG_MODE_IMMEDIATE=y
```

## src/main.c
```c
/*
 * L3 — 역양자화 관문. **허용 오차 0 — 비트 일치**다.
 *
 * ggml 의 C 구현(dequantize_row_q4_0 / dequantize_row_q4_K)을 Zephyr 로
 * 그대로 빌드해 돌리고, 같은 코드를 호스트에서 돌린 결과와 비트 단위로
 * 비교한다. 재구현하지 않는다 — 계획의 B안이 ggml 포팅이고, 재구현하면
 * 그 질문을 피해 갈 뿐 아니라 재구현의 버그를 ggml 의 버그로 착각하게 된다.
 *
 * 골든값: src/l3_golden.h (tools/l3_golden.sh 가 만든다).
 *
 * 왜 비트 일치인가: 정수 언팩 + 고정 스케일 곱이다. 다르면 구현이 틀린 것이다.
 * 실제로 골든값에 **음의 0(0x80000000)** 이 들어 있다 — x0=0 이고 스케일이
 * 음수인 경우다. +0.0 을 내는 구현은 값으로는 같고 비트로는 다르다.
 */
#include <zephyr/kernel.h>
#include <zephyr/devicetree.h>
#include <string.h>
#include <stdint.h>
#include <inttypes.h>

#include "ggml-quants.h"
#include "l3_golden.h"

#define BLOB_ADDR	DT_REG_ADDR(DT_NODELABEL(model_blob))

static uint32_t bits(float f) { uint32_t b; memcpy(&b, &f, 4); return b; }

static int compare(const char *what, const float *got, const uint32_t *golden, int n)
{
	int bad = 0;

	printk("  %s %d개 ... ", what, n);
	for (int i = 0; i < n; i++) {
		if (bits(got[i]) != golden[i]) {
			if (bad < 4) {
				printk("\n      [%d] 얻음 0x%08x  골든 0x%08x", i, bits(got[i]), golden[i]);
				if ((bits(got[i]) ^ golden[i]) == 0x80000000u) {
					printk("   ← **부호만 다르다 (음의 0?)**");
				}
			}
			bad++;
		}
	}
	if (bad == 0) {
		printk("OK — 비트 일치\n");
		return 0;
	}
	printk("\n      FAIL — %d/%d 비트 불일치\n", bad, n);
	return 1;
}

static float y40[L3_Q4_0_N];
static float y4k[L3_Q4_K_N];

int main(void)
{
	int fail = 0;
	const uint8_t *blob = (const uint8_t *)(uintptr_t)BLOB_ADDR;

	printk("=== L3: 역양자화 관문 (허용 오차 0 — 비트 일치) ===\n");
	printk("  ggml 소스를 그대로 빌드했다: dequantize_row_q4_0 / _q4_K\n");

	/*
	 * [0a] 블롭이 실제로 적재됐는가.
	 * ⚠ 이 검사가 없으면 L_BLOB 을 빼먹었을 때 전부 0 인 메모리를 역양자화해
	 *   Q4_0 은 -8×0 = **-0.0**, Q4_K 는 0×0-0 = **+0.0** 이 나온다. 그럴듯한
	 *   부동소수 값이라 "포팅이 틀렸다" 로 오진하게 된다 — 실제로 한 번 겪었다.
	 */
	printk("  [0a] 블롭 매직 ... ");
	uint32_t magic = 0;
	memcpy(&magic, blob, 4);
	if (magic == 0x46554747u) {
		printk("OK ('GGUF')\n");
	} else {
		printk("FAIL — 0x%08x. 블롭이 없다.\n", magic);
		printk("       L_BLOB=<gguf> ./tools/qemu_run.sh apps/llm_l3 로 돌려라\n");
		printk("=== L3 FAIL (실패 1) ===\n");
		return 0;
	}

	/* 블록 구조체 크기가 ggml 과 같은가 — 패딩이 다르면 전부 어긋난다 */
	printk("  [0] 블록 크기 q4_0=%u q4_K=%u ... ",
	       (unsigned)sizeof(block_q4_0), (unsigned)sizeof(block_q4_K));
	if (sizeof(block_q4_0) == 18 && sizeof(block_q4_K) == 144) {
		printk("OK\n");
	} else {
		printk("FAIL — 기대 18 / 144\n");
		fail++;
	}

	dequantize_row_q4_0((const block_q4_0 *)(blob + L3_Q4_0_FILE_OFF), y40, L3_Q4_0_N);
	fail += compare("[1] Q4_0", y40, l3_q4_0_golden_bits, L3_Q4_0_N);

	dequantize_row_q4_K((const block_q4_K *)(blob + L3_Q4_K_FILE_OFF), y4k, L3_Q4_K_N);
	fail += compare("[2] Q4_K", y4k, l3_q4_k_golden_bits, L3_Q4_K_N);

	if (fail == 0) {
		printk("=== L3 PASS (실패 0) ===\n");
	} else {
		printk("=== L3 FAIL (실패 %d) ===\n", fail);
	}
	return 0;
}
```

## src/ggml_stubs.c
```c
/* ggml-quants.c 의 **양자화** 경로만 쓰는 심볼들. 역양자화는 쓰지 않는다.
 * 불려도 조용히 틀린 값이 나오지 않게 큰 소리로 죽는다. */
#include <zephyr/kernel.h>
#include <stdarg.h>
#include <stddef.h>
#include "ggml.h"

void ggml_abort(const char *file, int line, const char *fmt, ...)
{
	printk("ggml_abort %s:%d: %s\n", file, line, fmt);
	k_panic();
}
size_t ggml_row_size(enum ggml_type t, int64_t n) { (void)t; (void)n; printk("스텁 ggml_row_size\n"); k_panic(); return 0; }
const char *ggml_type_name(enum ggml_type t) { (void)t; printk("스텁 ggml_type_name\n"); k_panic(); return ""; }
size_t ggml_type_size(enum ggml_type t) { (void)t; printk("스텁 ggml_type_size\n"); k_panic(); return 0; }
```

## src/l3_golden.h
```c
/*
 * l3_golden.h — 생성 파일이다. 손으로 고치지 않는다.
 *
 *   $ ./tools/l3_golden.sh
 *
 * 출처: ggml 의 C 구현 dequantize_row_q4_0 / dequantize_row_q4_K 를
 * 호스트에서 **그대로 호출한** 결과다. 파이썬 역양자화기를 쓰지 않았다 —
 * L3 의 허용 오차가 0(비트 일치)이고 연산 결합 순서가 다르면 반올림이
 * 달라지기 때문이다.
 *
 * f32 를 비트 패턴으로 적는다. 10진수로는 비트 일치를 확인할 수 없다.
 */
#ifndef L3_GOLDEN_H
#define L3_GOLDEN_H

#include <stdint.h>

#define L3_Q4_0_BLOCKS 4
#define L3_Q4_0_N      128
#define L3_Q4_K_BLOCKS 2
#define L3_Q4_K_N      512
#define L3_QK4_0       32
#define L3_QK_K        256

#define L3_Q4_0_FILE_OFF 3488u  /* 데이터 시작 + 텐서 오프셋 */
#define L3_Q4_K_FILE_OFF 3584u

static const uint32_t l3_q4_0_golden_bits[L3_Q4_0_N] = {
	0x3ea48000u, 0x3ea48000u, 0x80000000u, 0xbf76c000u, 0x3ea48000u, 0xbfa48000u, 0x3f76c000u, 0x3ea48000u,
	0xbea48000u, 0x3f248000u, 0xbf76c000u, 0x3ea48000u, 0x3ea48000u, 0x3ea48000u, 0x80000000u, 0xbf248000u,
	0xbfcda000u, 0x3f248000u, 0xbf248000u, 0x3fcda000u, 0x80000000u, 0x40248000u, 0xbea48000u, 0x80000000u,
	0xbf76c000u, 0xbff6c000u, 0xbff6c000u, 0x80000000u, 0x3f248000u, 0xbf248000u, 0xbf76c000u, 0xbfa48000u,
	0xbf5e0000u, 0x3f5e0000u, 0x3fa68000u, 0x3ede0000u, 0x3ede0000u, 0xbfde0000u, 0xbf5e0000u, 0x405e0000u,
	0xbede0000u, 0x80000000u, 0x3f5e0000u, 0x80000000u, 0xbede0000u, 0xbfa68000u, 0xbf5e0000u, 0x3f5e0000u,
	0x3ede0000u, 0x3f5e0000u, 0xbede0000u, 0xbf5e0000u, 0x3ede0000u, 0x3ede0000u, 0x80000000u, 0xbede0000u,
	0x3f5e0000u, 0xbfa68000u, 0x40268000u, 0xbfde0000u, 0xbede0000u, 0xbede0000u, 0x3ede0000u, 0x400ac000u,
	0xbfc1c000u, 0x3f688000u, 0x00000000u, 0x3fc1c000u, 0xc01b0000u, 0x3fc1c000u, 0xbf9b0000u, 0xbf1b0000u,
	0xbe9b0000u, 0xbf1b0000u, 0x3e9b0000u, 0xbfc1c000u, 0x3f1b0000u, 0x00000000u, 0x3f688000u, 0xbf688000u,
	0xbf1b0000u, 0x00000000u, 0xbe9b0000u, 0xbf688000u, 0xbfc1c000u, 0xbf9b0000u, 0xbf1b0000u, 0x00000000u,
	0x00000000u, 0xbf1b0000u, 0x3f1b0000u, 0xbf9b0000u, 0x3f688000u, 0xc01b0000u, 0x3f1b0000u, 0xbfe88000u,
	0x3f9b3c00u, 0xbf786000u, 0xbf9b3c00u, 0x3ef86000u, 0x3f786000u, 0xbe786000u, 0x3f786000u, 0x3fba4800u,
	0xbf3a4800u, 0xbf3a4800u, 0x3fba4800u, 0xbef86000u, 0xbe786000u, 0x3f786000u, 0xbff86000u, 0x3f3a4800u,
	0xbe786000u, 0x3f9b3c00u, 0x3ef86000u, 0xbf786000u, 0x3e786000u, 0x3e786000u, 0xbe786000u, 0x3ef86000u,
	0x3f3a4800u, 0x3e786000u, 0xbef86000u, 0xbef86000u, 0xbf786000u, 0x3e786000u, 0x00000000u, 0x3e786000u,
};

static const uint32_t l3_q4_k_golden_bits[L3_Q4_K_N] = {
	0x414865e0u, 0x414432f0u, 0x41456610u, 0x414432f0u, 0x41413320u, 0x4148ff70u, 0x41456610u, 0x414432f0u,
	0x4147cc50u, 0x4145ffa0u, 0x41469930u, 0x41400000u, 0x41400000u, 0x41400000u, 0x4148ff70u, 0x414865e0u,
	0x41400000u, 0x41469930u, 0x414865e0u, 0x4144cc80u, 0x41400000u, 0x4144cc80u, 0x4142ffd0u, 0x41456610u,
	0x414432f0u, 0x41413320u, 0x4148ff70u, 0x41409990u, 0x4145ffa0u, 0x4145ffa0u, 0x4144cc80u, 0x4142ffd0u,
	0x408e6280u, 0x40ad93c0u, 0x40200000u, 0x40c25f40u, 0x40b7f980u, 0x4098c840u, 0x40ebf640u, 0x4034cb80u,
	0x40ebf640u, 0x40ccc500u, 0x405e6280u, 0x4098c840u, 0x40ccc500u, 0x40c25f40u, 0x40ccc500u, 0x40ebf640u,
	0x40ebf640u, 0x40a32e00u, 0x4034cb80u, 0x405e6280u, 0x40ebf640u, 0x40ccc500u, 0x408e6280u, 0x4034cb80u,
	0x405e6280u, 0x40499700u, 0x40c25f40u, 0x40c25f40u, 0x40499700u, 0x40ad93c0u, 0x40c25f40u, 0x4083fcc0u,
	0x41ec0000u, 0x41ee1978u, 0x41ecb328u, 0x41ecb328u, 0x41f51908u, 0x41f032f0u, 0x41f032f0u, 0x41f19940u,
	0x41f0e618u, 0x41f2ff90u, 0x41f2ff90u, 0x41f0e618u, 0x41f032f0u, 0x41f24c68u, 0x41f19940u, 0x41f0e618u,
	0x41eecca0u, 0x41ec0000u, 0x41f2ff90u, 0x41ec0000u, 0x41ecb328u, 0x41ecb328u, 0x41ec0000u, 0x41ed6650u,
	0x41ee1978u, 0x41f465e0u, 0x41f0e618u, 0x41ee1978u, 0x41ee1978u, 0x41ed6650u, 0x41f2ff90u, 0x41eecca0u,
	0x41103230u, 0x41103230u, 0x4101ccb0u, 0x410e6580u, 0x4108ff70u, 0x41103230u, 0x411afe50u, 0x410c98d0u,
	0x411afe50u, 0x4101ccb0u, 0x41103230u, 0x410732c0u, 0x41000000u, 0x41039960u, 0x41039960u, 0x41000000u,
	0x410732c0u, 0x41159840u, 0x410732c0u, 0x410e6580u, 0x410c98d0u, 0x4101ccb0u, 0x4101ccb0u, 0x41000000u,
	0x41159840u, 0x41039960u, 0x411931a0u, 0x41000000u, 0x411931a0u, 0x4101ccb0u, 0x41039960u, 0x411afe50u,
	0x418cffb0u, 0x41897fe8u, 0x418affd0u, 0x41880000u, 0x4189ffe0u, 0x418cffb0u, 0x418f7f88u, 0x41897fe8u,
	0x418bffc0u, 0x418eff90u, 0x41887ff8u, 0x418b7fc8u, 0x418affd0u, 0x418f7f88u, 0x418affd0u, 0x418b7fc8u,
	0x418dffa0u, 0x418cffb0u, 0x418cffb0u, 0x418dffa0u, 0x418affd0u, 0x4188fff0u, 0x418a7fd8u, 0x418affd0u,
	0x418a7fd8u, 0x418dffa0u, 0x418b7fc8u, 0x418dffa0u, 0x4189ffe0u, 0x418e7f98u, 0x418dffa0u, 0x4189ffe0u,
	0x407bf640u, 0x3fc00000u, 0x41052c60u, 0x40cbf640u, 0x408d93c0u, 0x3fc00000u, 0x407bf640u, 0x403d93c0u,
	0x405cc500u, 0x410cf8b0u, 0x405cc500u, 0x40cbf640u, 0x40eb2780u, 0x3fc00000u, 0x40fac020u, 0x407bf640u,
	0x407bf640u, 0x407bf640u, 0x405cc500u, 0x41052c60u, 0x403d93c0u, 0x40db8ee0u, 0x403d93c0u, 0x40bc5da0u,
	0x403d93c0u, 0x410cf8b0u, 0x409d2c60u, 0x408d93c0u, 0x408d93c0u, 0x40db8ee0u, 0x40bc5da0u, 0x40fac020u,
	0x41880000u, 0x41880000u, 0x419a3210u, 0x41880000u, 0x418fcc50u, 0x419f64f0u, 0x41ac6420u, 0x41aefd90u,
	0x419ccb80u, 0x41aefd90u, 0x41880000u, 0x41a1fe60u, 0x418fcc50u, 0x41a1fe60u, 0x41a9cab0u, 0x41a9cab0u,
	0x41a1fe60u, 0x41ac6420u, 0x419ccb80u, 0x419a3210u, 0x419f64f0u, 0x4194ff30u, 0x418a9970u, 0x41ac6420u,
	0x419a3210u, 0x41a497d0u, 0x419798a0u, 0x418d32e0u, 0x419798a0u, 0x419a3210u, 0x41ac6420u, 0x41a9cab0u,
	0x41c32fc0u, 0x41b563d0u, 0x41909950u, 0x4199cbf0u, 0x41be9670u, 0x41a797e0u, 0x41909950u, 0x41be9670u,
	0x41ac3130u, 0x41cc6260u, 0x41ac3130u, 0x41d0fbb0u, 0x418c0000u, 0x41d0fbb0u, 0x41be9670u, 0x41b9fd20u,
	0x41c32fc0u, 0x419532a0u, 0x41909950u, 0x41c7c910u, 0x41b0ca80u, 0x41ac3130u, 0x41b9fd20u, 0x419e6540u,
	0x4199cbf0u, 0x41c32fc0u, 0x41b9fd20u, 0x41c7c910u, 0x41c32fc0u, 0x41b9fd20u, 0x41909950u, 0x41b0ca80u,
	0xc139eb80u, 0xc13b5c20u, 0xc13c51e0u, 0xc13cccc0u, 0xc13ae140u, 0xc13e3d60u, 0xc13eb840u, 0xc13a6660u,
	0xc13eb840u, 0xc13cccc0u, 0xc13c51e0u, 0xc13e3d60u, 0xc13f3320u, 0xc13b5c20u, 0xc13bd700u, 0xc13b5c20u,
	0xc13dc280u, 0xc13bd700u, 0xc13f3320u, 0xc13a6660u, 0xc1380000u, 0xc13c51e0u, 0xc13a6660u, 0xc139eb80u,
	0xc13d47a0u, 0xc1387ae0u, 0xc13f3320u, 0xc13e3d60u, 0xc13b5c20u, 0xc13dc280u, 0xc13e3d60u, 0xc13d47a0u,
	0xc1c7ff10u, 0xc1c1ff20u, 0xc1afff50u, 0xc173ffc0u, 0xc185ffc0u, 0xc185ffc0u, 0xc15c0000u, 0xc17fffa0u,
	0xc1a9ff60u, 0xc173ffc0u, 0xc1c7ff10u, 0xc18bffb0u, 0xc167ffe0u, 0xc1a3ff70u, 0xc197ff90u, 0xc173ffc0u,
	0xc1a9ff60u, 0xc15c0000u, 0xc1c1ff20u, 0xc185ffc0u, 0xc1bbff30u, 0xc1c1ff20u, 0xc18bffb0u, 0xc15c0000u,
	0xc19dff80u, 0xc1c1ff20u, 0xc191ffa0u, 0xc17fffa0u, 0xc1a9ff60u, 0xc191ffa0u, 0xc191ffa0u, 0xc191ffa0u,
	0xc1d3ad30u, 0xc18a3d50u, 0xc1c76fe0u, 0xc1f86520u, 0xc214ad30u, 0xc2086fe0u, 0xc2025138u, 0xc1aef540u,
	0xc18a3d50u, 0xc18a3d50u, 0xc20e8e88u, 0xc17c0000u, 0xc1a2b7f0u, 0xc2086fe0u, 0xc21acbd8u, 0xc214ad30u,
	0xc1ec27d0u, 0xc18a3d50u, 0xc1c76fe0u, 0xc214ad30u, 0xc1ec27d0u, 0xc1a2b7f0u, 0xc2025138u, 0xc18a3d50u,
	0xc21acbd8u, 0xc1c76fe0u, 0xc1f86520u, 0xc1ec27d0u, 0xc1aef540u, 0xc1f86520u, 0xc17c0000u, 0xc1ec27d0u,
	0xc13bd700u, 0xc13bd700u, 0xc14f0a00u, 0xc14b3300u, 0xc14f0a00u, 0xc169eb00u, 0xc16dc200u, 0xc1380000u,
	0xc16dc200u, 0xc15a8f00u, 0xc169eb00u, 0xc1719900u, 0xc1380000u, 0xc1623d00u, 0xc13bd700u, 0xc169eb00u,
	0xc14b3300u, 0xc1719900u, 0xc1623d00u, 0xc1438500u, 0xc1438500u, 0xc152e100u, 0xc1719900u, 0xc14b3300u,
	0xc14b3300u, 0xc152e100u, 0xc13bd700u, 0xc1661400u, 0xc13fae00u, 0xc1438500u, 0xc1661400u, 0xc169eb00u,
	0xc1981310u, 0xc0b8f480u, 0xc1b65030u, 0xc078f480u, 0xc1a731a0u, 0xc13731a0u, 0xc1e3abe0u, 0xc1a731a0u,
	0xc1981310u, 0xc1a731a0u, 0xc0f56ec0u, 0xc1f2ca70u, 0xc0f56ec0u, 0xc1d48d50u, 0xc1a731a0u, 0xc1981310u,
	0xc0b8f480u, 0xc118f480u, 0xc1e3abe0u, 0xc118f480u, 0xc1981310u, 0xc13731a0u, 0xc1e3abe0u, 0xc0000000u,
	0xc0f56ec0u, 0xc173abe0u, 0xc0f56ec0u, 0xc0b8f480u, 0xc1556ec0u, 0xc0f56ec0u, 0xc1a731a0u, 0xc1f2ca70u,
	0xc17a6460u, 0xc089eb40u, 0xc16d6ec0u, 0xc12ca2a0u, 0xc0d7ad00u, 0xc16d6ec0u, 0xc1468de0u, 0xc0a3d680u,
	0xc16d6ec0u, 0xc0a3d680u, 0xc17a6460u, 0xc0600000u, 0xc0bdc1c0u, 0xc12ca2a0u, 0xc0f19840u, 0xc11fad00u,
	0xc11fad00u, 0xc17a6460u, 0xc1607920u, 0xc089eb40u, 0xc16d6ec0u, 0xc0f19840u, 0xc1399840u, 0xc0600000u,
	0xc16d6ec0u, 0xc0a3d680u, 0xc16d6ec0u, 0xc1468de0u, 0xc0600000u, 0xc0a3d680u, 0xc0600000u, 0xc0600000u,
	0xc0e80000u, 0xc0e80000u, 0xc0e80000u, 0xc0e80000u, 0xc0e80000u, 0xc0e80000u, 0xc0e80000u, 0xc0e80000u,
	0xc0e80000u, 0xc0e80000u, 0xc0e80000u, 0xc0e80000u, 0xc0e80000u, 0xc0e80000u, 0xc0e80000u, 0xc0e80000u,
	0xc0e80000u, 0xc0e80000u, 0xc0e80000u, 0xc0e80000u, 0xc0e80000u, 0xc0e80000u, 0xc0e80000u, 0xc0e80000u,
	0xc0e80000u, 0xc0e80000u, 0xc0e80000u, 0xc0e80000u, 0xc0e80000u, 0xc0e80000u, 0xc0e80000u, 0xc0e80000u,
	0xc1a06520u, 0xc1aca270u, 0xc1d15a60u, 0xc0980000u, 0xc0c8f540u, 0xc0980000u, 0xc1775a60u, 0xc1c51d10u,
	0xc1c51d10u, 0xc1466520u, 0xc1c51d10u, 0xc187ea80u, 0xc1b8dfc0u, 0xc1466520u, 0xc1a06520u, 0xc1a06520u,
	0xc1b8dfc0u, 0xc1b8dfc0u, 0xc1aca270u, 0xc1b8dfc0u, 0xc1a06520u, 0xc1156fe0u, 0xc1b8dfc0u, 0xc1dd97b0u,
	0xc0c8f540u, 0xc12dea80u, 0xc15edfc0u, 0xc0f9ea80u, 0xc1aca270u, 0xc19427d0u, 0xc0f9ea80u, 0xc1d15a60u,
};

#endif /* L3_GOLDEN_H */
```
