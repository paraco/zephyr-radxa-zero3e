## CMakeLists.txt
```
cmake_minimum_required(VERSION 3.20.0)
# 모델 가중치 창은 **공용 파일 하나**를 쓴다 (llm_l5b 와 같은 이유).
set(EXTRA_DTC_OVERLAY_FILE
    "${CMAKE_CURRENT_SOURCE_DIR}/../llm_common/model_blob.overlay;${CMAKE_CURRENT_SOURCE_DIR}/../llm_common/llm_heap.overlay")

# 사다리 공용 Kconfig 조각 — uart2 인터럽트 폭주를 끈다 (사이클의 77%).
# 근거와 측정값은 그 파일에 있다. ⚠ prj.conf **뒤에** 병합되므로 그 파일이 이긴다.
set(EXTRA_CONF_FILE
    "${CMAKE_CURRENT_SOURCE_DIR}/../llm_common/ladder.conf")

find_package(Zephyr REQUIRED HINTS $ENV{ZEPHYR_BASE})
project(llm_l8q)

# ── ggml·llama 소스만 -O3 로 (2026-11-07 밤) ────────────────────────────
#
# Zephyr Kconfig 에는 -O3 선택지가 없다 (SIZE/-Os · SPEED/-O2 · …).
# 업스트림 llama.cpp 는 Release 에서 -O3 를 쓴다. 전역 Kconfig 는 그대로
# 두고(이 앱은 -O2) **ggml·llama 소스와 main 에만** 뒤에 붙여 덮는다
# (gcc 는 마지막 -O 를 쓴다). 커널에는 주지 않는다.
#
# ⚠ include **전에** 세워야 한다 — llm_ggml.cmake 의 set(... CACHE ...) 는
#   FORCE 가 없어 이미 있는 값을 이기지 못한다.
# ⚠ 되돌리기는 이 줄을 지우는 것이다. 그러면 Kconfig 값(-O2)으로 돌아간다.
set(LLM_GGML_OPT_LEVEL "-O3" CACHE STRING "" FORCE)
# ── L8q: repack ON (l6-decisions 결정 1 — L8 에서만 켠다) ─────────────────
# 이 CPU(dotprod 있음 · i8mm 없음)에서 repack.cpp 는 q4_K_8x4 · q5_K_8x4 · q6_K_8x4 를 고른다.
set(LLM_GGML_REPACK ON CACHE BOOL "" FORCE)

include(${CMAKE_CURRENT_SOURCE_DIR}/../../cmake/llm_ggml.cmake)
include(${CMAKE_CURRENT_SOURCE_DIR}/../../cmake/llm_llama.cmake)
llm_add_ggml()
llm_add_llama(L6B)

target_sources(app PRIVATE
	src/main.cpp
	${CMAKE_CURRENT_SOURCE_DIR}/../llm_common/ggml_port.c
	${CMAKE_CURRENT_SOURCE_DIR}/../llm_common/llm_bigheap.c)
# 큰 할당(repack 가중치 등)을 llm_heap 으로 — llm_bigheap.c 머리말
zephyr_ld_options(-Wl,--wrap=posix_memalign -Wl,--wrap=free)
target_include_directories(app PRIVATE src)
llm_ggml_flags(${CMAKE_CURRENT_SOURCE_DIR}/src/main.cpp)
```

## prj.conf
```kconfig
CONFIG_PRINTK=y
CONFIG_BOOT_BANNER=n
# ⚠ 64 KiB 에서 **256 KiB 로 올렸다** (2026-11-07 밤). SMP + n_threads=4 로
#   llama_init_from_model 이 메인 스택을 더 쓴다 (스레드풀 구성·그래프 예약).
#   STACK_SENTINEL 이 잡아 준 지점이 바로 거기다:
#       [3] 문맥 생성 ...
#       >>> ZEPHYR FATAL ERROR 2: Stack overflow on CPU 0
#       Current thread: 0x4045f2c0 (main)      x1 = 0xf0f0f0f0 (센티넬 패턴)
#
#   ⚠ 그 전 시도의 `ELR=0` NULL 점프도 **같은 원인**이었다. 센티넬이 없어
#     복귀 주소가 조용히 깨진 뒤 15.6초에 엉뚱한 곳에서 터졌다. 센티넬을
#     켜니 9.0초에 정확한 지점에서 잡혔다. 진단 설정을 함께 넣은 것이
#     이것을 살렸다 — 스택만 키웠다면 또 오진했다.
CONFIG_MAIN_STACK_SIZE=262144
CONFIG_MAX_XLAT_TABLES=24

CONFIG_CPP=y
CONFIG_STD_CPP17=y
CONFIG_GLIBCXX_LIBCPP=y
CONFIG_CPP_EXCEPTIONS=y
CONFIG_CPP_RTTI=y

CONFIG_POSIX_API=y
CONFIG_THREAD_STACK_INFO=y
CONFIG_DYNAMIC_THREAD=y
CONFIG_DYNAMIC_THREAD_ALLOC=y
# CONFIG_DYNAMIC_THREAD_STACK_SIZE 는 아래 멀티코어 절에서 128 KiB 로 올렸다

# ggml_init 이 mem_size(16 MiB)를 **정렬 할당 한 덩이**로 받는다. 아레나가
# 요청과 같으면 정렬 여유가 없어 실패한다(L4 에서 겪었다). 여러 배로 둔다.
CONFIG_COMMON_LIBC_MALLOC=y
# ⚠ L6a 는 **어휘**를 힙에 올린다 — 248,320 토큰. 토큰마다 std::string 과
#   unordered_map 노드 둘(id→token, token→id)이 생기므로 수십 MB 다.
#   창(sram0)이 128 MiB 라 넉넉히 준다. 실제 사용량은 앱이 찍는다.
# ⚠ **창이 256 MiB 가 된 뒤의 값** (2026-11-07, boards/.../radxa_zero_3e.dts).
#     창 262,144 − 정적 비-아레나 9,604 − 여유 6,780 = 245,760 KiB = **240 MiB**
#
#   왜 이만큼 필요한가 — 128 MiB 창에서 L6b 가 멈춘 이유를 측정했다:
#     모델·어휘 고정          62.5 MB
#     가장 큰 **연속** 블록   27.9 MB   ← 합계는 48.3 MB 였다
#     단편화로 잃은 몫        20.5 MB   ← 어휘가 248,320개 토큰을 작은
#                                        조각으로 할당하고 20 MB 를 돌려준다
#     그 27.9 MB 에서 output 0.95 + KV 3.00 + RS 19.27 를 먼저 떼면 4.7 MB
#     남고, 스케줄러 문맥 13.4 MB 가 들어가지 못했다.
#   즉 총량과 **연속성**이 둘 다 모자랐다. 창을 넓혀 둘 다 푼다.
CONFIG_COMMON_LIBC_MALLOC_ARENA_SIZE=251658240
CONFIG_HEAP_MEM_POOL_SIZE=4194304

# ⚠ 이것이 있어야 malloc_runtime_stats_get() 이 **링크된다**
#   (zephyr/lib/libc/common/source/stdlib/malloc.c:265-280 이 #ifdef 로 감싼다).
#   없으면 undefined reference 로 끝난다 — 겪었다.
#   west build 의 "RAM 79.48%" 는 아레나를 전부 예약으로 세어서 쓸모가 없다.
#   어휘가 실제로 얼마를 쓰는지 알아야 L6b 의 자리가 있는지 가릴 수 있다.
CONFIG_SYS_HEAP_RUNTIME_STATS=y

# ⚠ **로그를 동기(immediate)로 만든다 — 쓰는 주체를 하나로 유지한 채.**
#
# 보드 defconfig 에 CONFIG_LOG=y 가 있어(dwc3 드라이버용) printk 가 기본으로
# 로그 시스템을 거친다. 기본 조합이 이렇다:
#     CONFIG_LOG_MODE_DEFERRED=y
#     CONFIG_LOG_BUFFER_SIZE=1024              ← 1 KB
#     CONFIG_LOG_PROCESS_THREAD_SLEEP_MS=1000  ← 로그 스레드가 1초씩 잔다
#     CONFIG_MAIN_THREAD_PRIORITY=0            ← main 이 그 스레드를 선점한다
# 사다리 앱은 80자 수십 줄을 main 에서 쏟으므로 버퍼가 넘쳐 **앞부분이
# 버려진다**(2026-11-07 L5b 첫 실기 투입에서 꼬리만 남았다).
#
# ⚠ 처음에 `CONFIG_LOG_PRINTK=n` 으로 고치려 했다가 **보드가 멈췄다.**
#   그러면 UART2 에 쓰는 주체가 둘이 된다 — printk(main, 동기)와 로그
#   백엔드(로그 스레드). 같은 인터럽트 구동 UART 를 동시에 건드려 교착한
#   것으로 보인다(dwc3 로그 한 줄만 나오고 멈췄다).
#
# 그래서 LOG_PRINTK 는 기본(y) 그대로 두고 **모드만 동기로** 바꾼다.
# 버퍼도 스레드도 쓰지 않으므로 유실이 없고 쓰는 주체는 하나다.
#
# ⚠ moru 는 이 설정을 쓰면 안 된다 — 동기 출력이 줄당 ~9 ms 를 잡아먹어
#   USB 열거의 SET_ADDRESS 50 ms 예산을 넘긴다(docs/hardware-verified.md).
#   사다리 앱은 USB 를 열거하지 않으므로 무해하다.
CONFIG_LOG_MODE_IMMEDIATE=y

# ── uart2 인터럽트 폭주 ───────────────────────────────────────────────
#
# CONFIG_UART_INTERRUPT_DRIVEN=n 은 이제 **공용 파일**에 있다:
#     apps/llm_common/ladder.conf
# 근거와 측정값(토큰당 23,600 ms → 1,423 ms, 16.6배)도 그 파일에 있다.
# 여기 복사해 두지 않는다 — 복사하면 갈린다.

# ── 멀티코어 (2026-11-07 밤) ────────────────────────────────────────────
#
# L8e 가 실기에서 네 코어를 올렸다:
#     코어 0 MPIDR 0x81000000 · 1 0x81000100 · 2 0x81000200 · 3 0x81000300
#     네 코어 모두 SCTLR C=1 I=1 M=1
# PSCI CPU_ON 이 동작하고 DT 의 Aff1 기반 번호(rk3568.dtsi)가 실측과 맞는다.
#
# ⚠ 이것이 19:27 에는 침묵했다. 바뀐 것은 **UART 폭주 제거**뿐이다
#   (soc_init/dw_uart_busy.c). 폭주가 있으면 SMP 초기화가 무너진다 —
#   정확한 지점은 미확인이다. 그래서 이 설정은 그 고침에 **의존한다.**
CONFIG_SMP=y
CONFIG_MP_MAX_NUM_CPUS=4
CONFIG_PM_CPU_OPS=y
CONFIG_PM_CPU_OPS_PSCI=y

# ggml 의 스레드풀은 pthread 를 쓴다 (ggml-cpu.c:484 의 ggml_thread_create =
# pthread_create, mutex/cond 도 pthread). n_threads=4 면 **워커 3개**를 만든다.
# 기본 상한이 모자라면 pthread_create 가 실패하고 ggml 이 단일 스레드로
# 조용히 떨어진다 — 그러면 '멀티코어가 효과 없다' 로 오진한다. 넉넉히 둔다.
CONFIG_POSIX_THREAD_THREADS_MAX=8

# ⚠ 메인 스레드 외에 워커가 늘어나므로 스택 총량을 다시 본다.
#   워커는 DYNAMIC_THREAD_STACK_SIZE(32 KiB)를 쓴다 → 3 × 32 KiB = 96 KiB.
#   창 여유가 6,780 KB 였으므로 문제 없다.

# ── 4스레드 첫 시도의 충돌 (2026-11-07 밤) ──────────────────────────────
#
# 첫 시도에서 **1단계는 성공했다** — id 11, 로짓 13.078794, 호스트와 일치,
# **450 ms** (1스레드 1452 ms 대비 3.2배). 그 직후 죽었다:
#
#     ESR 0x86000005 · EC 0x21 (Instruction Abort, EL 변화 없음)
#     ELR=0 · FAR=0 → **NULL 로 점프**
#     x3 = 0xfe660000 (UART 베이스) · TPIDRRO 0x02000000… (cpu 2)
#     출력이 두 코어에서 섞여 찍혔다
#
# 복귀 주소가 0 으로 깨지는 것은 **스택 넘침**의 전형이다. 워커는
# pthread_create(NULL attr) 로 만들어지고, Zephyr 는 그때
# CONFIG_DYNAMIC_THREAD_STACK_SIZE 를 쓴다
# (subsys/portability/posix/options/pthread.c:40-41). 32 KiB 였다.
#
# ⚠ 그리고 이 모델은 **융합 커널**을 켠다 (로그의 resolve_fused_ops:
#   fused DeepSeek V4 HC pre/comb/post enabled). 그런 커널은 큰 스택
#   버퍼를 쓸 수 있다.
#
# 추측을 끝낸다 — 둘을 함께 넣는다. 하나는 고침 후보, 하나는 **진단**이다:
#   · 스택을 128 KiB 로 (워커 3개 × 128 KiB = 384 KiB. 창 여유 6.7 MB)
#   · STACK_SENTINEL 로 넘침을 **잡아서 알려 주게** 한다. 지금은 넘쳐도
#     조용히 NULL 로 뛴다 — 그러면 원인을 가릴 수 없다
#
# ⚠ CONFIG_FRAME_POINTER / EXCEPTION_STACK_TRACE 는 **켜지 않는다.**
#   이 보드에서 켜면 기동 자체가 안 된다 (docs/hardware-verified.md).
CONFIG_DYNAMIC_THREAD_STACK_SIZE=131072
CONFIG_STACK_SENTINEL=y
CONFIG_THREAD_NAME=y
```

## src/main.cpp
```c
/*
 * L8q — L8p 를 **repack 켜고** 다시 (GGML_CPU_REPACK · q4_K/q5_K/q6_K_8x4 · 가중치는 llm_heap).
 *
 * 더 하는 것: [0] 적재 시간·llm_heap 사용량 [C] L7b 'chat' 정답 대조(1등 + 이어서 8) — repack 은
 * 누산 순서를 바꾸므로 답이 크게 달라지지 않는지 [G] 생성 속도(이어서 32 토큰).
 *
 * (아래는 L8p 설명)
 * L8p — 배치 prefill 이 왜 느린가: 연산(op)별 시간.
 *
 * L7b 실측: 55 토큰을 한 배치로 7,378 ms · 하나씩 14,999 ms — 배치가 2 배만 빠르다.
 * 가중치를 한 번 읽어 여러 토큰에 쓰면 보통 몇 배 이상 빨라야 한다.
 *
 * 방법: llama_context_params.cb_eval 로 그래프의 **노드마다** 끝난 시각을 받아
 * (앞 노드와의 차이 = 그 노드의 계산 시간) "연산 · src0 형" 별로 모은다.
 *   A. 'long' 55 토큰을 한 배치(n_ubatch 64)로
 *   B. 같은 55 토큰을 하나씩(n_ubatch 1 문맥)
 * 두 경우의 **토큰당** 비용을 연산별로 나란히 찍는다. 배치로 넣어도 토큰당
 * 비용이 줄지 않는 연산이 원인이다.
 *
 * ⚠ 콜백이 노드마다 동기화를 걸어 전체 시간은 늘어난다 — 그래서 각 경우를 콜백
 *   없이도 한 번 재서 "덧붙은 시간"을 함께 찍는다. 비율 비교가 목적이다.
 * ⚠ 4 스레드 · 1104 MHz · 과열 보호 없음(측정 앱) — 실행은 1 분 남짓.
 *
 * SPDX-License-Identifier: Apache-2.0
 */
#include <zephyr/kernel.h>
#include <zephyr/devicetree.h>

#include "ggml.h"
#include "llama.h"

#include <cinttypes>
#include <cstdio>
#include <cstring>

#include "prompts.h"
#include "l7b_golden.inc"
#include "llm_bigheap.h"
#include <moru_led.h>
#include <rk3566_tsadc.h>

#define BLOB_ADDR ((uintptr_t)DT_REG_ADDR(DT_NODELABEL(model_blob)))
#define MODEL_BYTES 532517120u

#define MAXK 48
struct agg { char key[40]; uint64_t cyc; uint32_t n; };
static agg acc[MAXK];
static int nacc;
static uint64_t last_cyc;
static bool rec;

static agg *slot(const char *k)
{
	for (int i = 0; i < nacc; i++) { if (!strcmp(acc[i].key, k)) { return &acc[i]; } }
	if (nacc == MAXK) { return &acc[MAXK - 1]; }
	memcpy(acc[nacc].key, k, strnlen(k, sizeof acc[nacc].key - 1));
	return &acc[nacc++];
}

static bool cb(struct ggml_tensor *t, bool ask, void *)
{
	if (ask) { return rec; }		/* 모든 노드를 본다 */
	const uint64_t now = k_cycle_get_64();
	char k[40];
	if (t->op == GGML_OP_MUL_MAT || t->op == GGML_OP_MUL_MAT_ID) {
		snprintf(k, sizeof k, "%s·%s", ggml_op_desc(t), t->src[0] ? ggml_type_name(t->src[0]->type) : "?");
	} else {
		snprintf(k, sizeof k, "%s", ggml_op_desc(t));
	}
	agg *a = slot(k);
	a->cyc += now - last_cyc;
	a->n++;
	last_cyc = now;
	return true;
}

static llama_context *mk(llama_model *m, int ub, bool with_cb)
{
	llama_context_params cp = llama_context_default_params();
	cp.n_ctx = 256; cp.n_batch = 256; cp.n_ubatch = ub;
	cp.n_threads = 4; cp.n_threads_batch = 4;
	cp.flash_attn_type = LLAMA_FLASH_ATTN_TYPE_DISABLED;
	if (with_cb) { cp.cb_eval = cb; cp.cb_eval_user_data = nullptr; }
	return llama_init_from_model(m, cp);
}

static llama_token toks[64];

static int64_t run(llama_context *c, int n, bool batch)
{
	llama_memory_clear(llama_get_memory(c), true);
	const int64_t t0 = k_uptime_get();
	if (batch) {
		(void)llama_decode(c, llama_batch_get_one(toks, n));
	} else {
		for (int i = 0; i < n; i++) { (void)llama_decode(c, llama_batch_get_one(&toks[i], 1)); }
	}
	return k_uptime_get() - t0;
}

static agg resA[MAXK], resB[MAXK];
static int nA, nB;

int main(void)
{
	printk("=== L8q: repack ON — 배치 prefill 연산별 시간 · 정답 대조 · 생성 속도 ===\n");
	moru_led_set(MORU_LED_BLOB);
	FILE *f = fmemopen((void *)BLOB_ADDR, MODEL_BYTES, "rb");
	llama_backend_init();
	llama_model_params mp = llama_model_default_params();
	mp.n_gpu_layers = 0; mp.load_mode = LLAMA_LOAD_MODE_MMAP;
	mp.check_tensors = false; mp.use_extra_bufts = true;	/* repack 버퍼 */
	const int64_t tl0 = k_uptime_get();
	llama_model *m = f ? llama_model_load_from_file_ptr(f, mp) : nullptr;
	if (!m) { printk("모델 적재 실패\n"); k_sleep(K_FOREVER); }
	printk("  [0] 적재 %" PRId64 " ms · llm_heap 사용 %zu MiB (최대 %zu / %zu MiB)\n",
	       k_uptime_get() - tl0, llm_bigheap_used() >> 20, llm_bigheap_peak() >> 20,
	       llm_bigheap_size() >> 20);
	const llama_vocab *v = llama_model_get_vocab(m);
	const l7b_prompt &P = l7b_prompts[1];	/* 'long' */
	const int n = llama_tokenize(v, P.text, (int)strlen(P.text), toks, 64, false, P.parse_special);
	printk("  프롬프트 '%s' %d 토큰\n", P.name, n);
	moru_led_set(MORU_LED_INFER);

	/* 콜백 없이 — 덧붙은 시간을 가늠하는 기준 */
	llama_context *ca = mk(m, 64, false), *cb1 = mk(m, 1, false);
	const int64_t a0 = run(ca, n, true), b0 = run(cb1, n, false);
	llama_free(ca); llama_free(cb1);
	printk("  콜백 없음: 배치 %" PRId64 " ms · 하나씩 %" PRId64 " ms (%.2f 배)\n", a0, b0,
	       (double)b0 / (double)a0);

	/* A: 배치 */
	ca = mk(m, 64, true);
	nacc = 0; rec = true; last_cyc = k_cycle_get_64();
	llama_memory_clear(llama_get_memory(ca), true);
	last_cyc = k_cycle_get_64();
	const int64_t a1 = run(ca, n, true);
	rec = false;
	memcpy(resA, acc, sizeof acc); nA = nacc;
	llama_free(ca);
	/* B: 하나씩 */
	cb1 = mk(m, 1, true);
	nacc = 0; memset(acc, 0, sizeof acc); rec = true;
	llama_memory_clear(llama_get_memory(cb1), true);
	last_cyc = k_cycle_get_64();
	const int64_t b1 = run(cb1, n, false);
	rec = false;
	memcpy(resB, acc, sizeof acc); nB = nacc;
	llama_free(cb1);
	printk("  콜백 있음: 배치 %" PRId64 " ms · 하나씩 %" PRId64 " ms\n", a1, b1);

	const double hz = (double)sys_clock_hw_cycles_per_sec();
	uint64_t ta = 0, tb = 0;
	for (int i = 0; i < nA; i++) { ta += resA[i].cyc; }
	for (int i = 0; i < nB; i++) { tb += resB[i].cyc; }
	printk("\n  %-26s %10s %10s %8s %6s %6s\n", "연산·형", "배치ms/tok", "하나ms/tok", "배치/하나", "배치%", "노드A");
	for (int i = 0; i < nA; i++) {
		uint64_t cb_ = 0;
		for (int j = 0; j < nB; j++) { if (!strcmp(resB[j].key, resA[i].key)) { cb_ = resB[j].cyc; } }
		const double ma = resA[i].cyc / hz * 1000.0 / n, mb = cb_ / hz * 1000.0 / n;
		if (ma < 0.05 && mb < 0.05) { continue; }
		printk("  %-26s %10.2f %10.2f %8.2f %5.1f%% %6u\n", resA[i].key, ma, mb,
		       mb > 0 ? ma / mb : 0.0, 100.0 * (double)resA[i].cyc / (double)ta, resA[i].n);
	}
	printk("  %-26s %10.2f %10.2f\n", "합계", ta / hz * 1000.0 / n, tb / hz * 1000.0 / n);
	/* [C] L7b 'chat' 정답 대조 + [G] 생성 속도 */
	{
		llama_context *cc = mk(m, 64, false);
		const l7b_prompt &C = l7b_prompts[0];
		const int nc = llama_tokenize(v, C.text, (int)strlen(C.text), toks, 64, false, C.parse_special);
		llama_memory_clear(llama_get_memory(cc), true);
		(void)llama_decode(cc, llama_batch_get_one(toks, nc));
		const int nv = llama_vocab_n_tokens(v);
		const float *lg = llama_get_logits_ith(cc, -1);
		int best = 0;
		for (int i = 1; i < nv; i++) { if (lg[i] > lg[best]) { best = i; } }
		printk("\n  [C] 'chat' %d 토큰 · 1등 %d (%.4f) · 호스트 %d (%.4f) %s\n", nc, best,
		       (double)lg[best], l7b_gold[0].top_id[0], (double)l7b_gold[0].top_logit[0],
		       best == l7b_gold[0].top_id[0] ? "OK" : "FAIL");
		int same = 0;
		llama_token cur = best;
		for (int s = 0; s < L7B_N_CONT; s++) {
			if (cur != l7b_gold[0].cont[s]) { break; }
			same++;
			if (s == L7B_N_CONT - 1) { break; }
			(void)llama_decode(cc, llama_batch_get_one(&cur, 1));
			const float *l2 = llama_get_logits_ith(cc, -1);
			int b2 = 0;
			for (int i = 1; i < nv; i++) { if (l2[i] > l2[b2]) { b2 = i; } }
			cur = b2;
		}
		printk("      이어서 %d/%d 호스트와 같다 (호스트는 repack OFF)\n", same, L7B_N_CONT);
		/* [G] 32 토큰 생성 */
		const int64_t g0 = k_uptime_get();
		for (int s = 0; s < 32; s++) {
			(void)llama_decode(cc, llama_batch_get_one(&cur, 1));
			const float *l3 = llama_get_logits_ith(cc, -1);
			int b3 = 0;
			for (int i = 1; i < nv; i++) { if (l3[i] > l3[b3]) { b3 = i; } }
			cur = b3;
		}
		const int64_t gt = k_uptime_get() - g0;
		printk("  [G] 생성 32 토큰 %" PRId64 " ms · %.1f ms/토큰 · %.2f 토큰/초 (repack OFF 274 ms · 3.65)\n",
		       gt, (double)gt / 32, 32000.0 / (double)gt);
		llama_free(cc);
	}
	printk("  llm_heap 최대 %zu MiB\n", llm_bigheap_peak() >> 20);
	int mc = 0;
	(void)rk3566_tsadc_get_mc(0, &mc);
	printk("  CPU 온도 %d.%d °C\n", mc / 1000, (mc % 1000) / 100);
	printk("=== L8q 측정 끝 ===\n");
	moru_led_set(MORU_LED_READY);
	k_sleep(K_FOREVER);
	return 0;
}
```

## src/prompts.h
```c
/*
 * L7b 프롬프트 — 호스트 도구(tools/l7b_host_prefill.cpp)와 보드 앱이 같이 쓴다.
 * 바꾸면 golden.inc 를 다시 만든다.
 *
 * SPDX-License-Identifier: Apache-2.0
 */
#pragma once

struct l7b_prompt {
	const char *name;
	const char *text;
	bool parse_special;
};

static const struct l7b_prompt l7b_prompts[] = {
	/* 채팅 템플릿 (18 토큰, L7a 'chat' 과 같다) */
	{ "chat", "<|im_start|>user\n저압 선로가 활선인지 알려줘<|im_end|>\n<|im_start|>assistant\n", true },
	/* 긴 평문 (55 토큰, L7a 'long' 과 같다) — 배치가 커질 때 */
	{ "long", "The quick brown fox jumps over the lazy dog. "
		  "다람쥐 헌 쳇바퀴에 타고파. "
		  "The quick brown fox jumps over the lazy dog. "
		  "다람쥐 헌 쳇바퀴에 타고파. 1234567890", false },
};

#define L7B_N_PROMPTS (sizeof(l7b_prompts) / sizeof(l7b_prompts[0]))
#define L7B_MAX_TOK   64	/* = n_batch = n_ubatch. 프롬프트가 한 배치에 들어가야 한다 */
#define L7B_TOPK      5
#define L7B_N_CONT    8		/* prefill 뒤 이어서 greedy 로 낼 토큰 수 */
#define L7B_N_CTX     256
```
