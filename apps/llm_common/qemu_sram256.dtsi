/*
 * qemu_sram256.dtsi — QEMU 쪽 sram 창도 **256 MiB** 로 맞춘다.
 *
 * ── 왜 별도 파일인가 ────────────────────────────────────────────────────
 *
 * 실기 보드 DTS 는 `reg = <0x40000000 DT_SIZE_M(256)>` (주소 1셀 + 크기 1셀)
 * 이고 인트리 `qemu_cortex_a53.dts:32` 는
 * `reg = <0x0 0x40000000 0x0 DT_SIZE_M(128)>` (2셀 + 2셀) 다.
 * **셀 개수가 달라 하나의 overlay 로 둘을 덮을 수 없다.**
 *
 * 그래서 Zephyr 의 표준 기구를 쓴다 — 앱의 `boards/<board>.overlay` 는
 * 그 보드로 빌드할 때만 자동으로 적용된다.
 *
 * ── 왜 맞춰야 하나 ──────────────────────────────────────────────────────
 *
 * QEMU 와 실기가 **같은 아레나 크기**(240 MiB)를 써야 한다. 한쪽만 작으면
 * 그 쪽에서 `region RAM overflowed` 로 링크가 깨지거나(겪었다), 더 나쁘게는
 * 빌드는 되는데 **다른 메모리 조건에서 돌아** 사다리의 뜻이 사라진다.
 * `cmake/ggml-sources.txt` 를 단일 출처로 만든 것과 같은 이유다.
 *
 * ⚠ QEMU 는 `-m 2G` 로 돌므로(tools/qemu_run.sh:43) DRAM 이
 *   0x40000000~0xC0000000 이다. 창 0x40000000+256 MiB = 0x50000000 은 그
 *   안이고, 모델 창 0x58000000 은 창 **밖**이라 겹치지 않는다 — 실기와 같다.
 */
&sram0 {
	reg = <0x0 0x40000000 0x0 DT_SIZE_M(256)>;
};
