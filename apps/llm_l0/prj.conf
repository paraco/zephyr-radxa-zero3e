## CMakeLists.txt
```
cmake_minimum_required(VERSION 3.20.0)
# 사다리 공용 Kconfig 조각 — uart2 인터럽트 폭주를 끈다 (사이클의 77%).
# 근거와 측정값은 그 파일에 있다. ⚠ prj.conf **뒤에** 병합되므로 그 파일이 이긴다.
set(EXTRA_CONF_FILE
    "${CMAKE_CURRENT_SOURCE_DIR}/../llm_common/ladder.conf")

find_package(Zephyr REQUIRED HINTS $ENV{ZEPHYR_BASE})
project(llm_l0)
target_sources(app PRIVATE src/main.cpp)
```

## prj.conf
```kconfig
CONFIG_PRINTK=y
CONFIG_BOOT_BANNER=n

# C++17 + STL + 예외 + RTTI  (picolibc 로 된다 — GLIBCXX_LIBCPP 가 PICOLIBC 를 허용한다)
CONFIG_CPP=y
CONFIG_STD_CPP17=y
CONFIG_GLIBCXX_LIBCPP=y
CONFIG_CPP_EXCEPTIONS=y
CONFIG_CPP_RTTI=y

# pthread — ggml 이 쓰는 것.
# ⚠ pthread_create(NULL attr) 가 스택을 받으려면 DYNAMIC_THREAD 가 필요하고,
#   그것은 THREAD_STACK_INFO 에 의존한다(kernel/Kconfig:192-195).
#   그 줄을 빼면 pthread_create 가 EINVAL(22) 로 실패한다 — 실제로 겪었다.
CONFIG_POSIX_API=y
CONFIG_THREAD_STACK_INFO=y
CONFIG_DYNAMIC_THREAD=y
CONFIG_DYNAMIC_THREAD_ALLOC=y
CONFIG_DYNAMIC_THREAD_STACK_SIZE=8192

CONFIG_HEAP_MEM_POOL_SIZE=131072
CONFIG_MAIN_STACK_SIZE=16384

# ⚠ **로그를 동기(immediate)로 만든다 — 쓰는 주체를 하나로 유지한 채.**
#
# 보드 defconfig 에 CONFIG_LOG=y 가 있어(dwc3 드라이버용) printk 가 기본으로
# 로그 시스템을 거친다. 기본 조합이 이렇다:
#     CONFIG_LOG_MODE_DEFERRED=y
#     CONFIG_LOG_BUFFER_SIZE=1024              ← 1 KB
#     CONFIG_LOG_PROCESS_THREAD_SLEEP_MS=1000  ← 로그 스레드가 1초씩 잔다
#     CONFIG_MAIN_THREAD_PRIORITY=0            ← main 이 그 스레드를 선점한다
# 사다리 앱은 80자 수십 줄을 main 에서 쏟으므로 버퍼가 넘쳐 **앞부분이
# 버려진다**(2026-11-07 L5b 첫 실기 투입에서 꼬리만 남았다).
#
# ⚠ 처음에 `CONFIG_LOG_PRINTK=n` 으로 고치려 했다가 **보드가 멈췄다.**
#   그러면 UART2 에 쓰는 주체가 둘이 된다 — printk(main, 동기)와 로그
#   백엔드(로그 스레드). 같은 인터럽트 구동 UART 를 동시에 건드려 교착한
#   것으로 보인다(dwc3 로그 한 줄만 나오고 멈췄다).
#
# 그래서 LOG_PRINTK 는 기본(y) 그대로 두고 **모드만 동기로** 바꾼다.
# 버퍼도 스레드도 쓰지 않으므로 유실이 없고 쓰는 주체는 하나다.
#
# ⚠ moru 는 이 설정을 쓰면 안 된다 — 동기 출력이 줄당 ~9 ms 를 잡아먹어
#   USB 열거의 SET_ADDRESS 50 ms 예산을 넘긴다(docs/hardware-verified.md).
#   사다리 앱은 USB 를 열거하지 않으므로 무해하다.
CONFIG_LOG_MODE_IMMEDIATE=y
```

## src/main.cpp
```c
/*
 * L0 관문 — ggml + llama.cpp 그래프 안(B안)이 성립하는지 가린다.
 * 세 기능을 한 파일에 넣는다. 하나라도 막히면 포팅 비용이 두 배가 된다.
 */
#include <zephyr/kernel.h>
#include <vector>
#include <stdexcept>
#include <thread>
#include <cstdio>
#include <pthread.h>

/* ggml 은 std::thread 가 아니라 pthread 를 쓴다 — 그것이 진짜 요구사항이다 */
static void *pworker(void *arg)
{
	auto *v = static_cast<std::vector<float> *>(arg);
	for (auto &x : *v) { x += 1.0f; }
	return nullptr;
}

static void worker(std::vector<float> &v)
{
	for (auto &x : v) {
		x += 1.0f;
	}
}

int main(void)
{
	int fail = 0;

	printk("=== L0: C++17 런타임 관문 ===\n");

	/* ① STL 컨테이너 + 힙 */
	std::vector<float> v(1024, 0.0f);
	printk("  [1] std::vector<float>(1024)  size=%u  ... ", (unsigned)v.size());
	if (v.size() == 1024 && v[0] == 0.0f) { printk("OK\n"); } else { printk("FAIL\n"); fail++; }

	/* ② 예외 — arm64 + 이 libc 에서 되는가 */
	printk("  [2] throw/catch std::runtime_error ... ");
	{
		bool caught = false;
		try {
			throw std::runtime_error("l0");
		} catch (const std::exception &e) {
			caught = (e.what() != nullptr);
		}
		if (caught) { printk("OK\n"); } else { printk("FAIL\n"); fail++; }
	}

	/* ③ pthread — ggml 의 실제 요구사항 */
	printk("  [3] pthread_create + join (ggml 이 쓰는 것) ... ");
	{
		pthread_t th;
		int rc = pthread_create(&th, NULL, pworker, &v);
		if (rc == 0) {
			pthread_join(th, NULL);
			if (v[0] == 1.0f && v[1023] == 1.0f) { printk("OK\n"); }
			else { printk("FAIL (v[0]=%d)\n", (int)v[0]); fail++; }
		} else {
			printk("FAIL (pthread_create rc=%d)\n", rc); fail++;
		}
	}

	/* ④ std::thread — 있으면 좋지만 ggml 필수는 아니다 */
	printk("  [4] std::thread (참고) ... ");
#ifdef _GLIBCXX_HAS_GTHREADS
	{
		std::thread t(worker, std::ref(v));
		t.join();
		printk("%s (v[0]=%d)\n", (v[0] == 2.0f) ? "OK" : "FAIL", (int)v[0]);
	}
#else
	printk("쓸 수 없다 — libstdc++ 가 gthreads 없이 빌드됐다 (ggml 에는 불필요)\n");
	(void)worker;
#endif

	printk("=== L0 %s (실패 %d) ===\n", fail ? "FAIL" : "PASS", fail);
	return fail;
}
```
