## CMakeLists.txt
```
cmake_minimum_required(VERSION 3.20.0)
# 모델 가중치 창은 **공용 파일 하나**를 쓴다 — 앱마다 복사해 두면 주소를
# 고칠 때 갈린다 (실제로 실기 DRAM 끝을 넘는 주소가 여섯 군데에 퍼져 있었다).
set(EXTRA_DTC_OVERLAY_FILE
    "${CMAKE_CURRENT_SOURCE_DIR}/../llm_common/model_blob.overlay")

# 사다리 공용 Kconfig 조각 — uart2 인터럽트 폭주를 끈다 (사이클의 77%).
# 근거와 측정값은 그 파일에 있다. ⚠ prj.conf **뒤에** 병합되므로 그 파일이 이긴다.
set(EXTRA_CONF_FILE
    "${CMAKE_CURRENT_SOURCE_DIR}/../llm_common/ladder.conf")

find_package(Zephyr REQUIRED HINTS $ENV{ZEPHYR_BASE})
project(llm_l5b)

include(${CMAKE_CURRENT_SOURCE_DIR}/../../cmake/llm_ggml.cmake)
llm_add_ggml()

target_sources(app PRIVATE
	src/main.c
	src/l5b_graph.c
	${CMAKE_CURRENT_SOURCE_DIR}/../llm_common/ggml_port.c)
target_include_directories(app PRIVATE src)
llm_ggml_flags(${CMAKE_CURRENT_SOURCE_DIR}/src/l5b_graph.c)
```

## prj.conf
```kconfig
CONFIG_PRINTK=y
CONFIG_BOOT_BANNER=n
CONFIG_MAIN_STACK_SIZE=32768
CONFIG_MAX_XLAT_TABLES=24

CONFIG_CPP=y
CONFIG_STD_CPP17=y
CONFIG_GLIBCXX_LIBCPP=y
CONFIG_CPP_EXCEPTIONS=y
CONFIG_CPP_RTTI=y

CONFIG_POSIX_API=y
CONFIG_THREAD_STACK_INFO=y
CONFIG_DYNAMIC_THREAD=y
CONFIG_DYNAMIC_THREAD_ALLOC=y
CONFIG_DYNAMIC_THREAD_STACK_SIZE=32768

# ggml_init 이 mem_size(16 MiB)를 **정렬 할당 한 덩이**로 받는다. 아레나가
# 요청과 같으면 정렬 여유가 없어 실패한다(L4 에서 겪었다). 여러 배로 둔다.
CONFIG_COMMON_LIBC_MALLOC=y
CONFIG_COMMON_LIBC_MALLOC_ARENA_SIZE=50331648
CONFIG_HEAP_MEM_POOL_SIZE=1048576

# ⚠ **로그를 동기(immediate)로 만든다 — 쓰는 주체를 하나로 유지한 채.**
#
# 보드 defconfig 에 CONFIG_LOG=y 가 있어(dwc3 드라이버용) printk 가 기본으로
# 로그 시스템을 거친다. 기본 조합이 이렇다:
#     CONFIG_LOG_MODE_DEFERRED=y
#     CONFIG_LOG_BUFFER_SIZE=1024              ← 1 KB
#     CONFIG_LOG_PROCESS_THREAD_SLEEP_MS=1000  ← 로그 스레드가 1초씩 잔다
#     CONFIG_MAIN_THREAD_PRIORITY=0            ← main 이 그 스레드를 선점한다
# 사다리 앱은 80자 수십 줄을 main 에서 쏟으므로 버퍼가 넘쳐 **앞부분이
# 버려진다**(2026-11-07 L5b 첫 실기 투입에서 꼬리만 남았다).
#
# ⚠ 처음에 `CONFIG_LOG_PRINTK=n` 으로 고치려 했다가 **보드가 멈췄다.**
#   그러면 UART2 에 쓰는 주체가 둘이 된다 — printk(main, 동기)와 로그
#   백엔드(로그 스레드). 같은 인터럽트 구동 UART 를 동시에 건드려 교착한
#   것으로 보인다(dwc3 로그 한 줄만 나오고 멈췄다).
#
# 그래서 LOG_PRINTK 는 기본(y) 그대로 두고 **모드만 동기로** 바꾼다.
# 버퍼도 스레드도 쓰지 않으므로 유실이 없고 쓰는 주체는 하나다.
#
# ⚠ moru 는 이 설정을 쓰면 안 된다 — 동기 출력이 줄당 ~9 ms 를 잡아먹어
#   USB 열거의 SET_ADDRESS 50 ms 예산을 넘긴다(docs/hardware-verified.md).
#   사다리 앱은 USB 를 열거하지 않으므로 무해하다.
CONFIG_LOG_MODE_IMMEDIATE=y
```

## src/main.c
```c
/*
 * L5b — Gated Attention 층 관문 (합성 가중치).
 *
 * GQA(8:2) + Q/K RMSNorm + **부분 mRoPE(256 중 64)** + 인과 마스크 softmax
 * + sigmoid 게이트 + 출력 투영. 치수는 Qwen3.5-0.8B 실측값이다.
 *
 * ⚠ 합성 가중치다. "ggml 이 이 층을 호스트와 똑같이 계산하는가" 만 가린다.
 *   "llama.cpp 의 qwen35 경로가 옳은가" 는 아니다.
 */
#include <zephyr/kernel.h>
#include <string.h>
#include <stdint.h>
#include <inttypes.h>

#include "l5b_graph.h"
#include "l5b_golden.h"

#define TOL_PPB		100000ull	/* 계획서의 L5 허용 오차 1e-4 */

static uint32_t bits(float f) { uint32_t b; memcpy(&b, &f, 4); return b; }
static float ab(float f) { return f < 0 ? -f : f; }

static uint64_t rel_ppb(float got, float want)
{
	float d = ab(got - want);
	float m = ab(want);

	/*
	 * ⚠ NaN·Inf 를 먼저 걸러낸다. 그러지 않으면 **NaN 이 OK 로 통과한다** —
	 *   NaN 비교는 `d == 0` 도 `r > 1e18` 도 거짓이고 `(uint64_t)NaN` 은 0 이라
	 *   worst 가 0 으로 남아 "최대 0 ppb" 로 찍힌다. 커널이 NaN 을 내거나
	 *   Inf-Inf 가 생기는 회귀가 조용히 통과한다.
	 */
	if (got != got || want != want) { return UINT64_MAX; }	/* NaN */
	if (d > 1e30f) { return UINT64_MAX; }			/* Inf 또는 폭발 */
	if (d == 0.0f) { return 0; }
	if (m < 1e-30f) { m = 1e-30f; }
	float r = d / m * 1e9f;

	return (r > 1e18f) ? (uint64_t)1e18 : (uint64_t)r;
}

static int check(const char *name, const float *got, const uint32_t *golden, int n,
		 uint32_t crc, uint32_t crc_golden)
{
	int nbit = 0;
	uint64_t worst = 0;
	int wi = 0;

	/*
	 * 비트가 같으면 비교를 건너뛰므로, **양쪽이 같은 NaN 을 내면 통과한다.**
	 * 그래서 얻은 값 자체에 비유한값이 있는지 골든과 무관하게 먼저 본다.
	 * 층 출력에 NaN·Inf 가 나오는 것은 어떤 경우에도 실패다.
	 */
	int nonfinite = 0;

	for (int i = 0; i < n; i++) {
		if (got[i] != got[i] || ab(got[i]) > 1e30f) { nonfinite++; }
	}
	if (nonfinite) {
		printk("FAIL — 얻은 값에 비유한값(NaN/Inf) %d개\n", nonfinite);
		return 1;
	}
	printk("  %-22s %4d개 ... ", name, n);
	for (int i = 0; i < n; i++) {
		if (bits(got[i]) != golden[i]) {
			float want;

			memcpy(&want, &golden[i], 4);
			nbit++;
			uint64_t r = rel_ppb(got[i], want);

			if (r > worst) { worst = r; wi = i; }
		}
	}
	if (nbit == 0) {
		if (crc_golden && crc == crc_golden) {
			printk("OK — **전체 비트 일치** (CRC 0x%08x)\n", crc);
		} else if (crc_golden) {
			printk("OK — 표본 비트 일치 (전체 CRC 는 다름)\n");
		} else {
			printk("OK — **비트 일치**\n");
		}
		return 0;
	}
	if (worst <= TOL_PPB) {
		printk("OK — 비트 %d/%d 다름, 최대 %" PRIu64 " ppb\n", nbit, n, worst);
		return 0;
	}
	printk("FAIL — 최대 %" PRIu64 " ppb (> %" PRIu64 ") at [%d]\n", worst, TOL_PPB, wi);
	printk("        얻음 0x%08x  골든 0x%08x\n", bits(got[wi]), golden[wi]);
	return 1;
}

static int check_ne(const char *name, const int64_t *got, const int64_t *g)
{
	printk("  %-22s [%" PRId64 ",%" PRId64 ",%" PRId64 ",%" PRId64 "] ... ",
	       name, got[0], got[1], got[2], got[3]);
	for (int i = 0; i < 4; i++) {
		if (got[i] != g[i]) {
			printk("FAIL — 골든 [%" PRId64 ",%" PRId64 ",%" PRId64 ",%" PRId64 "]\n",
			       g[0], g[1], g[2], g[3]);
			return 1;
		}
	}
	printk("OK\n");
	return 0;
}

static struct l5b_results res;

/*
 * 전체 텐서 요약 비교 — 표본 밖 영역의 상한이다. CRC 불일치는 libm 1 ulp 로도
 * 생기므로 실패로 셀 수 없고, 큰 텐서는 12~50%만 표본이다. 그 구멍을 좁힌다.
 */
static int check_full_all(void)
{
	int bad = 0;

	for (int i = 0; i < L5B_FULL_N; i++) {
		float gs, ga;

		memcpy(&gs, &l5b_g_full_sum[i], 4);
		memcpy(&ga, &l5b_g_full_abs[i], 4);
		uint64_t rs = rel_ppb(res.full[i].sum, gs);
		uint64_t ra = rel_ppb(res.full[i].abssum, ga);

		printk("  %-22s 합 %" PRIu64 " · |합| %" PRIu64 " ppb ... ",
		       l5b_full_names[i], rs, ra);
		/* 합은 상쇄가 있을 수 있어 참고, |합| 을 주 판정으로 쓴다 */
		if (ra <= TOL_PPB) {
			printk("OK\n");
		} else {
			printk("FAIL — 표본 밖이 틀렸다는 뜻이다\n");
			bad++;
		}
	}
	return bad;
}


int main(void)
{
	int fail = 0;

	printk("=== L5b: Gated Attention 층 관문 (합성 가중치) ===\n");
	printk("  치수 실측: head_dim=%d n_head=%d n_head_kv=%d (GQA %d:1) n_rot=%d/%d\n",
	       L5B_HEAD_DIM, L5B_N_HEAD, L5B_N_HEAD_KV,
	       L5B_N_HEAD / L5B_N_HEAD_KV, L5B_N_ROT, L5B_HEAD_DIM);

	int rc = l5b_run(&res);

	if (rc != 0) {
		printk("  l5b_run 실패: %d\n", rc);
		printk("=== L5b FAIL (실패 1) ===\n");
		return 0;
	}

	printk("  [0] 기능 집합  dotprod=%d i8mm=%d / 호스트 %d %d ... ",
	       res.dotprod, res.i8mm, L5B_HOST_DOTPROD, L5B_HOST_I8MM);
	if (res.dotprod == L5B_HOST_DOTPROD && res.i8mm == L5B_HOST_I8MM) {
		printk("OK\n");
	} else {
		printk("불일치 — 다른 커널 경로끼리다\n");
		fail++;
	}

	printk("  ── 축 배치 (값보다 먼저 본다)\n");
	fail += check_ne("[1] Q 교차 뷰", res.ne_q_view, l5b_g_ne_q_view);
	fail += check_ne("[2] 게이트 2d", res.ne_gate, l5b_g_ne_gate);
	fail += check_ne("[3] kq", res.ne_kq, l5b_g_ne_kq);
	fail += check_ne("[4] 어텐션 2d", res.ne_att2d, l5b_g_ne_att2d);
	fail += check_ne("[5] 출력", res.ne_out, l5b_g_ne_out);

	/*
	 * 부분 RoPE 증거. head_dim 256 중 n_rot 64 만 회전해야 한다.
	 * hi(= [64,256) 에서 바뀐 개수)가 **0** 이어야 맞다.
	 */
	printk("  ── 부분 RoPE (%d/%d)\n", L5B_N_ROT, L5B_HEAD_DIM);
	printk("  %-22s lo=%d hi=%d (골든 lo=%d hi=%d) ... ",
	       "[6] 회전 범위", res.rope_changed_lo, res.rope_changed_hi,
	       L5B_G_ROPE_LO, L5B_G_ROPE_HI);
	/*
	 * ⚠ lo 를 골든값과 **정확히** 비교하면 안 된다. sin/cos 가 1 ulp 다르면
	 *   회전된 원소 하나가 한쪽에서만 원래 값과 같아져 개수가 ±1 흔들린다.
	 *   그러면 버그가 아닌 것을 쫓게 된다. 실기(다른 libm)에서 더 그렇다.
	 *
	 *   주장을 지탱하는 것은 **hi == 0**(뒤쪽은 건드리지 않았다)이고,
	 *   앞쪽은 **lo > 0**(회전이 실제로 걸렸다)면 충분하다.
	 */
	if (res.rope_changed_hi == 0 && L5B_G_ROPE_HI == 0 && res.rope_changed_lo > 0) {
		printk("OK — 뒤쪽 %d 차원은 그대로다", L5B_HEAD_DIM - L5B_N_ROT);
		if (res.rope_changed_lo != L5B_G_ROPE_LO) {
			printk(" (lo 가 골든과 %d 만큼 다르다 — libm 1 ulp 범위라면 정상)",
			       res.rope_changed_lo - L5B_G_ROPE_LO);
		}
		printk("\n");
	} else {
		printk("FAIL — hi 가 0 이 아니면 부분 RoPE 범위가 틀린 것이다\n");
		fail++;
	}

	printk("  ── 값\n");
	fail += check("[7] Q RMSNorm", res.q_norm, l5b_g_q_norm, L5B_Q_SAMP,
		      res.q_norm_crc, L5B_G_QNORM_CRC);
	fail += check("[8] K RMSNorm", res.k_norm, l5b_g_k_norm, L5B_K_SAMP,
		      res.k_norm_crc, L5B_G_KNORM_CRC);
	fail += check("[9] Q mRoPE", res.q_rope, l5b_g_q_rope, L5B_Q_SAMP,
		      res.q_rope_crc, L5B_G_QROPE_CRC);
	fail += check("[10] K mRoPE", res.k_rope, l5b_g_k_rope, L5B_K_SAMP,
		      res.k_rope_crc, L5B_G_KROPE_CRC);
	fail += check("[11] softmax(kq)", res.kq, l5b_g_kq, L5B_KQ_N, 0, 0);
	fail += check("[12] 어텐션 출력", res.att, l5b_g_att, L5B_ATT_SAMP,
		      res.att_crc, L5B_G_ATT_CRC);
	fail += check("[13] 게이트", res.gate, l5b_g_gate, L5B_ATT_SAMP,
		      res.gate_crc, L5B_G_GATE_CRC);
	/*
	 * [14] 는 sigmoid 를 **지난** 값이다. [13](sigmoid 전)이 비트 일치인데
	 * [14] 가 다르면 오차의 입구가 sigmoid(libm)라는 뜻이다 — 추론이 아니라
	 * 측정으로 가린다.
	 */
	fail += check("[14] sigmoid 곱한 뒤", res.gated, l5b_g_gated, L5B_ATT_SAMP,
		      res.gated_crc, L5B_G_GATED_CRC);
	fail += check("[15] 층 출력 (wo 투영)", res.out, l5b_g_out, L5B_OUT_SAMP,
		      res.out_crc, L5B_G_OUT_CRC);

	printk("  ── 전체 요약 (표본 밖 영역의 상한)\n");
	fail += check_full_all();

	if (fail == 0) {
		printk("=== L5b PASS (실패 0) ===\n");
		printk("  ⚠ 합성 가중치다. 'llama.cpp 의 qwen35 경로가 옳은가' 는 아직 못 가렸다.\n");
	} else {
		printk("=== L5b FAIL (실패 %d) ===\n", fail);
	}
	return 0;
}
```

## src/l5b_graph.c
```c
/*
 * L5b 그래프 — 호스트와 Zephyr 가 공유한다. l5b_graph.h 참고.
 *
 * Qwen3.5 의 **Gated Attention 층**을 llama.cpp 의 연산 순서 그대로 재현한다.
 * 가중치만 합성이다.
 *
 *   출처: src/models/qwen35.cpp:263-331      (층 전체 순서)
 *         src/llama-graph.cpp:3084-3141      (어텐션 본체, 비-flash 경로)
 *         src/llama-graph.cpp:1642-1658      (mRoPE 는 ggml_rope_multi)
 *
 * ⚠ 합성 가중치다. "ggml 이 이 층을 호스트와 똑같이 계산하는가" 만 가린다.
 */
#include "l5b_graph.h"

#include <string.h>
#include <math.h>

#include "ggml.h"
#include "ggml-cpu.h"

static float fn(int i, int salt)
{
	return (float)(((i * 7919 + salt * 104729) % 251) - 125) * 0.008f;
}

static void fill(struct ggml_tensor *t, int salt)
{
	float *p = (float *)t->data;
	int64_t n = ggml_nelements(t);

	for (int64_t i = 0; i < n; i++) {
		p[i] = fn((int)i, salt);
	}
}

static void save_ne(int64_t *dst, const struct ggml_tensor *t)
{
	for (int i = 0; i < 4; i++) {
		dst[i] = t->ne[i];
	}
}

static uint32_t crc32_of(const void *data, size_t len)
{
	static const uint32_t tab[16] = {
		0x00000000u, 0x1db71064u, 0x3b6e20c8u, 0x26d930acu,
		0x76dc4190u, 0x6b6b51f4u, 0x4db26158u, 0x5005713cu,
		0xedb88320u, 0xf00f9344u, 0xd6d6a3e8u, 0xcb61b38cu,
		0x9b64c2b0u, 0x86d3d2d4u, 0xa00ae278u, 0xbdbdf21cu,
	};
	const uint8_t *p = (const uint8_t *)data;
	uint32_t crc = ~0u;

	for (size_t i = 0; i < len; i++) {
		crc = (crc >> 4) ^ tab[(crc ^ p[i]) & 0x0f];
		crc = (crc >> 4) ^ tab[(crc ^ ((uint32_t)p[i] >> 4)) & 0x0f];
	}
	return ~crc;
}

static void sample(float *dst, const float *src, int n, int stride)
{
	for (int i = 0; i < n; i++) {
		dst[i] = src[(size_t)i * stride];
	}
}

int l5b_run(struct l5b_results *out)
{
	memset(out, 0, sizeof(*out));
#ifdef __ARM_FEATURE_DOTPROD
	out->dotprod = 1;
#endif
#ifdef __ARM_FEATURE_MATMUL_INT8
	out->i8mm = 1;
#endif

	struct ggml_init_params ip = {
		.mem_size   = 16u * 1024 * 1024,
		.mem_buffer = NULL,
		.no_alloc   = false,
	};
	struct ggml_context *ctx = ggml_init(ip);

	if (!ctx) {
		return -1;
	}
	struct ggml_cgraph *gf = ggml_new_graph(ctx);

	const int HD = L5B_HEAD_DIM, NH = L5B_N_HEAD, NKV = L5B_N_HEAD_KV, NT = L5B_N_TOK;

	/*
	 * ── 결합 QG 투영의 결과.
	 * ⚠ Q 와 게이트가 **헤드마다 교차 배치**돼 있다. 헤드당 블록이
	 *   2*head_dim 이고 앞 절반이 Q, 뒤 절반이 게이트다(qwen35.cpp:283-302).
	 *   앞 절반 전체가 Q, 뒤 절반 전체가 게이트인 것이 **아니다** —
	 *   그렇게 읽으면 형태는 맞고 값이 섞인다.
	 */
	struct ggml_tensor *qg = ggml_new_tensor_2d(ctx, GGML_TYPE_F32, HD * 2 * NH, NT);

	fill(qg, 1);
	const size_t es = ggml_element_size(qg);
	struct ggml_tensor *q = ggml_view_3d(ctx, qg, HD, NH, NT,
					     es * HD * 2, es * HD * 2 * NH, 0);
	struct ggml_tensor *gate = ggml_view_3d(ctx, qg, HD, NH, NT,
						es * HD * 2, es * HD * 2 * NH, es * HD);

	save_ne(out->ne_q_view, q);

	struct ggml_tensor *kraw = ggml_new_tensor_2d(ctx, GGML_TYPE_F32, HD * NKV, NT);
	struct ggml_tensor *vt = ggml_new_tensor_3d(ctx, GGML_TYPE_F32, NT, HD, NKV);

	fill(kraw, 2);
	fill(vt, 3);	/* KV 캐시의 v 는 전치돼 있다 (v_trans) */

	/* ── Q/K RMSNorm (가중치 곱까지) */
	struct ggml_tensor *qn_w = ggml_new_tensor_1d(ctx, GGML_TYPE_F32, HD);
	struct ggml_tensor *kn_w = ggml_new_tensor_1d(ctx, GGML_TYPE_F32, HD);

	fill(qn_w, 4);
	fill(kn_w, 5);
	struct ggml_tensor *qn = ggml_mul(ctx, ggml_rms_norm(ctx, q, 1e-6f), qn_w);
	struct ggml_tensor *k3 = ggml_reshape_3d(ctx, kraw, HD, NKV, NT);
	struct ggml_tensor *kn = ggml_mul(ctx, ggml_rms_norm(ctx, k3, 1e-6f), kn_w);

	struct ggml_tensor *gate2 = ggml_cont_2d(ctx, gate, HD * NH, NT);

	save_ne(out->ne_gate, gate2);

	/*
	 * ── mRoPE.  llama-graph.cpp:1647-1653 이 ggml_rope_multi 를 부른다.
	 * ⚠ n_rot=64 인데 head_dim=256 이다 — **앞 64 차원만 회전**하고 나머지
	 *   192 는 그대로다. 그것을 아래에서 증거로 확인한다.
	 * ⚠ mRoPE 는 **토큰당 위치 id 4개**를 요구한다 (ggml.c: a->ne[2]*4 == b->ne[0]).
	 */
	struct ggml_tensor *pos = ggml_new_tensor_1d(ctx, GGML_TYPE_I32, NT * 4);

	for (int i = 0; i < NT * 4; i++) {
		((int32_t *)pos->data)[i] = i % NT;
	}
	int sections[GGML_MROPE_SECTIONS] = { 11, 11, 10, 0 };
	struct ggml_tensor *qr = ggml_rope_multi(ctx, qn, pos, NULL, L5B_N_ROT, sections,
						 GGML_ROPE_TYPE_MROPE, 0, L5B_FREQ_BASE,
						 1.0f, 0.0f, 1.0f, 0.0f, 0.0f);
	struct ggml_tensor *kr = ggml_rope_multi(ctx, kn, pos, NULL, L5B_N_ROT, sections,
						 GGML_ROPE_TYPE_MROPE, 0, L5B_FREQ_BASE,
						 1.0f, 0.0f, 1.0f, 0.0f, 0.0f);

	/* ── 어텐션 본체 (비-flash 경로, llama-graph.cpp:3084-3141) */
	struct ggml_tensor *qp = ggml_permute(ctx, qr, 0, 2, 1, 3);	/* [HD, NT, NH] */
	struct ggml_tensor *kp = ggml_permute(ctx, kr, 0, 2, 1, 3);	/* [HD, NT, NKV] */
	struct ggml_tensor *kq = ggml_mul_mat(ctx, kp, qp);		/* GQA 전파 */

	save_ne(out->ne_kq, kq);

	/* 인과 마스크. soft_max_ext 규약: ne0 == kq->ne0, ne1 >= kq->ne1, 연속 */
	struct ggml_tensor *mask = ggml_new_tensor_2d(ctx, GGML_TYPE_F32, NT, NT);

	for (int j = 0; j < NT; j++) {
		for (int i = 0; i < NT; i++) {
			((float *)mask->data)[j * NT + i] = (i <= j) ? 0.0f : -INFINITY;
		}
	}
	const float kq_scale = 1.0f / sqrtf((float)HD);
	struct ggml_tensor *kqs = ggml_soft_max_ext(ctx, kq, mask, kq_scale, 0.0f);
	struct ggml_tensor *kqv = ggml_mul_mat(ctx, vt, kqs);		/* [HD, NT, NH] */
	struct ggml_tensor *att = ggml_permute(ctx, kqv, 0, 2, 1, 3);	/* [HD, NH, NT] */

	att = ggml_cont_2d(ctx, att, HD * NH, NT);
	save_ne(out->ne_att2d, att);

	/* ── 게이트: **sigmoid** 다 (qwen35.cpp:322-325). L5a-4 의 silu 와 다르다. */
	struct ggml_tensor *gated = ggml_mul(ctx, att, ggml_sigmoid(ctx, gate2));

	/* ── 출력 투영 */
	struct ggml_tensor *wo = ggml_new_tensor_2d(ctx, GGML_TYPE_F32, HD * NH, L5B_N_EMBD);

	fill(wo, 6);
	struct ggml_tensor *o = ggml_mul_mat(ctx, wo, gated);

	save_ne(out->ne_out, o);

	/* RoPE 전/후를 비교하려면 qn 도 결과로 남겨야 한다 */
	struct ggml_tensor *qn_c = ggml_cont(ctx, qn);
	struct ggml_tensor *kn_c = ggml_cont(ctx, kn);
	struct ggml_tensor *qr_c = ggml_cont(ctx, qr);
	struct ggml_tensor *kr_c = ggml_cont(ctx, kr);

	ggml_build_forward_expand(gf, qn_c);
	ggml_build_forward_expand(gf, kn_c);
	ggml_build_forward_expand(gf, qr_c);
	ggml_build_forward_expand(gf, kr_c);
	ggml_build_forward_expand(gf, kqs);
	ggml_build_forward_expand(gf, att);
	ggml_build_forward_expand(gf, gate2);
	ggml_build_forward_expand(gf, gated);
	ggml_build_forward_expand(gf, o);

	enum ggml_status st = ggml_graph_compute_with_ctx(ctx, gf, 1);

	if (st != GGML_STATUS_SUCCESS) {
		ggml_free(ctx);
		return -2 - (int)st;
	}

	const float *pqn = (const float *)qn_c->data;
	const float *pqr = (const float *)qr_c->data;

	sample(out->q_norm, pqn, L5B_Q_SAMP, L5B_Q_STRIDE);
	sample(out->q_rope, pqr, L5B_Q_SAMP, L5B_Q_STRIDE);
	out->q_norm_crc = crc32_of(pqn, (size_t)L5B_Q_N * 4);
	out->q_rope_crc = crc32_of(pqr, (size_t)L5B_Q_N * 4);
	sample(out->k_norm, (const float *)kn_c->data, L5B_K_SAMP, L5B_K_STRIDE);
	sample(out->k_rope, (const float *)kr_c->data, L5B_K_SAMP, L5B_K_STRIDE);
	out->k_norm_crc = crc32_of(kn_c->data, (size_t)L5B_K_N * 4);
	out->k_rope_crc = crc32_of(kr_c->data, (size_t)L5B_K_N * 4);

	memcpy(out->kq, kqs->data, sizeof(out->kq));
	sample(out->att, (const float *)att->data, L5B_ATT_SAMP, L5B_ATT_STRIDE);
	out->att_crc = crc32_of(att->data, (size_t)L5B_ATT_N * 4);
	sample(out->gate, (const float *)gate2->data, L5B_ATT_SAMP, L5B_ATT_STRIDE);
	out->gate_crc = crc32_of(gate2->data, (size_t)L5B_ATT_N * 4);
	sample(out->gated, (const float *)gated->data, L5B_ATT_SAMP, L5B_ATT_STRIDE);
	out->gated_crc = crc32_of(gated->data, (size_t)L5B_ATT_N * 4);
	sample(out->out, (const float *)o->data, L5B_OUT_SAMP, L5B_OUT_STRIDE);
	out->out_crc = crc32_of(o->data, (size_t)L5B_OUT_N * 4);

	out->full[L5B_FULL_QNORM] = llm_fullsum_of(pqn, L5B_Q_N);
	out->full[L5B_FULL_KNORM] = llm_fullsum_of((const float *)kn_c->data, L5B_K_N);
	out->full[L5B_FULL_QROPE] = llm_fullsum_of(pqr, L5B_Q_N);
	out->full[L5B_FULL_KROPE] = llm_fullsum_of((const float *)kr_c->data, L5B_K_N);
	out->full[L5B_FULL_ATT]   = llm_fullsum_of((const float *)att->data, L5B_ATT_N);
	out->full[L5B_FULL_GATE]  = llm_fullsum_of((const float *)gate2->data, L5B_ATT_N);
	out->full[L5B_FULL_GATED] = llm_fullsum_of((const float *)gated->data, L5B_ATT_N);
	out->full[L5B_FULL_OUT]   = llm_fullsum_of((const float *)o->data, L5B_OUT_N);

	/*
	 * ── 부분 RoPE 증거.
	 * RoPE 전후가 달라진 자리를 **모든 토큰·헤드에 걸쳐** 센다.
	 * [0,64) 은 여러 개 달라져야 하고 **[64,256) 은 0 이어야 한다.**
	 * 이 숫자가 없으면 "부분 RoPE 가 맞게 걸렸는지" 를 말할 수 없다.
	 *
	 * ⚠ 토큰 0 만 보면 안 된다 — 위치가 0 이면 theta=0 이라 cos=1·sin=0 이고
	 *   회전이 **항등**이다. 처음에 토큰 0 만 봐서 lo=0 hi=0 이 나왔고
	 *   "RoPE 가 안 걸렸다" 로 오독했다.
	 *
	 * 배치는 [HD, NH, NT] 연속이므로 첨자 = t*(HD*NH) + h*HD + d 다.
	 * mRoPE 의 위치 배열은 구간별이다 — p_t=pos[i2], p_h=pos[i2+ne2]
	 * (ggml-cpu/ops.cpp:6403-6404).
	 */
	for (int t = 0; t < NT; t++) {
		for (int h = 0; h < NH; h++) {
			const size_t base = (size_t)t * HD * NH + (size_t)h * HD;

			for (int d = 0; d < HD; d++) {
				if (pqn[base + d] != pqr[base + d]) {
					if (d < L5B_N_ROT) {
						out->rope_changed_lo++;
					} else {
						out->rope_changed_hi++;
					}
				}
			}
		}
	}

	ggml_free(ctx);
	return 0;
}
```

## src/l5b_graph.h
```c
/*
 * L5b 그래프 — **호스트와 Zephyr 가 이 파일을 공유한다.**
 *
 * 치수는 Qwen3.5-0.8B 의 **실측값**이다(gguf_dump):
 *   attention.key_length = value_length = 256   (head_dim)
 *   attention.head_count = 8 · head_count_kv = 2   (GQA 4:1)
 *   rope.dimension_count = 64                   (**부분 RoPE** — 256 중 64만 회전)
 *   rope.dimension_sections = [11, 11, 10, 0]    (mRoPE 구간)
 *   rope.freq_base = 1e7 · embedding_length = 1024
 */
#ifndef L5B_GRAPH_H
#define L5B_GRAPH_H

#include <stdint.h>
#include "llm_fullsum.h"

#define L5B_HEAD_DIM	256
#define L5B_N_HEAD	8
#define L5B_N_HEAD_KV	2
#define L5B_N_TOK	4
#define L5B_N_EMBD	1024
#define L5B_N_ROT	64
#define L5B_FREQ_BASE	1.0e7f

#define L5B_Q_N		(L5B_HEAD_DIM * L5B_N_HEAD * L5B_N_TOK)		/* 8192 */
#define L5B_K_N		(L5B_HEAD_DIM * L5B_N_HEAD_KV * L5B_N_TOK)	/* 2048 */
#define L5B_KQ_N	(L5B_N_TOK * L5B_N_TOK * L5B_N_HEAD)		/* 128 */
#define L5B_ATT_N	(L5B_HEAD_DIM * L5B_N_HEAD * L5B_N_TOK)		/* 8192 */
#define L5B_OUT_N	(L5B_N_EMBD * L5B_N_TOK)			/* 4096 */

/* 큰 출력은 보폭 표본으로 비교하고 전체는 CRC32 로 한 번 더 본다 */
#define L5B_Q_STRIDE	8
#define L5B_Q_SAMP	(L5B_Q_N / L5B_Q_STRIDE)	/* 1024 */
#define L5B_K_STRIDE	2
#define L5B_K_SAMP	(L5B_K_N / L5B_K_STRIDE)	/* 1024 */
#define L5B_ATT_STRIDE	8
#define L5B_ATT_SAMP	(L5B_ATT_N / L5B_ATT_STRIDE)	/* 1024 */
#define L5B_OUT_STRIDE	4
#define L5B_OUT_SAMP	(L5B_OUT_N / L5B_OUT_STRIDE)	/* 1024 */

/* 전체 요약을 재는 텐서 — 순서가 골든 배열과 맞아야 한다 */
enum {
	L5B_FULL_QNORM = 0, L5B_FULL_KNORM, L5B_FULL_QROPE, L5B_FULL_KROPE,
	L5B_FULL_ATT, L5B_FULL_GATE, L5B_FULL_GATED, L5B_FULL_OUT,
	L5B_FULL_N
};
static const char *const l5b_full_names[L5B_FULL_N] = {
	"Q RMSNorm", "K RMSNorm", "Q mRoPE", "K mRoPE",
	"어텐션 출력", "게이트", "sigmoid 뒤", "층 출력",
};

struct l5b_results {
	float    q_norm[L5B_Q_SAMP];	uint32_t q_norm_crc;
	float    k_norm[L5B_K_SAMP];	uint32_t k_norm_crc;
	float    q_rope[L5B_Q_SAMP];	uint32_t q_rope_crc;
	float    k_rope[L5B_K_SAMP];	uint32_t k_rope_crc;
	float    kq[L5B_KQ_N];		/* 전체 — 작다 */
	float    att[L5B_ATT_SAMP];	uint32_t att_crc;
	float    gate[L5B_ATT_SAMP];	uint32_t gate_crc;
	/* sigmoid 를 지난 뒤 — 층 출력의 오차가 어디서 들어오는지 가린다 */
	float    gated[L5B_ATT_SAMP];	uint32_t gated_crc;
	float    out[L5B_OUT_SAMP];	uint32_t out_crc;
	/* 축 배치 */
	int64_t  ne_q_view[4];
	int64_t  ne_gate[4];
	int64_t  ne_kq[4];
	int64_t  ne_att2d[4];
	int64_t  ne_out[4];
	/* 부분 RoPE 증거 — 회전된 앞 64 과 안 건드린 뒤쪽이 구분되는가 */
	int      rope_changed_lo;	/* [0,64) 중 RoPE 로 값이 바뀐 개수 */
	int      rope_changed_hi;	/* [64,256) 중 바뀐 개수 — **0 이어야 한다** */
	/*
	 * 표본 밖 영역의 상한. CRC32 는 차이를 감지하지만 허용 오차가 없어
	 * libm 1 ulp 로도 달라지고 실패로 셀 수 없다. 큰 텐서는 12~50%만
	 * 표본이므로 전체 합·절댓값 합으로 묶는다. 순서는 L5B_FULL_* 와 맞춘다.
	 */
	struct llm_fullsum full[L5B_FULL_N];
	int      dotprod;
	int      i8mm;
};

int l5b_run(struct l5b_results *out);

#endif /* L5B_GRAPH_H */
```
