## Kconfig
```kconfig
# SPDX-License-Identifier: Apache-2.0
rsource "drivers/Kconfig"
rsource "soc_init/Kconfig"
```

## boards/radxa/radxa_zero_3e/Kconfig.radxa_zero_3e
```kconfig
# SPDX-License-Identifier: Apache-2.0

config BOARD_RADXA_ZERO_3E
	select SOC_RK3568
```

## drivers/Kconfig
```kconfig
# SPDX-License-Identifier: Apache-2.0
rsource "usb/udc/Kconfig"
rsource "hwinfo/Kconfig"
```

## drivers/hwinfo/Kconfig
```kconfig
# SPDX-License-Identifier: Apache-2.0

config HWINFO_RK3566_OTP
	bool "RK3566 OTP 에서 칩 고유 ID 읽기"
	depends on HWINFO
	default y if HWINFO
	help
	  OTP(OTP_NS @0xFE38C000)에서 칩 고유 ID 16바이트를 읽어
	  hwinfo_get_device_id() 로 제공한다. USB 직렬번호 문자열
	  디스크립터가 이것을 쓴다.

	  Zephyr 에 이 SoC 의 클럭·리셋 드라이버가 없으므로 CRU 레지스터를
	  직접 써서 OTP 클럭 게이트를 풀고 소프트리셋을 때린다. 주소와 비트의
	  출처는 소스 머리말에 적어 두었다.

	  읽기에 실패하면 자리표 ID 를 쓰고 경고를 남긴다 — USB 열거를
	  깨끗하게 유지하기 위한 것이다.
```

## drivers/sdhc/Kconfig
```kconfig
# SPDX-License-Identifier: Apache-2.0
config SDHC_RK_DW_MSHC
	bool "Rockchip RK3566 SD 컨트롤러 (DesignWare MSHC, PIO + IDMAC)"
	default y
	depends on DT_HAS_ROCKCHIP_RK3568_DW_MSHC_ENABLED
	select SDHC_SUPPORTS_NATIVE_MODE
	help
	  sdmmc0 @0xfe2b0000. U-Boot dw_mmc.c 의 FIFO 경로 + IDMAC 디스크립터 링(TF-A dw_mmc.c).
```

## drivers/usb/udc/Kconfig
```kconfig
# SPDX-License-Identifier: Apache-2.0

config UDC_DWC3
	bool "DWC3 USB device controller driver"
	default y
	depends on DT_HAS_SNPS_DWC3_ENABLED
	select UDC_DRIVER_HAS_HIGH_SPEED_SUPPORT
	select EVENTS
	help
	  Synopsys DesignWare USB 3.x (DWC3) 컨트롤러를 device 모드로 쓴다.

	  이 드라이버는 USB 2.0 High Speed device 동작만 대상으로 한다.
	  SuperSpeed · host/OTG 역할 전환 · hibernation 은 범위 밖이다
	  (대상 보드 Radxa ZERO 3E 가 USB3 combphy 를 연결하지 않음).

	  EVENTS 가 필요하다 — ISR 이 이벤트 처리 스레드를 깨우는 데
	  k_event 를 쓴다.

if UDC_DWC3

config UDC_DWC3_STACK_SIZE
	int "DWC3 driver internal thread stack size"
	default 1024
	help
	  이벤트 처리 스레드(아래쪽 절반)의 스택 크기.

	  udc_setup_received() 가 UDC 락에 의존해 스레드 문맥에서만 부를
	  수 있으므로 ISR 에서 이벤트를 처리할 수 없다. ISR 은 인터럽트를
	  마스크하고 깃발만 올리고, 이 스레드가 이벤트 링을 비운다.

config UDC_DWC3_THREAD_PRIORITY
	int "DWC3 driver internal thread priority"
	default 8
	help
	  이벤트 처리 스레드의 협조적(cooperative) 우선순위.
	  USB 호스트의 열거 타임아웃 안에 응답해야 하므로 낮지 않게 둔다.

endif # UDC_DWC3
```

## dts/bindings/sdhc/rockchip,rk3568-dw-mshc.yaml
```yaml
# SPDX-License-Identifier: Apache-2.0
description: |
  Rockchip RK3566/RK3568 SD 컨트롤러 (Synopsys DesignWare Mobile Storage Host, sdmmc0).
  drivers/sdhc/rk_dw_mshc.c — U-Boot drivers/mmc/dw_mmc.c 의 FIFO(PIO) 경로를 옮겼다.
  클럭·핀·전원은 U-Boot 가 해 둔 설정을 이어받고, 카드 클럭은 CRU clksel_con[30] 으로 고른다.

compatible: "rockchip,rk3568-dw-mshc"

include: [sdhc.yaml]

properties:
  reg:
    required: true

  fifo-depth:
    type: int
    default: 256
    description: FIFO 깊이 (32비트 워드). linux rk356x-base.dtsi 는 0x100.
```

## soc_init/Kconfig
```kconfig
# SPDX-License-Identifier: Apache-2.0
config MORU_LED
	bool "보드 LED 로 진행 상태 표시 (soc_init/moru_led.c)"
	depends on BOARD_RADXA_ZERO_3E
	default y
	help
	  GPIO0_A0 LED 를 상태별 패턴으로 깜박인다. 표는 include/moru_led.h.
	  LED 를 직접 다루는 진단 앱(ledblink·usbled·usbuart)은 n 으로 둔다.

config MORU_LED_FATAL_HANDLER
	bool "치명 오류 시 LED 0.2 초 점멸 (k_sys_fatal_error_handler 제공)"
	depends on MORU_LED
	default y
	help
	  앱이 자기 k_sys_fatal_error_handler 를 두면 n 으로 하고 그 끝에서
	  moru_led_fatal() 을 부른다 (apps/moru 가 그렇다).
```
